## drivers/char/xlog/Kconfig
```kconfig
config XLOGCHAR
	tristate "xlogchar driver"
	default m
	help
	  Implements a high performance log driver
```

## drivers/char/xlogchar/Kconfig
```kconfig
# SPDX-License-Identifier: GPL-2.0
#
# Character device configuration
#


config XLOGCHAR
	tristate "xlogchar driver"
	default m
	help
	  Implements a high performance log driver
```

## drivers/edac/Kconfig
```kconfig
# SPDX-License-Identifier: GPL-2.0-only
source "$(KCONFIG_EXT_PREFIX)drivers/edac/mediatek/Kconfig"
```

## drivers/edac/mediatek/Kconfig
```kconfig
# SPDX-License-Identifier: GPL-2.0

config MTK_EDAC
	bool "MediaTek EDAC support"
	help
	  Support for the EDAC devices found on MediaTek(R) SoCs.
	  This config enables MTK_SLC for SLC drivers.

if MTK_EDAC

config MTK_SLC
	tristate "MediaTek System Level Cache driver"
	depends on MTK_EDAC
	help
	  This selects the MediaTek(R) SLC driver.

endif
```

## drivers/firmware/cirrus/Kconfig
```kconfig
# SPDX-License-Identifier: GPL-2.0-only

config FW_CS_DSP_MI
	tristate
	default n

config CL_DSP_MI
	tristate
	default n
```

## drivers/gpu/drm/bridge/Kconfig
```kconfig
# SPDX-License-Identifier: GPL-2.0-only
config DRM_MAXIAM_MAX96851
	tristate "DRM EDP Support for Mediatek SoCs"
	depends on OF
	select PHY_MTK_EDP
	help
	  DRM/KMS EDPTX driver for Mediatek SoCs
	  Choose this option if you want to enable
	  eDPTX driver, and this config depends on
	  DRM_MEDIATEK
```

## drivers/gpu/drm/mediatek/disp_sync/Kconfig
```kconfig
config MTK_DISP_SYNC
	tristate "MTK Virtual Display Sync Control"
	help
	  MTK Virtual Display Sync Control is used for virtual
          display that sent to yocto wayland client. For virtual
	  display, no drm driver involved, but it still need fence
	  control and display vsync information.
```

## drivers/gpu/drm/mediatek/mediatek_v2/Kconfig
```kconfig
config DRM_MEDIATEK_V2
	bool "Version 2 of DRM Support for Mediatek SoCs"
	select FONT_SUPPORT
	help
	  Choose this option if you have a phone Mediatek
	  SoCs. The module will be called mediatek-drm v2
	  This driver provides kernel mode setting and
	  buffer management to userspace.

config DRM_MEDIATEK_DPTX_AUTO
	tristate "DRM DPTX AUTO Support for Mediatek SoCs"
	depends on DRM_MEDIATEK_V2
	help
	  DPTX AUTO driver for Mediatek SoCs.
	  This config will separate the auto from phone.
	  Choose this option if you want to enable
	  DPTX AUTO driver for auto.

config DRM_MEDIATEK_AUTO
	tristate "DRM AUTO Yocto Support for Mediatek SoCs"
	depends on DRM_MEDIATEK_V2
	help
	  DRM AUTO Yocto driver for Mediatek SoCs.
	  This config will separate the auto from phone.
	  Choose this option if you want to enable
	  DRM AUTO Yocto driver for auto.

config DRM_MEDIATEK_AUTO_YCT
	tristate "DRM AUTO Yocto Support for Mediatek SoCs"
	depends on DRM_MEDIATEK_V2
	help
	  DRM AUTO Yocto driver for Mediatek SoCs.
	  This config will separate the auto from phone.
	  Choose this option if you want to enable
	  DRM AUTO Yocto driver for auto.

config DRM_MTK_DISABLE_AEE_LAYER
	bool "Disable AEE Layer for the customer who don't want to produce AEE"
	help
	  Disable AEE Layer if you do not want to produce AEE.
	  Default Mediatek SoCs will produce AEE when exception occurred.
	  If this value is y, will not produce AEE.
	  If this value is n, will produce AEE.
	  If you do not produce AEE, please set it to Y in xxx_defconfig.

config DRM_MTK_R2Y
	bool "Support MTK RGB2YUV feature"
	help
	  Decide whether to support RGB 2 YUV by pq.
	  This config only for auto driver.
	  This feature requires the cowork of panel driver.
	  Enabling this feature ensures optimal color conversion
	  from RGB to YUV, which is essential for display and
	  imaging applications.

config LEDS_MTK_MODULE
	bool "backlight notify Support for AAL and PQ"
	help
	  Choose this option if you need leds to notify backlight.
	  If this value is y, leds will notify backlight to PQ and AAL.
	  This feature requires the cowork of AAL and PQ user-space process.

config MTK_AAL_SUPPORT
	bool "Support MTK ambient-light adaptive luma (AAL)"
	help
	  Decide whether to support ambient-light adaptive luma and
	  display visual enhancement.
	  This feature requires the cowork of AAL user-space algorithm process.

config MTK_DRE30_SUPPORT
	bool "Support DRE 30"
	help
	  Decide whether to support ambient-light adaptive luma and
	  display visual enhancement ver.3.
	  This feature requires the cowork of AAL user-space algorithm process.

config MTK_DISP_LOGGER
	bool "Default enable display logger function"
	help
	  Display logger would record display-related event
	  for debug purpose.
	  If this value is Y, display driver would
	  initial display loggger during driver probe
	  stage, but can still manual disable this function
	  through debugfs or procfs.

config MTK_DISP_DEBUG
	bool "Support display debug function, default disable in user load"
	help
	  Used to debug for display module, only needed by developers.
	  The function sould be disabled in user load for security.

config VIS_DISPLAY_DALI
	tristate "nova 336 asic driver"
	default n
	help
	  This is the nova 336 asic driver

config MTK_FB_MMDVFS_SUPPORT
       bool "No HRT hardware is required to support MMDVFS"
       help
         If HRT hardware is not in the platform, then support for
         MMDVFS needs to be added through software.

config MTK_LCM_DUAL_PORT_SUPPORT
	bool "support lcm dual dsi port"
	help
	  This config decide if device support lcm dual dsi port
	  If dsi support dual port, dual dsc may also should support
	  If this value is Y, display maybe single pipe
	  If dsi support dual port, each dsi could calculate lower mmclk, and
	  support more types lcm

config MTK_DISPLAY_DUAL_PIPE_DUAL_PORT_SUPPORT
	bool "support lcm dual pipe and dual dsi port"
	help
	  This config decide if device support lcm dual pipe and dual dsi port
	  If dsi support dual port, dual dsc may also should support
	  If this value is Y, display maybe dual pipe
	  If dsi support dual port, each dsi could calculate lower mmclk, and
	  support more types lcm

config MTK_MT6382_BDG
	tristate "Support Bridge IC 6382"
	help
	  This config decide if device with BridgeIC 6382
	  BridgeIC 6382 can support VESA-1.2 DSC, compressing display framedata
	  Normal project will disable it first
	  If you are not sure about this, do not set it to y

config MTK_SE_SUPPORT
	bool "Support auto RVC and AVM"
	help
	  This option enables support for the SurfaceEngine functionality within
	  the driver. The SurfaceEngine is responsible for handling specific
	  rendering tasks such as Rear View Camera (RVC) and Around View Monitoring
	  (AVM) features. Enabling this option will include the necessary APIs and
	  driver support required for these features to function correctly.
	  If your project requires RVC or AVM capabilities, or if you need to take
	  advantage of the SurfaceEngine's hardware acceleration for rendering,
	  you should enable this option. Otherwise, it can be left disabled to
	  reduce the driver's footprint.

config MTK_DISP_MMDVFS_INIT_SEQUENCE
	bool "Configure initialization sequence of DISP and MMDVFS"
	help
	  Say yes here to add support for adjusting the initialization sequence
	  between DISP and MMDVFS . This can be used to resolve issues with screen
	  flickering that arise due to the order in which these components are
	  started during the boot process.

config MTK_RECU_FENCE_LOCK
	bool "enable fence deadlock workarond for img_gpu"
	help
	  For IMG GPU, it will attach to display fence
	  by callback, and it maybe occur deadlock when fence ref is
	  reduced to zero in fence signal flow because of linux fence
	  limitation. So the option will control whether display run
	  workaround flow.

config MTK_LCM_PHYSICAL_ROTATION_HW
	bool "support LCM phsical rotation"
	help
	  For rotating in the right direction, this option should
	  be set firstly, because the code added in mtk_disp_ovl.c
	  will use this configuration to change the variable called
	  rotate to "1".
config ENABLE_SEND_PPS_PER_FRAME
	bool "send pps per frame"
	help
	  Say Y here if you want to enable send pps per frame support.
	  For  some bridge need send pps per frame when enable dsc.
	  Only for mt8678 dsi vdo mode.
	  Only for demo.

config MTK_LK_NO_DISPLAY
	tristate "DRM LK NO DISPLAY Support for Mediatek SoCs"
	depends on DRM_MEDIATEK_V2
	help
	  DRM LK NO DISPLAY Support for Mediatek SoCs.
	  This config will enable CONFIG_MTK_DISP_NO_LK.
	  Choose this option if you want to enable
	  CONFIG_MTK_DISP_NO_LK for auto.

config MTK_DP_AS_CRTC0
	tristate "DRM MTK_DP_AS_CRTC0 Support for Mediatek SoCs"
	depends on DRM_MEDIATEK_V2
	help
	  DRM MTK_DP_AS_CRTC0 Support for Mediatek SoCs.
	  This config will enable MTK_DP_AS_CRTC0.
	  Choose this option if you want to enable
	  MTK_DP_AS_CRTC0 for auto.

source "$(KCONFIG_EXT_PREFIX)drivers/gpu/drm/mediatek/mediatek_v2/mtk_drm_edp/Kconfig"
source "$(KCONFIG_EXT_PREFIX)drivers/gpu/drm/mediatek/mediatek_v2/mi_disp/Kconfig"
```

## drivers/gpu/drm/mediatek/mediatek_v2/v1/mtk_drm_auto/Kconfig
```kconfig
config DRM_MEDIATEK_AUTO
	tristate "DRM AUTO Support for Mediatek SoCs"
	depends on DRM_MEDIATEK_V2
	help
	  DRM AUTO driver for Mediatek SoCs.
	  This config will separate the auto from phone.
	  Choose this option if you want to enable
	  DRM AUTO driver for auto.

config DRM_MEDIATEK_AUTO_HOST
	tristate "DRM AUTO Host Support for Mediatek SoCs"
	depends on DRM_MEDIATEK_V2
	help
	  DRM AUTO Host driver for Mediatek SoCs.
	  This config will separate the auto host from phone.
	  Choose this option if you want to enable
	  DRM AUTO Host driver for auto.

config DRM_MEDIATEK_AUTO_GUEST
	tristate "DRM AUTO Guest Support for Mediatek SoCs"
	depends on DRM_MEDIATEK_V2
	help
	  DRM AUTO Guest driver for Mediatek SoCs.
	  This config will separate the auto guest from phone.
	  Choose this option if you want to enable
	  DRM AUTO Guest driver for auto.

config DRM_MEDIATEK_AUTO_MBRAIN
	bool "Enable MediaTek Display Support for MBRAIN"
	help
	  Enable support for MediaTek Display MBRAIN feature.
	  This feature provides advanced display capabilities
	  for MediaTek platforms. It is recommended to enable this
	  option if you are using a MediaTek platform that supports
	  the MBRAIN feature.

config DRM_MEDIATEK_AUTO_DUAL_PIPE_W_DUAL_DSC
	bool "Enable Dual Pipe with Dual DSC"
	help
	  Enable this option to support dual pipe with dual DSC (Display Stream Compression).
	  This is typically used for high-resolution display configurations.
	  If unsure, say N.
	  Requires hardware support for dual DSC pipelines.

config DRM_MEDIATEK_AUTO_VIRT_DISP_PATH
	tristate "Support display virtual path"
	help
	  Used for no physical display-port, only used to configure exdma blender
	  pq, etc.
	  The function is used in the hypervisor android virtual machine.
	  The function is used in the hypervisor android virtual machine.
```

## drivers/gpu/drm/mediatek/virtio_disp/Kconfig
```kconfig
# SPDX-License-Identifier: GPL-2.0-only
config MTK_VIRTIO_DISP
	tristate "MTK Virtual Display Sync Control"
	help
		MTK Virtual Display Sync Control is used for virtual
		display that sent to yocto wayland client. For virtual
		display, no drm driver involved, but it still need fence
		control and display vsync information.
```

## drivers/hooks/geniezone_vendor_hooks/Kconfig
```kconfig
# SPDX-License-Identifier: GPL-2.0

config MTK_GZVM_VENDOR_HOOKS
	tristate "GenieZone Hypervisor hooks to vendor modules"
	depends on ARM64
	help
	  This option enables support for GenieZone Hypervisor
	  vendor-specific hooks in the kernel.
	  Say Y here if you are building a kernel with support
	  for gzvm vendor-specific hooks. If unsure, say N.
	  To compile this driver as a module, choose M here: the
	  module will be called gzvm_hooks.
```

## drivers/hypervisor/host/Kconfig
```kconfig
# SPDX-License-Identifier: GPL-2.0-only
#
# Virtualization yocto host support drivers
#

config DEVICE_MODULES_ACRN_HSM
	tristate "ACRN Hypervisor Service Module"
	select EVENTFD
	help
	  ACRN Hypervisor Service Module (HSM) is a kernel module which
	  communicates with ACRN userspace through ioctls and talks to
	  the ACRN Hypervisor through hypercalls. HSM will only run in
	  a privileged management VM, called Service VM, to manage User
	  VMs and do I/O emulation. Not required for simply running
	  under ACRN as a User VM.

	  To compile as a module, choose M, the module will be called
	  acrn. If unsure, say N.

config DEVICE_MODULES_VHOST_BLK
	tristate "Host kernel accelerator for virtio blk (EXPERIMENTAL)"
	depends on BLOCK
	select VHOST
	help
	  This kernel module can be loaded in host kernel to accelerate
	  guest block with virtio_blk. Not to be confused with virtio_blk
	  module itself which needs to be loaded in guest kernel.

	  To compile this driver as a module, choose M here: the module will
	  be called vhost_blk.

config DEVICE_MODULES_VHOST_UART
	tristate "Host kernel accelerator for virtio uart (EXPERIMENTAL)"
	select VHOST
	help
	  This kernel module can be loaded in host kernel to accelerate
	  guest uart with virtio_console. Not to be confused with virtio_console
	  module itself which needs to be loaded in guest kernel.

	  To compile this driver as a module, choose M here: the module will
	  be called vhost_uart.

config VHOST_CMDQ
	tristate "hypervisor vhost cmdq driver"
	help
	  This extension enable vhost cmdq driver, vhost cmdq driver
	  for hypervisor project. The vhost driver is located at virt/grt,
	  Also used to isolate the conflicting part of the cmdq driver
	  on main project, default is n.

config VHOST_DMABUF
	tristate "vhost_dmabuf driver used to share buffers between dual systems"
	help
	  This kernel module can be loaded into the host kernel to import the
	  virtual address (va) passed by the guest and export a vhost file
	  descriptor (fd) to provide users with shared buffer capabilities.

	  To compile as a module, choose M, the module will be called
	  acrn. If unsure, say N.

config GRT_HYPERVISOR
	tristate "hypervisor driver config"
	help
	  This config enable hypervisor driver for hypervisor project, GRT_HYPERVISOR
	  can be used to distinguish hypervisor yocto OS and yocto OS. This config
	  is used in vhost OS(hypervisor yocto OS), default is n, to compile driver
	  as a module, choose M here.

config DEVICE_MODULES_VHOST_ADSP
	tristate "Host kernel accelerator for virtio blk (EXPERIMENTAL)"
	depends on BLOCK
	select VHOST
	help
	  This kernel module can be loaded in host kernel to accelerate
	  guest block with virtio_adsp. Not to be confused with virtio_adsp
	  module itself which needs to be loaded in guest kernel.

	  To compile this driver as a module, choose M here: the module will
	  be called vhost_adsp.

config VHOST_IOMMU
	tristate "hypervisor vhost iommu driver"
	help
	  This extension enable vhost iommu driver, vhost iommu driver
	  for hypervisor project. The vhost driver is located at virt/grt,
	  Also used to isolate the conflicting part of the iommu driver
	  on main project, default is n.
```

## drivers/hypervisor/vm_uos/Kconfig
```kconfig
# SPDX-License-Identifier: GPL-2.0-only
#
# Virtualization android guest support drivers
#

config HYPER_VM_UOS
	tristate "hypervisor guest android1 os"
	help
	  The hypervisor project is "m".
	  Used for hypervisor guest android1 os.
	  If your code is for hypervisor android os,
	  you can use it to wrap your code.

config VIRTIO_VIDEO_MTK_EXTENSION
	tristate "MTK extensions"
	help
	  This option enables support for MediaTek-specific extensions
	  to the virtio video driver.
	  This is the virtual video driver for virtio.
	  Say Y or M.

config VIRTIO_VIDEO_TRACE_DEBUG
	bool "VIRTIO Video TRACE Debug support"
	depends on VIRTIO_VIDEO_MTK_EXTENSION
	help
	  This is a debug interface for VIRTIO Video
	  Set Y to enable this feature.
	  Set N to disable this feature.
	  If unsure, Set N to disable it.
```
