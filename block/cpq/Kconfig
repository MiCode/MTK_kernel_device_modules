## drivers/hypervisor/yocto_uos/Kconfig
```kconfig
# SPDX-License-Identifier: GPL-2.0-only
#
# Virtualization yocto guest uos support drivers
#

config HYPER_YOCTO_UOS
	tristate "hypervisor guest yocto os"
	help
	  The hypervisor project is "m".
	  Used for hypervisor guest yocto os.
	  If your code is for hypervisor yocto uos os,
	  you can use it to wrap your code.

config VIRTIO_CONNINFRA_TBOX
	tristate "Hypervisor for virtio conninfra tbox"
	help
	  This extension enable virtio conninfra tbox driver, virtio conninfra tbox driver enable
	  for hypervisor project. The virtio driver is located at virt/spm_v1,
	  Also used to isolate the conflicting part of the conninfra driver
	  on main project, default is n.
```

## drivers/input/Vhost_input/Kconfig
```kconfig
config TOUCHSCREEN_VHOST_TOUCH
	tristate "vhost touchscreen"
        depends on GRT_VM
	help
	  Say Y here if you have a vhost_touch
	  to your system.
	  If build module, say M.
	  If unsure, say N.

config TOUCHSCREEN_VHOST_TOUCH_ENABLE
	bool "Enable vhost touch config"
	help
	  If you choose to enable this option, the kernel will include support for
	  the virtual host touchscreen driver. This is useful for systems that
	  require touch input to be managed by a guest operating system in a
	  virtualized environment. Enabling this option will allow the guest OS to
	  interact with the touchscreen as if it were directly connected to the
	  hardware
```

## drivers/input/Vhost_input_YO/Kconfig
```kconfig
config TOUCHSCREEN_VHOST_COMMON
	tristate "vhost common"
	help
	  Say Y here if you have a vhost_touch
	  to your system.
	  If build module, say M.
	  If unsure, say N.
```

## drivers/input/fingerprint/Kconfig
```kconfig
menu "Device Drivers"

config SILEAD_FP
	tristate "Silead Fingerprint driver support"
	help
	  This supports Silead Fingerprint drivers.

source "$(KCONFIG_EXT_PREFIX)drivers/input/fingerprint/silead/Kconfig"

endmenu
```

## drivers/input/input_handler/Kconfig
```kconfig
config INPUT_VHOST_HANDLER
	tristate "Input Vhost Handler support"
	help
	  Say Y here if you have a Input Vhost
	  Handler.
	  If build module, say M.
	  If unsure, say N.
```

## drivers/input/misc/Kconfig
```kconfig
# SPDX-License-Identifier: GPL-2.0-only
#
# Input misc drivers configuration
#
menuconfig INPUT_MISC
	bool "Miscellaneous devices"
	help
	  Say Y here, and a list of miscellaneous input drivers will be displayed.
	  Everything that didn't fit into the other categories is here. This option
	  doesn't affect the kernel.

	  If unsure, say Y.

if INPUT_MISC

source "$(KCONFIG_EXT_PREFIX)drivers/input/misc/aw_haptic/Kconfig"
source "$(KCONFIG_EXT_PREFIX)drivers/input/misc/si_haptic/Kconfig"
endif
```

## drivers/input/misc/aac_haptic/Kconfig
```kconfig
config AAC_VIBRATOR
    tristate "AAC Vibrator driver"
    default y
    help 
    AAC Vibrator driver
```

## drivers/input/misc/aw8693x_haptic/Kconfig
```kconfig
#
# MTK AWINIC_AW8693x_HAPTIC Driver
#

config AWINIC_AW8693x_HAPTIC
	tristate "Awinic high voltage LRA haptic driver"
	depends on I2C
	help
	  Say Y here if you have awinic high voltage haptic chip in your system.
	  If unsure, say N.
	  To compile this driver as a module, choose M here: the
	  module will be called haptic.
```

## drivers/input/misc/aw8693x_haptic_yili/Kconfig
```kconfig
#
# MTK AWINIC_AW8693x_HAPTIC_YILI Driver
#

config AWINIC_AW8693x_HAPTIC_YILI
	tristate "Awinic high voltage LRA haptic driver"
	depends on I2C
	help
	  Say Y here if you have awinic high voltage haptic chip in your system.
	  If unsure, say N.
	  To compile this driver as a module, choose M here: the
	  module will be called haptic.
```

## drivers/input/misc/fs3002_haptic/Kconfig
```kconfig
config INPUT_FS3002_HAPTIC
    tristate "Foursemi FS3002 HAPTIC"
    default y
    help 
    Foursemi Vibrator driver
```

## drivers/input/misc/si_haptic/Kconfig
```kconfig
config SIH_VIBRATOR
    tristate "SI Vibrator driver"
    default y
    help 
    SI Vibrator driver
```
