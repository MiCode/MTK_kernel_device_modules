
&tran_touch{

/* test limit for the pt7 testing */
/* including upper and lower bounds */
	pt7_hi_limits_row_01 = <38>;
	pt7_hi_limits_cols_01 = <38>;
	pt7_hi_limits_01 = <
		1700  1700  1700  1700  1700  1700  1700  1700  1700  1700  1700  1700  1700  1700  1700  1700  1700  1700  1700  1700  1700  1700  1700  1700  1700  1700  1700  1700  1700  1700  1700  1700  1700  1700  1700  1700  1700  1700
		1700  1700  1700  1700  1700  1700  1700  1700  1700  1700  1700  1700  1700  1700  1700  1700  1700  1700  1700  1700  1700  1700  1700  1700  1700  1700  1700  1700  1700  1700  1700  1700  1700  1700  1700  1700  1700  1700
		1700  1700  1700  1700  1700  1700  1700  1700  1700  1700  1700  1700  1700  1700  1700  1700  1700  1700  1700  1700  1700  1700  1700  1700  1700  1700  1700  1700  1700  1700  1700  1700  1700  1700  1700  1700  1700  1700
		1700  1700  1700  1700  1700  1700  1700  1700  1700  1700  1700  1700  1700  1700  1700  1700  1700  1700  1700  1700  1700  1700  1700  1700  1700  1700  1700  1700  1700  1700  1700  1700  1700  1700  1700  1700  1700  1700
		1700  1700  1700  1700  1700  1700  1700  1700  1700  1700  1700  1700  1700  1700  1700  1700  1700  1700  1700  1700  1700  1700  1700  1700  1700  1700  1700  1700  1700  1700  1700  1700  1700  1700  1700  1700  1700  1700
		1700  1700  1700  1700  1700  1700  1700  1700  1700  1700  1700  1700  1700  1700  1700  1700  1700  1700  1700  1700  1700  1700  1700  1700  1700  1700  1700  1700  1700  1700  1700  1700  1700  1700  1700  1700  1700  1700
		1700  1700  1700  1700  1700  1700  1700  1700  1700  1700  1700  1700  1700  1700  1700  1700  1700  1700  1700  1700  1700  1700  1700  1700  1700  1700  1700  1700  1700  1700  1700  1700  1700  1700  1700  1700  1700  1700
		1700  1700  1700  1700  1700  1700  1700  1700  1700  1700  1700  1700  1700  1700  1700  1700  1700  1700  1700  1700  1700  1700  1700  1700  1700  1700  1700  1700  1700  1700  1700  1700  1700  1700  1700  1700  1700  1700
		1700  1700  1700  1700  1700  1700  1700  1700  1700  1700  1700  1700  1700  1700  1700  1700  1700  1700  1700  1700  1700  1700  1700  1700  1700  1700  1700  1700  1700  1700  1700  1700  1700  1700  1700  1700  1700  1700
		1700  1700  1700  1700  1700  1700  1700  1700  1700  1700  1700  1700  1700  1700  1700  1700  1700  1700  1700  1700  1700  1700  1700  1700  1700  1700  1700  1700  1700  1700  1700  1700  1700  1700  1700  1700  1700  1700
		1700  1700  1700  1700  1700  1700  1700  1700  1700  1700  1700  1700  1700  1700  1700  1700  1700  1700  1700  1700  1700  1700  1700  1700  1700  1700  1700  1700  1700  1700  1700  1700  1700  1700  1700  1700  1700  1700
		1700  1700  1700  1700  1700  1700  1700  1700  1700  1700  1700  1700  1700  1700  1700  1700  1700  1700  1700  1700  1700  1700  1700  1700  1700  1700  1700  1700  1700  1700  1700  1700  1700  1700  1700  1700  1700  1700
		1700  1700  1700  1700  1700  1700  1700  1700  1700  1700  1700  1700  1700  1700  1700  1700  1700  1700  1700  1700  1700  1700  1700  1700  1700  1700  1700  1700  1700  1700  1700  1700  1700  1700  1700  1700  1700  1700
		1700  1700  1700  1700  1700  1700  1700  1700  1700  1700  1700  1700  1700  1700  1700  1700  1700  1700  1700  1700  1700  1700  1700  1700  1700  1700  1700  1700  1700  1700  1700  1700  1700  1700  1700  1700  1700  1700
		1700  1700  1700  1700  1700  1700  1700  1700  1700  1700  1700  1700  1700  1700  1700  1700  1700  1700  1700  1700  1700  1700  1700  1700  1700  1700  1700  1700  1700  1700  1700  1700  1700  1700  1700  1700  1700  1700
		1700  1700  1700  1700  1700  1700  1700  1700  1700  1700  1700  1700  1700  1700  1700  1700  1700  1700  1700  1700  1700  1700  1700  1700  1700  1700  1700  1700  1700  1700  1700  1700  1700  1700  1700  1700  1700  1700
		1700  1700  1700  1700  1700  1700  1700  1700  1700  1700  1700  1700  1700  1700  1700  1700  1700  1700  1700  1700  1700  1700  1700  1700  1700  1700  1700  1700  1700  1700  1700  1700  1700  1700  1700  1700  1700  1700
		1700  1700  1700  1700  1700  1700  1700  1700  1700  1700  1700  1700  1700  1700  1700  1700  1700  1700  1700  1700  1700  1700  1700  1700  1700  1700  1700  1700  1700  1700  1700  1700  1700  1700  1700  1700  1700  1700
		1700  1700  1700  1700  1700  1700  1700  1700  1700  1700  1700  1700  1700  1700  1700  1700  1700  1700  1700  1700  1700  1700  1700  1700  1700  1700  1700  1700  1700  1700  1700  1700  1700  1700  1700  1700  1700  1700
		1700  1700  1700  1700  1700  1700  1700  1700  1700  1700  1700  1700  1700  1700  1700  1700  1700  1700  1700  1700  1700  1700  1700  1700  1700  1700  1700  1700  1700  1700  1700  1700  1700  1700  1700  1700  1700  1700
		1700  1700  1700  1700  1700  1700  1700  1700  1700  1700  1700  1700  1700  1700  1700  1700  1700  1700  1700  1700  1700  1700  1700  1700  1700  1700  1700  1700  1700  1700  1700  1700  1700  1700  1700  1700  1700  1700
		1700  1700  1700  1700  1700  1700  1700  1700  1700  1700  1700  1700  1700  1700  1700  1700  1700  1700  1700  1700  1700  1700  1700  1700  1700  1700  1700  1700  1700  1700  1700  1700  1700  1700  1700  1700  1700  1700
		1700  1700  1700  1700  1700  1700  1700  1700  1700  1700  1700  1700  1700  1700  1700  1700  1700  1700  1700  1700  1700  1700  1700  1700  1700  1700  1700  1700  1700  1700  1700  1700  1700  1700  1700  1700  1700  1700
		1700  1700  1700  1700  1700  1700  1700  1700  1700  1700  1700  1700  1700  1700  1700  1700  1700  1700  1700  1700  1700  1700  1700  1700  1700  1700  1700  1700  1700  1700  1700  1700  1700  1700  1700  1700  1700  1700
		1700  1700  1700  1700  1700  1700  1700  1700  1700  1700  1700  1700  1700  1700  1700  1700  1700  1700  1700  1700  1700  1700  1700  1700  1700  1700  1700  1700  1700  1700  1700  1700  1700  1700  1700  1700  1700  1700
		1700  1700  1700  1700  1700  1700  1700  1700  1700  1700  1700  1700  1700  1700  1700  1700  1700  1700  1700  1700  1700  1700  1700  1700  1700  1700  1700  1700  1700  1700  1700  1700  1700  1700  1700  1700  1700  1700
		1700  1700  1700  1700  1700  1700  1700  1700  1700  1700  1700  1700  1700  1700  1700  1700  1700  1700  1700  1700  1700  1700  1700  1700  1700  1700  1700  1700  1700  1700  1700  1700  1700  1700  1700  1700  1700  1700
		1700  1700  1700  1700  1700  1700  1700  1700  1700  1700  1700  1700  1700  1700  1700  1700  1700  1700  1700  1700  1700  1700  1700  1700  1700  1700  1700  1700  1700  1700  1700  1700  1700  1700  1700  1700  1700  1700
		1700  1700  1700  1700  1700  1700  1700  1700  1700  1700  1700  1700  1700  1700  1700  1700  1700  1700  1700  1700  1700  1700  1700  1700  1700  1700  1700  1700  1700  1700  1700  1700  1700  1700  1700  1700  1700  1700
		1700  1700  1700  1700  1700  1700  1700  1700  1700  1700  1700  1700  1700  1700  1700  1700  1700  1700  1700  1700  1700  1700  1700  1700  1700  1700  1700  1700  1700  1700  1700  1700  1700  1700  1700  1700  1700  1700
		1700  1700  1700  1700  1700  1700  1700  1700  1700  1700  1700  1700  1700  1700  1700  1700  1700  1700  1700  1700  1700  1700  1700  1700  1700  1700  1700  1700  1700  1700  1700  1700  1700  1700  1700  1700  1700  1700
		1700  1700  1700  1700  1700  1700  1700  1700  20000 20000 1700  1700  1700  1700  1700  1700  1700  1700  1700  1700  1700  1700  1700  1700  1700  1700  1700  1700  1700  1700  1700  1700  1700  1700  1700  1700  1700  1700
		1700  1700  1700  1700  1700  1700  1700  1700  1700  1700  1700  1700  1700  1700  1700  1700  1700  1700  1700  1700  1700  1700  1700  1700  1700  1700  1700  1700  1700  1700  1700  1700  1700  1700  1700  1700  1700  1700
		1700  1700  1700  1700  1700  1700  1700  1700  1700  1700  1700  1700  1700  1700  1700  1700  1700  1700  1700  1700  1700  1700  1700  1700  1700  1700  1700  1700  1700  1700  1700  1700  1700  1700  1700  1700  1700  1700
		1700  1700  1700  1700  1700  1700  1700  1700  1700  1700  1700  1700  1700  1700  1700  1700  1700  1700  1700  1700  1700  1700  1700  1700  1700  1700  1700  1700  1700  1700  1700  1700  1700  1700  1700  1700  1700  1700
		1700  1700  1700  1700  1700  1700  1700  1700  1700  1700  1700  1700  1700  1700  1700  1700  1700  1700  1700  1700  1700  1700  1700  1700  1700  1700  1700  1700  1700  1700  1700  1700  1700  1700  1700  1700  1700  1700
		1700  1700  1700  1700  1700  1700  1700  1700  1700  1700  1700  1700  1700  1700  1700  1700  1700  1700  1700  1700  1700  1700  1700  1700  1700  1700  1700  1700  1700  1700  1700  1700  1700  1700  1700  1700  1700  1700
		1700  1700  1700  1700  1700  1700  1700  1700  1700  1700  1700  1700  1700  1700  1700  1700  1700  1700  1700  1700  1700  1700  1700  1700  1700  1700  1700  1700  1700  1700  1700  1700  1700  1700  1700  1700  1700  1700
	>;

	pt7_lo_limits_row_01 = <38>;
	pt7_lo_limits_cols_01 = <38>;
	pt7_lo_limits_01 = <
		300  300  300  300  300  300  300  300  300  300  300  300  300  300  300  300  300  300  300  300  300  300  300  300  300  300  300  300  300  300  300  300  300  300  300  300  300  300
		300  300  300  300  300  300  300  300  300  300  300  300  300  300  300  300  300  300  300  300  300  300  300  300  300  300  300  300  300  300  300  300  300  300  300  300  300  300
		300  300  300  300  300  300  300  300  300  300  300  300  300  300  300  300  300  300  300  300  300  300  300  300  300  300  300  300  300  300  300  300  300  300  300  300  300  300
		300  300  300  300  300  300  300  300  300  300  300  300  300  300  300  300  300  300  300  300  300  300  300  300  300  300  300  300  300  300  300  300  300  300  300  300  300  300
		300  300  300  300  300  300  300  300  300  300  300  300  300  300  300  300  300  300  300  300  300  300  300  300  300  300  300  300  300  300  300  300  300  300  300  300  300  300
		300  300  300  300  300  300  300  300  300  300  300  300  300  300  300  300  300  300  300  300  300  300  300  300  300  300  300  300  300  300  300  300  300  300  300  300  300  300
		300  300  300  300  300  300  300  300  300  300  300  300  300  300  300  300  300  300  300  300  300  300  300  300  300  300  300  300  300  300  300  300  300  300  300  300  300  300
		300  300  300  300  300  300  300  300  300  300  300  300  300  300  300  300  300  300  300  300  300  300  300  300  300  300  300  300  300  300  300  300  300  300  300  300  300  300
		300  300  300  300  300  300  300  300  300  300  300  300  300  300  300  300  300  300  300  300  300  300  300  300  300  300  300  300  300  300  300  300  300  300  300  300  300  300
		300  300  300  300  300  300  300  300  300  300  300  300  300  300  300  300  300  300  300  300  300  300  300  300  300  300  300  300  300  300  300  300  300  300  300  300  300  300
		300  300  300  300  300  300  300  300  300  300  300  300  300  300  300  300  300  300  300  300  300  300  300  300  300  300  300  300  300  300  300  300  300  300  300  300  300  300
		300  300  300  300  300  300  300  300  300  300  300  300  300  300  300  300  300  300  300  300  300  300  300  300  300  300  300  300  300  300  300  300  300  300  300  300  300  300
		300  300  300  300  300  300  300  300  300  300  300  300  300  300  300  300  300  300  300  300  300  300  300  300  300  300  300  300  300  300  300  300  300  300  300  300  300  300
		300  300  300  300  300  300  300  300  300  300  300  300  300  300  300  300  300  300  300  300  300  300  300  300  300  300  300  300  300  300  300  300  300  300  300  300  300  300
		300  300  300  300  300  300  300  300  300  300  300  300  300  300  300  300  300  300  300  300  300  300  300  300  300  300  300  300  300  300  300  300  300  300  300  300  300  300
		300  300  300  300  300  300  300  300  300  300  300  300  300  300  300  300  300  300  300  300  300  300  300  300  300  300  300  300  300  300  300  300  300  300  300  300  300  300
		300  300  300  300  300  300  300  300  300  300  300  300  300  300  300  300  300  300  300  300  300  300  300  300  300  300  300  300  300  300  300  300  300  300  300  300  300  300
		300  300  300  300  300  300  300  300  300  300  300  300  300  300  300  300  300  300  300  300  300  300  300  300  300  300  300  300  300  300  300  300  300  300  300  300  300  300
		300  300  300  300  300  300  300  300  300  300  300  300  300  300  300  300  300  300  300  300  300  300  300  300  300  300  300  300  300  300  300  300  300  300  300  300  300  300
		300  300  300  300  300  300  300  300  300  300  300  300  300  300  300  300  300  300  300  300  300  300  300  300  300  300  300  300  300  300  300  300  300  300  300  300  300  300
		300  300  300  300  300  300  300  300  300  300  300  300  300  300  300  300  300  300  300  300  300  300  300  300  300  300  300  300  300  300  300  300  300  300  300  300  300  300
		300  300  300  300  300  300  300  300  300  300  300  300  300  300  300  300  300  300  300  300  300  300  300  300  300  300  300  300  300  300  300  300  300  300  300  300  300  300
		300  300  300  300  300  300  300  300  300  300  300  300  300  300  300  300  300  300  300  300  300  300  300  300  300  300  300  300  300  300  300  300  300  300  300  300  300  300
		300  300  300  300  300  300  300  300  300  300  300  300  300  300  300  300  300  300  300  300  300  300  300  300  300  300  300  300  300  300  300  300  300  300  300  300  300  300
		300  300  300  300  300  300  300  300  300  300  300  300  300  300  300  300  300  300  300  300  300  300  300  300  300  300  300  300  300  300  300  300  300  300  300  300  300  300
		300  300  300  300  300  300  300  300  300  300  300  300  300  300  300  300  300  300  300  300  300  300  300  300  300  300  300  300  300  300  300  300  300  300  300  300  300  300
		300  300  300  300  300  300  300  300  300  300  300  300  300  300  300  300  300  300  300  300  300  300  300  300  300  300  300  300  300  300  300  300  300  300  300  300  300  300
		300  300  300  300  300  300  300  300  300  300  300  300  300  300  300  300  300  300  300  300  300  300  300  300  300  300  300  300  300  300  300  300  300  300  300  300  300  300
		300  300  300  300  300  300  300  300  300  300  300  300  300  300  300  300  300  300  300  300  300  300  300  300  300  300  300  300  300  300  300  300  300  300  300  300  300  300
		300  300  300  300  300  300  300  300  300  300  300  300  300  300  300  300  300  300  300  300  300  300  300  300  300  300  300  300  300  300  300  300  300  300  300  300  300  300
		300  300  300  300  300  300  300  300  300  300  300  300  300  300  300  300  300  300  300  300  300  300  300  300  300  300  300  300  300  300  300  300  300  300  300  300  300  300
		300  300  300  300  300  300  300  300  0    0    300  300  300  300  300  300  300  300  300  300  300  300  300  300  300  300  300  300  300  300  300  300  300  300  300  300  300  300
		300  300  300  300  300  300  300  300  300  300  300  300  300  300  300  300  300  300  300  300  300  300  300  300  300  300  300  300  300  300  300  300  300  300  300  300  300  300
		300  300  300  300  300  300  300  300  300  300  300  300  300  300  300  300  300  300  300  300  300  300  300  300  300  300  300  300  300  300  300  300  300  300  300  300  300  300
		300  300  300  300  300  300  300  300  300  300  300  300  300  300  300  300  300  300  300  300  300  300  300  300  300  300  300  300  300  300  300  300  300  300  300  300  300  300
		300  300  300  300  300  300  300  300  300  300  300  300  300  300  300  300  300  300  300  300  300  300  300  300  300  300  300  300  300  300  300  300  300  300  300  300  300  300
		300  300  300  300  300  300  300  300  300  300  300  300  300  300  300  300  300  300  300  300  300  300  300  300  300  300  300  300  300  300  300  300  300  300  300  300  300  300
		300  300  300  300  300  300  300  300  300  300  300  300  300  300  300  300  300  300  300  300  300  300  300  300  300  300  300  300  300  300  300  300  300  300  300  300  300  300
	>;

/* test limit for the pt11 testing */
/*  including upper and lower bounds */
	pt11_hi_limits_row_01 = <38>;
	pt11_hi_limits_cols_01 = <38>;
	pt11_hi_limits_01 = <
		 80  80  80  80  80  80  80  80  80  80  80  80  80  80  80  80  80  80  80  80  80  80  80  80  80  80  80  80  80  80  80  80  80  80  80  80  80  80
		 80  80  80  80  80  80  80  80  80  80  80  80  80  80  80  80  80  80  80  80  80  80  80  80  80  80  80  80  80  80  80  80  80  80  80  80  80  80
		 80  80  80  80  80  80  80  80  80  80  80  80  80  80  80  80  80  80  80  80  80  80  80  80  80  80  80  80  80  80  80  80  80  80  80  80  80  80
		 80  80  80  80  80  80  80  80  80  80  80  80  80  80  80  80  80  80  80  80  80  80  80  80  80  80  80  80  80  80  80  80  80  80  80  80  80  80
		 80  80  80  80  80  80  80  80  80  80  80  80  80  80  80  80  80  80  80  80  80  80  80  80  80  80  80  80  80  80  80  80  80  80  80  80  80  80
		 80  80  80  80  80  80  80  80  80  80  80  80  80  80  80  80  80  80  80  80  80  80  80  80  80  80  80  80  80  80  80  80  80  80  80  80  80  80
		 80  80  80  80  80  80  80  80  80  80  80  80  80  80  80  80  80  80  80  80  80  80  80  80  80  80  80  80  80  80  80  80  80  80  80  80  80  80
		 80  80  80  80  80  80  80  80  80  80  80  80  80  80  80  80  80  80  80  80  80  80  80  80  80  80  80  80  80  80  80  80  80  80  80  80  80  80
		 80  80  80  80  80  80  80  80  80  80  80  80  80  80  80  80  80  80  80  80  80  80  80  80  80  80  80  80  80  80  80  80  80  80  80  80  80  80
		 80  80  80  80  80  80  80  80  80  80  80  80  80  80  80  80  80  80  80  80  80  80  80  80  80  80  80  80  80  80  80  80  80  80  80  80  80  80
		 80  80  80  80  80  80  80  80  80  80  80  80  80  80  80  80  80  80  80  80  80  80  80  80  80  80  80  80  80  80  80  80  80  80  80  80  80  80
		 80  80  80  80  80  80  80  80  80  80  80  80  80  80  80  80  80  80  80  80  80  80  80  80  80  80  80  80  80  80  80  80  80  80  80  80  80  80
		 80  80  80  80  80  80  80  80  80  80  80  80  80  80  80  80  80  80  80  80  80  80  80  80  80  80  80  80  80  80  80  80  80  80  80  80  80  80
		 80  80  80  80  80  80  80  80  80  80  80  80  80  80  80  80  80  80  80  80  80  80  80  80  80  80  80  80  80  80  80  80  80  80  80  80  80  80
		 80  80  80  80  80  80  80  80  80  80  80  80  80  80  80  80  80  80  80  80  80  80  80  80  80  80  80  80  80  80  80  80  80  80  80  80  80  80
		 80  80  80  80  80  80  80  80  80  80  80  80  80  80  80  80  80  80  80  80  80  80  80  80  80  80  80  80  80  80  80  80  80  80  80  80  80  80
		 80  80  80  80  80  80  80  80  80  80  80  80  80  80  80  80  80  80  80  80  80  80  80  80  80  80  80  80  80  80  80  80  80  80  80  80  80  80
		 80  80  80  80  80  80  80  80  80  80  80  80  80  80  80  80  80  80  80  80  80  80  80  80  80  80  80  80  80  80  80  80  80  80  80  80  80  80
		 80  80  80  80  80  80  80  80  80  80  80  80  80  80  80  80  80  80  80  80  80  80  80  80  80  80  80  80  80  80  80  80  80  80  80  80  80  80
		 80  80  80  80  80  80  80  80  80  80  80  80  80  80  80  80  80  80  80  80  80  80  80  80  80  80  80  80  80  80  80  80  80  80  80  80  80  80
		 80  80  80  80  80  80  80  80  80  80  80  80  80  80  80  80  80  80  80  80  80  80  80  80  80  80  80  80  80  80  80  80  80  80  80  80  80  80
		 80  80  80  80  80  80  80  80  80  80  80  80  80  80  80  80  80  80  80  80  80  80  80  80  80  80  80  80  80  80  80  80  80  80  80  80  80  80
		 80  80  80  80  80  80  80  80  80  80  80  80  80  80  80  80  80  80  80  80  80  80  80  80  80  80  80  80  80  80  80  80  80  80  80  80  80  80
		 80  80  80  80  80  80  80  80  80  80  80  80  80  80  80  80  80  80  80  80  80  80  80  80  80  80  80  80  80  80  80  80  80  80  80  80  80  80
		 80  80  80  80  80  80  80  80  80  80  80  80  80  80  80  80  80  80  80  80  80  80  80  80  80  80  80  80  80  80  80  80  80  80  80  80  80  80
		 80  80  80  80  80  80  80  80  80  80  80  80  80  80  80  80  80  80  80  80  80  80  80  80  80  80  80  80  80  80  80  80  80  80  80  80  80  80
		 80  80  80  80  80  80  80  80  80  80  80  80  80  80  80  80  80  80  80  80  80  80  80  80  80  80  80  80  80  80  80  80  80  80  80  80  80  80
		 80  80  80  80  80  80  80  80  80  80  80  80  80  80  80  80  80  80  80  80  80  80  80  80  80  80  80  80  80  80  80  80  80  80  80  80  80  80
		 80  80  80  80  80  80  80  80  80  80  80  80  80  80  80  80  80  80  80  80  80  80  80  80  80  80  80  80  80  80  80  80  80  80  80  80  80  80
		 80  80  80  80  80  80  80  80  80  80  80  80  80  80  80  80  80  80  80  80  80  80  80  80  80  80  80  80  80  80  80  80  80  80  80  80  80  80
		 80  80  80  80  80  80  80  80  80  80  80  80  80  80  80  80  80  80  80  80  80  80  80  80  80  80  80  80  80  80  80  80  80  80  80  80  80  80
		 80  80  80  80  80  80  80  80  80  80  80  80  80  80  80  80  80  80  80  80  80  80  80  80  80  80  80  80  80  80  80  80  80  80  80  80  80  80
		 80  80  80  80  80  80  80  80  80  80  80  80  80  80  80  80  80  80  80  80  80  80  80  80  80  80  80  80  80  80  80  80  80  80  80  80  80  80
		 80  80  80  80  80  80  80  80  80  80  80  80  80  80  80  80  80  80  80  80  80  80  80  80  80  80  80  80  80  80  80  80  80  80  80  80  80  80
		 80  80  80  80  80  80  80  80  80  80  80  80  80  80  80  80  80  80  80  80  80  80  80  80  80  80  80  80  80  80  80  80  80  80  80  80  80  80
		 80  80  80  80  80  80  80  80  80  80  80  80  80  80  80  80  80  80  80  80  80  80  80  80  80  80  80  80  80  80  80  80  80  80  80  80  80  80
		 80  80  80  80  80  80  80  80  80  80  80  80  80  80  80  80  80  80  80  80  80  80  80  80  80  80  80  80  80  80  80  80  80  80  80  80  80  80
		 80  80  80  80  80  80  80  80  80  80  80  80  80  80  80  80  80  80  80  80  80  80  80  80  80  80  80  80  80  80  80  80  80  80  80  80  80  80
	 >;

	pt11_lo_limits_row_01 = <38>;
	pt11_lo_limits_cols_01 = <38>;
	pt11_lo_limits_01 = <
		 (-80)  (-80)  (-80)  (-80)  (-80)  (-80)  (-80)  (-80)  (-80)  (-80)  (-80)  (-80)  (-80)  (-80)  (-80)  (-80)  (-80)  (-80)  (-80)  (-80)  (-80)  (-80)  (-80)  (-80)  (-80)  (-80)  (-80)  (-80)  (-80)  (-80)  (-80)  (-80)  (-80)  (-80)  (-80)  (-80)  (-80)  (-80)
		 (-80)  (-80)  (-80)  (-80)  (-80)  (-80)  (-80)  (-80)  (-80)  (-80)  (-80)  (-80)  (-80)  (-80)  (-80)  (-80)  (-80)  (-80)  (-80)  (-80)  (-80)  (-80)  (-80)  (-80)  (-80)  (-80)  (-80)  (-80)  (-80)  (-80)  (-80)  (-80)  (-80)  (-80)  (-80)  (-80)  (-80)  (-80)
		 (-80)  (-80)  (-80)  (-80)  (-80)  (-80)  (-80)  (-80)  (-80)  (-80)  (-80)  (-80)  (-80)  (-80)  (-80)  (-80)  (-80)  (-80)  (-80)  (-80)  (-80)  (-80)  (-80)  (-80)  (-80)  (-80)  (-80)  (-80)  (-80)  (-80)  (-80)  (-80)  (-80)  (-80)  (-80)  (-80)  (-80)  (-80)
		 (-80)  (-80)  (-80)  (-80)  (-80)  (-80)  (-80)  (-80)  (-80)  (-80)  (-80)  (-80)  (-80)  (-80)  (-80)  (-80)  (-80)  (-80)  (-80)  (-80)  (-80)  (-80)  (-80)  (-80)  (-80)  (-80)  (-80)  (-80)  (-80)  (-80)  (-80)  (-80)  (-80)  (-80)  (-80)  (-80)  (-80)  (-80)
		 (-80)  (-80)  (-80)  (-80)  (-80)  (-80)  (-80)  (-80)  (-80)  (-80)  (-80)  (-80)  (-80)  (-80)  (-80)  (-80)  (-80)  (-80)  (-80)  (-80)  (-80)  (-80)  (-80)  (-80)  (-80)  (-80)  (-80)  (-80)  (-80)  (-80)  (-80)  (-80)  (-80)  (-80)  (-80)  (-80)  (-80)  (-80)
		 (-80)  (-80)  (-80)  (-80)  (-80)  (-80)  (-80)  (-80)  (-80)  (-80)  (-80)  (-80)  (-80)  (-80)  (-80)  (-80)  (-80)  (-80)  (-80)  (-80)  (-80)  (-80)  (-80)  (-80)  (-80)  (-80)  (-80)  (-80)  (-80)  (-80)  (-80)  (-80)  (-80)  (-80)  (-80)  (-80)  (-80)  (-80)
		 (-80)  (-80)  (-80)  (-80)  (-80)  (-80)  (-80)  (-80)  (-80)  (-80)  (-80)  (-80)  (-80)  (-80)  (-80)  (-80)  (-80)  (-80)  (-80)  (-80)  (-80)  (-80)  (-80)  (-80)  (-80)  (-80)  (-80)  (-80)  (-80)  (-80)  (-80)  (-80)  (-80)  (-80)  (-80)  (-80)  (-80)  (-80)
		 (-80)  (-80)  (-80)  (-80)  (-80)  (-80)  (-80)  (-80)  (-80)  (-80)  (-80)  (-80)  (-80)  (-80)  (-80)  (-80)  (-80)  (-80)  (-80)  (-80)  (-80)  (-80)  (-80)  (-80)  (-80)  (-80)  (-80)  (-80)  (-80)  (-80)  (-80)  (-80)  (-80)  (-80)  (-80)  (-80)  (-80)  (-80)
		 (-80)  (-80)  (-80)  (-80)  (-80)  (-80)  (-80)  (-80)  (-80)  (-80)  (-80)  (-80)  (-80)  (-80)  (-80)  (-80)  (-80)  (-80)  (-80)  (-80)  (-80)  (-80)  (-80)  (-80)  (-80)  (-80)  (-80)  (-80)  (-80)  (-80)  (-80)  (-80)  (-80)  (-80)  (-80)  (-80)  (-80)  (-80)
		 (-80)  (-80)  (-80)  (-80)  (-80)  (-80)  (-80)  (-80)  (-80)  (-80)  (-80)  (-80)  (-80)  (-80)  (-80)  (-80)  (-80)  (-80)  (-80)  (-80)  (-80)  (-80)  (-80)  (-80)  (-80)  (-80)  (-80)  (-80)  (-80)  (-80)  (-80)  (-80)  (-80)  (-80)  (-80)  (-80)  (-80)  (-80)
		 (-80)  (-80)  (-80)  (-80)  (-80)  (-80)  (-80)  (-80)  (-80)  (-80)  (-80)  (-80)  (-80)  (-80)  (-80)  (-80)  (-80)  (-80)  (-80)  (-80)  (-80)  (-80)  (-80)  (-80)  (-80)  (-80)  (-80)  (-80)  (-80)  (-80)  (-80)  (-80)  (-80)  (-80)  (-80)  (-80)  (-80)  (-80)
		 (-80)  (-80)  (-80)  (-80)  (-80)  (-80)  (-80)  (-80)  (-80)  (-80)  (-80)  (-80)  (-80)  (-80)  (-80)  (-80)  (-80)  (-80)  (-80)  (-80)  (-80)  (-80)  (-80)  (-80)  (-80)  (-80)  (-80)  (-80)  (-80)  (-80)  (-80)  (-80)  (-80)  (-80)  (-80)  (-80)  (-80)  (-80)
		 (-80)  (-80)  (-80)  (-80)  (-80)  (-80)  (-80)  (-80)  (-80)  (-80)  (-80)  (-80)  (-80)  (-80)  (-80)  (-80)  (-80)  (-80)  (-80)  (-80)  (-80)  (-80)  (-80)  (-80)  (-80)  (-80)  (-80)  (-80)  (-80)  (-80)  (-80)  (-80)  (-80)  (-80)  (-80)  (-80)  (-80)  (-80)
		 (-80)  (-80)  (-80)  (-80)  (-80)  (-80)  (-80)  (-80)  (-80)  (-80)  (-80)  (-80)  (-80)  (-80)  (-80)  (-80)  (-80)  (-80)  (-80)  (-80)  (-80)  (-80)  (-80)  (-80)  (-80)  (-80)  (-80)  (-80)  (-80)  (-80)  (-80)  (-80)  (-80)  (-80)  (-80)  (-80)  (-80)  (-80)
		 (-80)  (-80)  (-80)  (-80)  (-80)  (-80)  (-80)  (-80)  (-80)  (-80)  (-80)  (-80)  (-80)  (-80)  (-80)  (-80)  (-80)  (-80)  (-80)  (-80)  (-80)  (-80)  (-80)  (-80)  (-80)  (-80)  (-80)  (-80)  (-80)  (-80)  (-80)  (-80)  (-80)  (-80)  (-80)  (-80)  (-80)  (-80)
		 (-80)  (-80)  (-80)  (-80)  (-80)  (-80)  (-80)  (-80)  (-80)  (-80)  (-80)  (-80)  (-80)  (-80)  (-80)  (-80)  (-80)  (-80)  (-80)  (-80)  (-80)  (-80)  (-80)  (-80)  (-80)  (-80)  (-80)  (-80)  (-80)  (-80)  (-80)  (-80)  (-80)  (-80)  (-80)  (-80)  (-80)  (-80)
		 (-80)  (-80)  (-80)  (-80)  (-80)  (-80)  (-80)  (-80)  (-80)  (-80)  (-80)  (-80)  (-80)  (-80)  (-80)  (-80)  (-80)  (-80)  (-80)  (-80)  (-80)  (-80)  (-80)  (-80)  (-80)  (-80)  (-80)  (-80)  (-80)  (-80)  (-80)  (-80)  (-80)  (-80)  (-80)  (-80)  (-80)  (-80)
		 (-80)  (-80)  (-80)  (-80)  (-80)  (-80)  (-80)  (-80)  (-80)  (-80)  (-80)  (-80)  (-80)  (-80)  (-80)  (-80)  (-80)  (-80)  (-80)  (-80)  (-80)  (-80)  (-80)  (-80)  (-80)  (-80)  (-80)  (-80)  (-80)  (-80)  (-80)  (-80)  (-80)  (-80)  (-80)  (-80)  (-80)  (-80)
		 (-80)  (-80)  (-80)  (-80)  (-80)  (-80)  (-80)  (-80)  (-80)  (-80)  (-80)  (-80)  (-80)  (-80)  (-80)  (-80)  (-80)  (-80)  (-80)  (-80)  (-80)  (-80)  (-80)  (-80)  (-80)  (-80)  (-80)  (-80)  (-80)  (-80)  (-80)  (-80)  (-80)  (-80)  (-80)  (-80)  (-80)  (-80)
		 (-80)  (-80)  (-80)  (-80)  (-80)  (-80)  (-80)  (-80)  (-80)  (-80)  (-80)  (-80)  (-80)  (-80)  (-80)  (-80)  (-80)  (-80)  (-80)  (-80)  (-80)  (-80)  (-80)  (-80)  (-80)  (-80)  (-80)  (-80)  (-80)  (-80)  (-80)  (-80)  (-80)  (-80)  (-80)  (-80)  (-80)  (-80)
		 (-80)  (-80)  (-80)  (-80)  (-80)  (-80)  (-80)  (-80)  (-80)  (-80)  (-80)  (-80)  (-80)  (-80)  (-80)  (-80)  (-80)  (-80)  (-80)  (-80)  (-80)  (-80)  (-80)  (-80)  (-80)  (-80)  (-80)  (-80)  (-80)  (-80)  (-80)  (-80)  (-80)  (-80)  (-80)  (-80)  (-80)  (-80)
		 (-80)  (-80)  (-80)  (-80)  (-80)  (-80)  (-80)  (-80)  (-80)  (-80)  (-80)  (-80)  (-80)  (-80)  (-80)  (-80)  (-80)  (-80)  (-80)  (-80)  (-80)  (-80)  (-80)  (-80)  (-80)  (-80)  (-80)  (-80)  (-80)  (-80)  (-80)  (-80)  (-80)  (-80)  (-80)  (-80)  (-80)  (-80)
		 (-80)  (-80)  (-80)  (-80)  (-80)  (-80)  (-80)  (-80)  (-80)  (-80)  (-80)  (-80)  (-80)  (-80)  (-80)  (-80)  (-80)  (-80)  (-80)  (-80)  (-80)  (-80)  (-80)  (-80)  (-80)  (-80)  (-80)  (-80)  (-80)  (-80)  (-80)  (-80)  (-80)  (-80)  (-80)  (-80)  (-80)  (-80)
		 (-80)  (-80)  (-80)  (-80)  (-80)  (-80)  (-80)  (-80)  (-80)  (-80)  (-80)  (-80)  (-80)  (-80)  (-80)  (-80)  (-80)  (-80)  (-80)  (-80)  (-80)  (-80)  (-80)  (-80)  (-80)  (-80)  (-80)  (-80)  (-80)  (-80)  (-80)  (-80)  (-80)  (-80)  (-80)  (-80)  (-80)  (-80)
		 (-80)  (-80)  (-80)  (-80)  (-80)  (-80)  (-80)  (-80)  (-80)  (-80)  (-80)  (-80)  (-80)  (-80)  (-80)  (-80)  (-80)  (-80)  (-80)  (-80)  (-80)  (-80)  (-80)  (-80)  (-80)  (-80)  (-80)  (-80)  (-80)  (-80)  (-80)  (-80)  (-80)  (-80)  (-80)  (-80)  (-80)  (-80)
		 (-80)  (-80)  (-80)  (-80)  (-80)  (-80)  (-80)  (-80)  (-80)  (-80)  (-80)  (-80)  (-80)  (-80)  (-80)  (-80)  (-80)  (-80)  (-80)  (-80)  (-80)  (-80)  (-80)  (-80)  (-80)  (-80)  (-80)  (-80)  (-80)  (-80)  (-80)  (-80)  (-80)  (-80)  (-80)  (-80)  (-80)  (-80)
		 (-80)  (-80)  (-80)  (-80)  (-80)  (-80)  (-80)  (-80)  (-80)  (-80)  (-80)  (-80)  (-80)  (-80)  (-80)  (-80)  (-80)  (-80)  (-80)  (-80)  (-80)  (-80)  (-80)  (-80)  (-80)  (-80)  (-80)  (-80)  (-80)  (-80)  (-80)  (-80)  (-80)  (-80)  (-80)  (-80)  (-80)  (-80)
		 (-80)  (-80)  (-80)  (-80)  (-80)  (-80)  (-80)  (-80)  (-80)  (-80)  (-80)  (-80)  (-80)  (-80)  (-80)  (-80)  (-80)  (-80)  (-80)  (-80)  (-80)  (-80)  (-80)  (-80)  (-80)  (-80)  (-80)  (-80)  (-80)  (-80)  (-80)  (-80)  (-80)  (-80)  (-80)  (-80)  (-80)  (-80)
		 (-80)  (-80)  (-80)  (-80)  (-80)  (-80)  (-80)  (-80)  (-80)  (-80)  (-80)  (-80)  (-80)  (-80)  (-80)  (-80)  (-80)  (-80)  (-80)  (-80)  (-80)  (-80)  (-80)  (-80)  (-80)  (-80)  (-80)  (-80)  (-80)  (-80)  (-80)  (-80)  (-80)  (-80)  (-80)  (-80)  (-80)  (-80)
		 (-80)  (-80)  (-80)  (-80)  (-80)  (-80)  (-80)  (-80)  (-80)  (-80)  (-80)  (-80)  (-80)  (-80)  (-80)  (-80)  (-80)  (-80)  (-80)  (-80)  (-80)  (-80)  (-80)  (-80)  (-80)  (-80)  (-80)  (-80)  (-80)  (-80)  (-80)  (-80)  (-80)  (-80)  (-80)  (-80)  (-80)  (-80)
		 (-80)  (-80)  (-80)  (-80)  (-80)  (-80)  (-80)  (-80)  (-80)  (-80)  (-80)  (-80)  (-80)  (-80)  (-80)  (-80)  (-80)  (-80)  (-80)  (-80)  (-80)  (-80)  (-80)  (-80)  (-80)  (-80)  (-80)  (-80)  (-80)  (-80)  (-80)  (-80)  (-80)  (-80)  (-80)  (-80)  (-80)  (-80)
		 (-80)  (-80)  (-80)  (-80)  (-80)  (-80)  (-80)  (-80)  (-80)  (-80)  (-80)  (-80)  (-80)  (-80)  (-80)  (-80)  (-80)  (-80)  (-80)  (-80)  (-80)  (-80)  (-80)  (-80)  (-80)  (-80)  (-80)  (-80)  (-80)  (-80)  (-80)  (-80)  (-80)  (-80)  (-80)  (-80)  (-80)  (-80)
		 (-80)  (-80)  (-80)  (-80)  (-80)  (-80)  (-80)  (-80)  (-80)  (-80)  (-80)  (-80)  (-80)  (-80)  (-80)  (-80)  (-80)  (-80)  (-80)  (-80)  (-80)  (-80)  (-80)  (-80)  (-80)  (-80)  (-80)  (-80)  (-80)  (-80)  (-80)  (-80)  (-80)  (-80)  (-80)  (-80)  (-80)  (-80)
		 (-80)  (-80)  (-80)  (-80)  (-80)  (-80)  (-80)  (-80)  (-80)  (-80)  (-80)  (-80)  (-80)  (-80)  (-80)  (-80)  (-80)  (-80)  (-80)  (-80)  (-80)  (-80)  (-80)  (-80)  (-80)  (-80)  (-80)  (-80)  (-80)  (-80)  (-80)  (-80)  (-80)  (-80)  (-80)  (-80)  (-80)  (-80)
		 (-80)  (-80)  (-80)  (-80)  (-80)  (-80)  (-80)  (-80)  (-80)  (-80)  (-80)  (-80)  (-80)  (-80)  (-80)  (-80)  (-80)  (-80)  (-80)  (-80)  (-80)  (-80)  (-80)  (-80)  (-80)  (-80)  (-80)  (-80)  (-80)  (-80)  (-80)  (-80)  (-80)  (-80)  (-80)  (-80)  (-80)  (-80)
		 (-80)  (-80)  (-80)  (-80)  (-80)  (-80)  (-80)  (-80)  (-80)  (-80)  (-80)  (-80)  (-80)  (-80)  (-80)  (-80)  (-80)  (-80)  (-80)  (-80)  (-80)  (-80)  (-80)  (-80)  (-80)  (-80)  (-80)  (-80)  (-80)  (-80)  (-80)  (-80)  (-80)  (-80)  (-80)  (-80)  (-80)  (-80)
		 (-80)  (-80)  (-80)  (-80)  (-80)  (-80)  (-80)  (-80)  (-80)  (-80)  (-80)  (-80)  (-80)  (-80)  (-80)  (-80)  (-80)  (-80)  (-80)  (-80)  (-80)  (-80)  (-80)  (-80)  (-80)  (-80)  (-80)  (-80)  (-80)  (-80)  (-80)  (-80)  (-80)  (-80)  (-80)  (-80)  (-80)  (-80)
		 (-80)  (-80)  (-80)  (-80)  (-80)  (-80)  (-80)  (-80)  (-80)  (-80)  (-80)  (-80)  (-80)  (-80)  (-80)  (-80)  (-80)  (-80)  (-80)  (-80)  (-80)  (-80)  (-80)  (-80)  (-80)  (-80)  (-80)  (-80)  (-80)  (-80)  (-80)  (-80)  (-80)  (-80)  (-80)  (-80)  (-80)  (-80)
	>;


/********************************************************************************************************************************************************************************************************************************************************************************/
/* test limit for the pt7 testing */
/* including upper and lower bounds */
	pt7_hi_limits_row_02 = <38>;
	pt7_hi_limits_cols_02 = <38>;
	pt7_hi_limits_02 = <
		1700  1700  1700  1700  1700  1700  1700  1700  1700  1700  1700  1700  1700  1700  1700  1700  1700  1700  1700  1700  1700  1700  1700  1700  1700  1700  1700  1700  1700  1700  1700  1700  1700  1700  1700  1700  1700  1700
		1700  1700  1700  1700  1700  1700  1700  1700  1700  1700  1700  1700  1700  1700  1700  1700  1700  1700  1700  1700  1700  1700  1700  1700  1700  1700  1700  1700  1700  1700  1700  1700  1700  1700  1700  1700  1700  1700
		1700  1700  1700  1700  1700  1700  1700  1700  1700  1700  1700  1700  1700  1700  1700  1700  1700  1700  1700  1700  1700  1700  1700  1700  1700  1700  1700  1700  1700  1700  1700  1700  1700  1700  1700  1700  1700  1700
		1700  1700  1700  1700  1700  1700  1700  1700  1700  1700  1700  1700  1700  1700  1700  1700  1700  1700  1700  1700  1700  1700  1700  1700  1700  1700  1700  1700  1700  1700  1700  1700  1700  1700  1700  1700  1700  1700
		1700  1700  1700  1700  1700  1700  1700  1700  1700  1700  1700  1700  1700  1700  1700  1700  1700  1700  1700  1700  1700  1700  1700  1700  1700  1700  1700  1700  1700  1700  1700  1700  1700  1700  1700  1700  1700  1700
		1700  1700  1700  1700  1700  1700  1700  1700  1700  1700  1700  1700  1700  1700  1700  1700  1700  1700  1700  1700  1700  1700  1700  1700  1700  1700  1700  1700  1700  1700  1700  1700  1700  1700  1700  1700  1700  1700
		1700  1700  1700  1700  1700  1700  1700  1700  1700  1700  1700  1700  1700  1700  1700  1700  1700  1700  1700  1700  1700  1700  1700  1700  1700  1700  1700  1700  1700  1700  1700  1700  1700  1700  1700  1700  1700  1700
		1700  1700  1700  1700  1700  1700  1700  1700  1700  1700  1700  1700  1700  1700  1700  1700  1700  1700  1700  1700  1700  1700  1700  1700  1700  1700  1700  1700  1700  1700  1700  1700  1700  1700  1700  1700  1700  1700
		1700  1700  1700  1700  1700  1700  1700  1700  1700  1700  1700  1700  1700  1700  1700  1700  1700  1700  1700  1700  1700  1700  1700  1700  1700  1700  1700  1700  1700  1700  1700  1700  1700  1700  1700  1700  1700  1700
		1700  1700  1700  1700  1700  1700  1700  1700  1700  1700  1700  1700  1700  1700  1700  1700  1700  1700  1700  1700  1700  1700  1700  1700  1700  1700  1700  1700  1700  1700  1700  1700  1700  1700  1700  1700  1700  1700
		1700  1700  1700  1700  1700  1700  1700  1700  1700  1700  1700  1700  1700  1700  1700  1700  1700  1700  1700  1700  1700  1700  1700  1700  1700  1700  1700  1700  1700  1700  1700  1700  1700  1700  1700  1700  1700  1700
		1700  1700  1700  1700  1700  1700  1700  1700  1700  1700  1700  1700  1700  1700  1700  1700  1700  1700  1700  1700  1700  1700  1700  1700  1700  1700  1700  1700  1700  1700  1700  1700  1700  1700  1700  1700  1700  1700
		1700  1700  1700  1700  1700  1700  1700  1700  1700  1700  1700  1700  1700  1700  1700  1700  1700  1700  1700  1700  1700  1700  1700  1700  1700  1700  1700  1700  1700  1700  1700  1700  1700  1700  1700  1700  1700  1700
		1700  1700  1700  1700  1700  1700  1700  1700  1700  1700  1700  1700  1700  1700  1700  1700  1700  1700  1700  1700  1700  1700  1700  1700  1700  1700  1700  1700  1700  1700  1700  1700  1700  1700  1700  1700  1700  1700
		1700  1700  1700  1700  1700  1700  1700  1700  1700  1700  1700  1700  1700  1700  1700  1700  1700  1700  1700  1700  1700  1700  1700  1700  1700  1700  1700  1700  1700  1700  1700  1700  1700  1700  1700  1700  1700  1700
		1700  1700  1700  1700  1700  1700  1700  1700  1700  1700  1700  1700  1700  1700  1700  1700  1700  1700  1700  1700  1700  1700  1700  1700  1700  1700  1700  1700  1700  1700  1700  1700  1700  1700  1700  1700  1700  1700
		1700  1700  1700  1700  1700  1700  1700  1700  1700  1700  1700  1700  1700  1700  1700  1700  1700  1700  1700  1700  1700  1700  1700  1700  1700  1700  1700  1700  1700  1700  1700  1700  1700  1700  1700  1700  1700  1700
		1700  1700  1700  1700  1700  1700  1700  1700  1700  1700  1700  1700  1700  1700  1700  1700  1700  1700  1700  1700  1700  1700  1700  1700  1700  1700  1700  1700  1700  1700  1700  1700  1700  1700  1700  1700  1700  1700
		1700  1700  1700  1700  1700  1700  1700  1700  1700  1700  1700  1700  1700  1700  1700  1700  1700  1700  1700  1700  1700  1700  1700  1700  1700  1700  1700  1700  1700  1700  1700  1700  1700  1700  1700  1700  1700  1700
		1700  1700  1700  1700  1700  1700  1700  1700  1700  1700  1700  1700  1700  1700  1700  1700  1700  1700  1700  1700  1700  1700  1700  1700  1700  1700  1700  1700  1700  1700  1700  1700  1700  1700  1700  1700  1700  1700
		1700  1700  1700  1700  1700  1700  1700  1700  1700  1700  1700  1700  1700  1700  1700  1700  1700  1700  1700  1700  1700  1700  1700  1700  1700  1700  1700  1700  1700  1700  1700  1700  1700  1700  1700  1700  1700  1700
		1700  1700  1700  1700  1700  1700  1700  1700  1700  1700  1700  1700  1700  1700  1700  1700  1700  1700  1700  1700  1700  1700  1700  1700  1700  1700  1700  1700  1700  1700  1700  1700  1700  1700  1700  1700  1700  1700
		1700  1700  1700  1700  1700  1700  1700  1700  1700  1700  1700  1700  1700  1700  1700  1700  1700  1700  1700  1700  1700  1700  1700  1700  1700  1700  1700  1700  1700  1700  1700  1700  1700  1700  1700  1700  1700  1700
		1700  1700  1700  1700  1700  1700  1700  1700  1700  1700  1700  1700  1700  1700  1700  1700  1700  1700  1700  1700  1700  1700  1700  1700  1700  1700  1700  1700  1700  1700  1700  1700  1700  1700  1700  1700  1700  1700
		1700  1700  1700  1700  1700  1700  1700  1700  1700  1700  1700  1700  1700  1700  1700  1700  1700  1700  1700  1700  1700  1700  1700  1700  1700  1700  1700  1700  1700  1700  1700  1700  1700  1700  1700  1700  1700  1700
		1700  1700  1700  1700  1700  1700  1700  1700  1700  1700  1700  1700  1700  1700  1700  1700  1700  1700  1700  1700  1700  1700  1700  1700  1700  1700  1700  1700  1700  1700  1700  1700  1700  1700  1700  1700  1700  1700
		1700  1700  1700  1700  1700  1700  1700  1700  1700  1700  1700  1700  1700  1700  1700  1700  1700  1700  1700  1700  1700  1700  1700  1700  1700  1700  1700  1700  1700  1700  1700  1700  1700  1700  1700  1700  1700  1700
		1700  1700  1700  1700  1700  1700  1700  1700  1700  1700  1700  1700  1700  1700  1700  1700  1700  1700  1700  1700  1700  1700  1700  1700  1700  1700  1700  1700  1700  1700  1700  1700  1700  1700  1700  1700  1700  1700
		1700  1700  1700  1700  1700  1700  1700  1700  1700  1700  1700  1700  1700  1700  1700  1700  1700  1700  1700  1700  1700  1700  1700  1700  1700  1700  1700  1700  1700  1700  1700  1700  1700  1700  1700  1700  1700  1700
		1700  1700  1700  1700  1700  1700  1700  1700  1700  1700  1700  1700  1700  1700  1700  1700  1700  1700  1700  1700  1700  1700  1700  1700  1700  1700  1700  1700  1700  1700  1700  1700  1700  1700  1700  1700  1700  1700
		1700  1700  1700  1700  1700  1700  1700  1700  1700  1700  1700  1700  1700  1700  1700  1700  1700  1700  1700  1700  1700  1700  1700  1700  1700  1700  1700  1700  1700  1700  1700  1700  1700  1700  1700  1700  1700  1700
		1700  1700  1700  1700  1700  1700  1700  1700  20000 20000 1700  1700  1700  1700  1700  1700  1700  1700  1700  1700  1700  1700  1700  1700  1700  1700  1700  1700  1700  1700  1700  1700  1700  1700  1700  1700  1700  1700
		1700  1700  1700  1700  1700  1700  1700  1700  1700  1700  1700  1700  1700  1700  1700  1700  1700  1700  1700  1700  1700  1700  1700  1700  1700  1700  1700  1700  1700  1700  1700  1700  1700  1700  1700  1700  1700  1700
		1700  1700  1700  1700  1700  1700  1700  1700  1700  1700  1700  1700  1700  1700  1700  1700  1700  1700  1700  1700  1700  1700  1700  1700  1700  1700  1700  1700  1700  1700  1700  1700  1700  1700  1700  1700  1700  1700
		1700  1700  1700  1700  1700  1700  1700  1700  1700  1700  1700  1700  1700  1700  1700  1700  1700  1700  1700  1700  1700  1700  1700  1700  1700  1700  1700  1700  1700  1700  1700  1700  1700  1700  1700  1700  1700  1700
		1700  1700  1700  1700  1700  1700  1700  1700  1700  1700  1700  1700  1700  1700  1700  1700  1700  1700  1700  1700  1700  1700  1700  1700  1700  1700  1700  1700  1700  1700  1700  1700  1700  1700  1700  1700  1700  1700
		1700  1700  1700  1700  1700  1700  1700  1700  1700  1700  1700  1700  1700  1700  1700  1700  1700  1700  1700  1700  1700  1700  1700  1700  1700  1700  1700  1700  1700  1700  1700  1700  1700  1700  1700  1700  1700  1700
		1700  1700  1700  1700  1700  1700  1700  1700  1700  1700  1700  1700  1700  1700  1700  1700  1700  1700  1700  1700  1700  1700  1700  1700  1700  1700  1700  1700  1700  1700  1700  1700  1700  1700  1700  1700  1700  1700
	>;

	pt7_lo_limits_row_02 = <38>;
	pt7_lo_limits_cols_02 = <38>;
	pt7_lo_limits_02 = <
		300  300  300  300  300  300  300  300  300  300  300  300  300  300  300  300  300  300  300  300  300  300  300  300  300  300  300  300  300  300  300  300  300  300  300  300  300  300
		300  300  300  300  300  300  300  300  300  300  300  300  300  300  300  300  300  300  300  300  300  300  300  300  300  300  300  300  300  300  300  300  300  300  300  300  300  300
		300  300  300  300  300  300  300  300  300  300  300  300  300  300  300  300  300  300  300  300  300  300  300  300  300  300  300  300  300  300  300  300  300  300  300  300  300  300
		300  300  300  300  300  300  300  300  300  300  300  300  300  300  300  300  300  300  300  300  300  300  300  300  300  300  300  300  300  300  300  300  300  300  300  300  300  300
		300  300  300  300  300  300  300  300  300  300  300  300  300  300  300  300  300  300  300  300  300  300  300  300  300  300  300  300  300  300  300  300  300  300  300  300  300  300
		300  300  300  300  300  300  300  300  300  300  300  300  300  300  300  300  300  300  300  300  300  300  300  300  300  300  300  300  300  300  300  300  300  300  300  300  300  300
		300  300  300  300  300  300  300  300  300  300  300  300  300  300  300  300  300  300  300  300  300  300  300  300  300  300  300  300  300  300  300  300  300  300  300  300  300  300
		300  300  300  300  300  300  300  300  300  300  300  300  300  300  300  300  300  300  300  300  300  300  300  300  300  300  300  300  300  300  300  300  300  300  300  300  300  300
		300  300  300  300  300  300  300  300  300  300  300  300  300  300  300  300  300  300  300  300  300  300  300  300  300  300  300  300  300  300  300  300  300  300  300  300  300  300
		300  300  300  300  300  300  300  300  300  300  300  300  300  300  300  300  300  300  300  300  300  300  300  300  300  300  300  300  300  300  300  300  300  300  300  300  300  300
		300  300  300  300  300  300  300  300  300  300  300  300  300  300  300  300  300  300  300  300  300  300  300  300  300  300  300  300  300  300  300  300  300  300  300  300  300  300
		300  300  300  300  300  300  300  300  300  300  300  300  300  300  300  300  300  300  300  300  300  300  300  300  300  300  300  300  300  300  300  300  300  300  300  300  300  300
		300  300  300  300  300  300  300  300  300  300  300  300  300  300  300  300  300  300  300  300  300  300  300  300  300  300  300  300  300  300  300  300  300  300  300  300  300  300
		300  300  300  300  300  300  300  300  300  300  300  300  300  300  300  300  300  300  300  300  300  300  300  300  300  300  300  300  300  300  300  300  300  300  300  300  300  300
		300  300  300  300  300  300  300  300  300  300  300  300  300  300  300  300  300  300  300  300  300  300  300  300  300  300  300  300  300  300  300  300  300  300  300  300  300  300
		300  300  300  300  300  300  300  300  300  300  300  300  300  300  300  300  300  300  300  300  300  300  300  300  300  300  300  300  300  300  300  300  300  300  300  300  300  300
		300  300  300  300  300  300  300  300  300  300  300  300  300  300  300  300  300  300  300  300  300  300  300  300  300  300  300  300  300  300  300  300  300  300  300  300  300  300
		300  300  300  300  300  300  300  300  300  300  300  300  300  300  300  300  300  300  300  300  300  300  300  300  300  300  300  300  300  300  300  300  300  300  300  300  300  300
		300  300  300  300  300  300  300  300  300  300  300  300  300  300  300  300  300  300  300  300  300  300  300  300  300  300  300  300  300  300  300  300  300  300  300  300  300  300
		300  300  300  300  300  300  300  300  300  300  300  300  300  300  300  300  300  300  300  300  300  300  300  300  300  300  300  300  300  300  300  300  300  300  300  300  300  300
		300  300  300  300  300  300  300  300  300  300  300  300  300  300  300  300  300  300  300  300  300  300  300  300  300  300  300  300  300  300  300  300  300  300  300  300  300  300
		300  300  300  300  300  300  300  300  300  300  300  300  300  300  300  300  300  300  300  300  300  300  300  300  300  300  300  300  300  300  300  300  300  300  300  300  300  300
		300  300  300  300  300  300  300  300  300  300  300  300  300  300  300  300  300  300  300  300  300  300  300  300  300  300  300  300  300  300  300  300  300  300  300  300  300  300
		300  300  300  300  300  300  300  300  300  300  300  300  300  300  300  300  300  300  300  300  300  300  300  300  300  300  300  300  300  300  300  300  300  300  300  300  300  300
		300  300  300  300  300  300  300  300  300  300  300  300  300  300  300  300  300  300  300  300  300  300  300  300  300  300  300  300  300  300  300  300  300  300  300  300  300  300
		300  300  300  300  300  300  300  300  300  300  300  300  300  300  300  300  300  300  300  300  300  300  300  300  300  300  300  300  300  300  300  300  300  300  300  300  300  300
		300  300  300  300  300  300  300  300  300  300  300  300  300  300  300  300  300  300  300  300  300  300  300  300  300  300  300  300  300  300  300  300  300  300  300  300  300  300
		300  300  300  300  300  300  300  300  300  300  300  300  300  300  300  300  300  300  300  300  300  300  300  300  300  300  300  300  300  300  300  300  300  300  300  300  300  300
		300  300  300  300  300  300  300  300  300  300  300  300  300  300  300  300  300  300  300  300  300  300  300  300  300  300  300  300  300  300  300  300  300  300  300  300  300  300
		300  300  300  300  300  300  300  300  300  300  300  300  300  300  300  300  300  300  300  300  300  300  300  300  300  300  300  300  300  300  300  300  300  300  300  300  300  300
		300  300  300  300  300  300  300  300  300  300  300  300  300  300  300  300  300  300  300  300  300  300  300  300  300  300  300  300  300  300  300  300  300  300  300  300  300  300
		300  300  300  300  300  300  300  300  0    0    300  300  300  300  300  300  300  300  300  300  300  300  300  300  300  300  300  300  300  300  300  300  300  300  300  300  300  300
		300  300  300  300  300  300  300  300  300  300  300  300  300  300  300  300  300  300  300  300  300  300  300  300  300  300  300  300  300  300  300  300  300  300  300  300  300  300
		300  300  300  300  300  300  300  300  300  300  300  300  300  300  300  300  300  300  300  300  300  300  300  300  300  300  300  300  300  300  300  300  300  300  300  300  300  300
		300  300  300  300  300  300  300  300  300  300  300  300  300  300  300  300  300  300  300  300  300  300  300  300  300  300  300  300  300  300  300  300  300  300  300  300  300  300
		300  300  300  300  300  300  300  300  300  300  300  300  300  300  300  300  300  300  300  300  300  300  300  300  300  300  300  300  300  300  300  300  300  300  300  300  300  300
		300  300  300  300  300  300  300  300  300  300  300  300  300  300  300  300  300  300  300  300  300  300  300  300  300  300  300  300  300  300  300  300  300  300  300  300  300  300
		300  300  300  300  300  300  300  300  300  300  300  300  300  300  300  300  300  300  300  300  300  300  300  300  300  300  300  300  300  300  300  300  300  300  300  300  300  300
	>;

/* test limit for the pt11 testing */
/*  including upper and lower bounds */
	pt11_hi_limits_row_02 = <38>;
	pt11_hi_limits_cols_02 = <38>;
	pt11_hi_limits_02 = <
		 80  80  80  80  80  80  80  80  80  80  80  80  80  80  80  80  80  80  80  80  80  80  80  80  80  80  80  80  80  80  80  80  80  80  80  80  80  80
		 80  80  80  80  80  80  80  80  80  80  80  80  80  80  80  80  80  80  80  80  80  80  80  80  80  80  80  80  80  80  80  80  80  80  80  80  80  80
		 80  80  80  80  80  80  80  80  80  80  80  80  80  80  80  80  80  80  80  80  80  80  80  80  80  80  80  80  80  80  80  80  80  80  80  80  80  80
		 80  80  80  80  80  80  80  80  80  80  80  80  80  80  80  80  80  80  80  80  80  80  80  80  80  80  80  80  80  80  80  80  80  80  80  80  80  80
		 80  80  80  80  80  80  80  80  80  80  80  80  80  80  80  80  80  80  80  80  80  80  80  80  80  80  80  80  80  80  80  80  80  80  80  80  80  80
		 80  80  80  80  80  80  80  80  80  80  80  80  80  80  80  80  80  80  80  80  80  80  80  80  80  80  80  80  80  80  80  80  80  80  80  80  80  80
		 80  80  80  80  80  80  80  80  80  80  80  80  80  80  80  80  80  80  80  80  80  80  80  80  80  80  80  80  80  80  80  80  80  80  80  80  80  80
		 80  80  80  80  80  80  80  80  80  80  80  80  80  80  80  80  80  80  80  80  80  80  80  80  80  80  80  80  80  80  80  80  80  80  80  80  80  80
		 80  80  80  80  80  80  80  80  80  80  80  80  80  80  80  80  80  80  80  80  80  80  80  80  80  80  80  80  80  80  80  80  80  80  80  80  80  80
		 80  80  80  80  80  80  80  80  80  80  80  80  80  80  80  80  80  80  80  80  80  80  80  80  80  80  80  80  80  80  80  80  80  80  80  80  80  80
		 80  80  80  80  80  80  80  80  80  80  80  80  80  80  80  80  80  80  80  80  80  80  80  80  80  80  80  80  80  80  80  80  80  80  80  80  80  80
		 80  80  80  80  80  80  80  80  80  80  80  80  80  80  80  80  80  80  80  80  80  80  80  80  80  80  80  80  80  80  80  80  80  80  80  80  80  80
		 80  80  80  80  80  80  80  80  80  80  80  80  80  80  80  80  80  80  80  80  80  80  80  80  80  80  80  80  80  80  80  80  80  80  80  80  80  80
		 80  80  80  80  80  80  80  80  80  80  80  80  80  80  80  80  80  80  80  80  80  80  80  80  80  80  80  80  80  80  80  80  80  80  80  80  80  80
		 80  80  80  80  80  80  80  80  80  80  80  80  80  80  80  80  80  80  80  80  80  80  80  80  80  80  80  80  80  80  80  80  80  80  80  80  80  80
		 80  80  80  80  80  80  80  80  80  80  80  80  80  80  80  80  80  80  80  80  80  80  80  80  80  80  80  80  80  80  80  80  80  80  80  80  80  80
		 80  80  80  80  80  80  80  80  80  80  80  80  80  80  80  80  80  80  80  80  80  80  80  80  80  80  80  80  80  80  80  80  80  80  80  80  80  80
		 80  80  80  80  80  80  80  80  80  80  80  80  80  80  80  80  80  80  80  80  80  80  80  80  80  80  80  80  80  80  80  80  80  80  80  80  80  80
		 80  80  80  80  80  80  80  80  80  80  80  80  80  80  80  80  80  80  80  80  80  80  80  80  80  80  80  80  80  80  80  80  80  80  80  80  80  80
		 80  80  80  80  80  80  80  80  80  80  80  80  80  80  80  80  80  80  80  80  80  80  80  80  80  80  80  80  80  80  80  80  80  80  80  80  80  80
		 80  80  80  80  80  80  80  80  80  80  80  80  80  80  80  80  80  80  80  80  80  80  80  80  80  80  80  80  80  80  80  80  80  80  80  80  80  80
		 80  80  80  80  80  80  80  80  80  80  80  80  80  80  80  80  80  80  80  80  80  80  80  80  80  80  80  80  80  80  80  80  80  80  80  80  80  80
		 80  80  80  80  80  80  80  80  80  80  80  80  80  80  80  80  80  80  80  80  80  80  80  80  80  80  80  80  80  80  80  80  80  80  80  80  80  80
		 80  80  80  80  80  80  80  80  80  80  80  80  80  80  80  80  80  80  80  80  80  80  80  80  80  80  80  80  80  80  80  80  80  80  80  80  80  80
		 80  80  80  80  80  80  80  80  80  80  80  80  80  80  80  80  80  80  80  80  80  80  80  80  80  80  80  80  80  80  80  80  80  80  80  80  80  80
		 80  80  80  80  80  80  80  80  80  80  80  80  80  80  80  80  80  80  80  80  80  80  80  80  80  80  80  80  80  80  80  80  80  80  80  80  80  80
		 80  80  80  80  80  80  80  80  80  80  80  80  80  80  80  80  80  80  80  80  80  80  80  80  80  80  80  80  80  80  80  80  80  80  80  80  80  80
		 80  80  80  80  80  80  80  80  80  80  80  80  80  80  80  80  80  80  80  80  80  80  80  80  80  80  80  80  80  80  80  80  80  80  80  80  80  80
		 80  80  80  80  80  80  80  80  80  80  80  80  80  80  80  80  80  80  80  80  80  80  80  80  80  80  80  80  80  80  80  80  80  80  80  80  80  80
		 80  80  80  80  80  80  80  80  80  80  80  80  80  80  80  80  80  80  80  80  80  80  80  80  80  80  80  80  80  80  80  80  80  80  80  80  80  80
		 80  80  80  80  80  80  80  80  80  80  80  80  80  80  80  80  80  80  80  80  80  80  80  80  80  80  80  80  80  80  80  80  80  80  80  80  80  80
		 80  80  80  80  80  80  80  80  80  80  80  80  80  80  80  80  80  80  80  80  80  80  80  80  80  80  80  80  80  80  80  80  80  80  80  80  80  80
		 80  80  80  80  80  80  80  80  80  80  80  80  80  80  80  80  80  80  80  80  80  80  80  80  80  80  80  80  80  80  80  80  80  80  80  80  80  80
		 80  80  80  80  80  80  80  80  80  80  80  80  80  80  80  80  80  80  80  80  80  80  80  80  80  80  80  80  80  80  80  80  80  80  80  80  80  80
		 80  80  80  80  80  80  80  80  80  80  80  80  80  80  80  80  80  80  80  80  80  80  80  80  80  80  80  80  80  80  80  80  80  80  80  80  80  80
		 80  80  80  80  80  80  80  80  80  80  80  80  80  80  80  80  80  80  80  80  80  80  80  80  80  80  80  80  80  80  80  80  80  80  80  80  80  80
		 80  80  80  80  80  80  80  80  80  80  80  80  80  80  80  80  80  80  80  80  80  80  80  80  80  80  80  80  80  80  80  80  80  80  80  80  80  80
		 80  80  80  80  80  80  80  80  80  80  80  80  80  80  80  80  80  80  80  80  80  80  80  80  80  80  80  80  80  80  80  80  80  80  80  80  80  80
	>;

	pt11_lo_limits_row_02 = <38>;
	pt11_lo_limits_cols_02 = <38>;
	pt11_lo_limits_02 = <
		 (-80)  (-80)  (-80)  (-80)  (-80)  (-80)  (-80)  (-80)  (-80)  (-80)  (-80)  (-80)  (-80)  (-80)  (-80)  (-80)  (-80)  (-80)  (-80)  (-80)  (-80)  (-80)  (-80)  (-80)  (-80)  (-80)  (-80)  (-80)  (-80)  (-80)  (-80)  (-80)  (-80)  (-80)  (-80)  (-80)  (-80)  (-80)
		 (-80)  (-80)  (-80)  (-80)  (-80)  (-80)  (-80)  (-80)  (-80)  (-80)  (-80)  (-80)  (-80)  (-80)  (-80)  (-80)  (-80)  (-80)  (-80)  (-80)  (-80)  (-80)  (-80)  (-80)  (-80)  (-80)  (-80)  (-80)  (-80)  (-80)  (-80)  (-80)  (-80)  (-80)  (-80)  (-80)  (-80)  (-80)
		 (-80)  (-80)  (-80)  (-80)  (-80)  (-80)  (-80)  (-80)  (-80)  (-80)  (-80)  (-80)  (-80)  (-80)  (-80)  (-80)  (-80)  (-80)  (-80)  (-80)  (-80)  (-80)  (-80)  (-80)  (-80)  (-80)  (-80)  (-80)  (-80)  (-80)  (-80)  (-80)  (-80)  (-80)  (-80)  (-80)  (-80)  (-80)
		 (-80)  (-80)  (-80)  (-80)  (-80)  (-80)  (-80)  (-80)  (-80)  (-80)  (-80)  (-80)  (-80)  (-80)  (-80)  (-80)  (-80)  (-80)  (-80)  (-80)  (-80)  (-80)  (-80)  (-80)  (-80)  (-80)  (-80)  (-80)  (-80)  (-80)  (-80)  (-80)  (-80)  (-80)  (-80)  (-80)  (-80)  (-80)
		 (-80)  (-80)  (-80)  (-80)  (-80)  (-80)  (-80)  (-80)  (-80)  (-80)  (-80)  (-80)  (-80)  (-80)  (-80)  (-80)  (-80)  (-80)  (-80)  (-80)  (-80)  (-80)  (-80)  (-80)  (-80)  (-80)  (-80)  (-80)  (-80)  (-80)  (-80)  (-80)  (-80)  (-80)  (-80)  (-80)  (-80)  (-80)
		 (-80)  (-80)  (-80)  (-80)  (-80)  (-80)  (-80)  (-80)  (-80)  (-80)  (-80)  (-80)  (-80)  (-80)  (-80)  (-80)  (-80)  (-80)  (-80)  (-80)  (-80)  (-80)  (-80)  (-80)  (-80)  (-80)  (-80)  (-80)  (-80)  (-80)  (-80)  (-80)  (-80)  (-80)  (-80)  (-80)  (-80)  (-80)
		 (-80)  (-80)  (-80)  (-80)  (-80)  (-80)  (-80)  (-80)  (-80)  (-80)  (-80)  (-80)  (-80)  (-80)  (-80)  (-80)  (-80)  (-80)  (-80)  (-80)  (-80)  (-80)  (-80)  (-80)  (-80)  (-80)  (-80)  (-80)  (-80)  (-80)  (-80)  (-80)  (-80)  (-80)  (-80)  (-80)  (-80)  (-80)
		 (-80)  (-80)  (-80)  (-80)  (-80)  (-80)  (-80)  (-80)  (-80)  (-80)  (-80)  (-80)  (-80)  (-80)  (-80)  (-80)  (-80)  (-80)  (-80)  (-80)  (-80)  (-80)  (-80)  (-80)  (-80)  (-80)  (-80)  (-80)  (-80)  (-80)  (-80)  (-80)  (-80)  (-80)  (-80)  (-80)  (-80)  (-80)
		 (-80)  (-80)  (-80)  (-80)  (-80)  (-80)  (-80)  (-80)  (-80)  (-80)  (-80)  (-80)  (-80)  (-80)  (-80)  (-80)  (-80)  (-80)  (-80)  (-80)  (-80)  (-80)  (-80)  (-80)  (-80)  (-80)  (-80)  (-80)  (-80)  (-80)  (-80)  (-80)  (-80)  (-80)  (-80)  (-80)  (-80)  (-80)
		 (-80)  (-80)  (-80)  (-80)  (-80)  (-80)  (-80)  (-80)  (-80)  (-80)  (-80)  (-80)  (-80)  (-80)  (-80)  (-80)  (-80)  (-80)  (-80)  (-80)  (-80)  (-80)  (-80)  (-80)  (-80)  (-80)  (-80)  (-80)  (-80)  (-80)  (-80)  (-80)  (-80)  (-80)  (-80)  (-80)  (-80)  (-80)
		 (-80)  (-80)  (-80)  (-80)  (-80)  (-80)  (-80)  (-80)  (-80)  (-80)  (-80)  (-80)  (-80)  (-80)  (-80)  (-80)  (-80)  (-80)  (-80)  (-80)  (-80)  (-80)  (-80)  (-80)  (-80)  (-80)  (-80)  (-80)  (-80)  (-80)  (-80)  (-80)  (-80)  (-80)  (-80)  (-80)  (-80)  (-80)
		 (-80)  (-80)  (-80)  (-80)  (-80)  (-80)  (-80)  (-80)  (-80)  (-80)  (-80)  (-80)  (-80)  (-80)  (-80)  (-80)  (-80)  (-80)  (-80)  (-80)  (-80)  (-80)  (-80)  (-80)  (-80)  (-80)  (-80)  (-80)  (-80)  (-80)  (-80)  (-80)  (-80)  (-80)  (-80)  (-80)  (-80)  (-80)
		 (-80)  (-80)  (-80)  (-80)  (-80)  (-80)  (-80)  (-80)  (-80)  (-80)  (-80)  (-80)  (-80)  (-80)  (-80)  (-80)  (-80)  (-80)  (-80)  (-80)  (-80)  (-80)  (-80)  (-80)  (-80)  (-80)  (-80)  (-80)  (-80)  (-80)  (-80)  (-80)  (-80)  (-80)  (-80)  (-80)  (-80)  (-80)
		 (-80)  (-80)  (-80)  (-80)  (-80)  (-80)  (-80)  (-80)  (-80)  (-80)  (-80)  (-80)  (-80)  (-80)  (-80)  (-80)  (-80)  (-80)  (-80)  (-80)  (-80)  (-80)  (-80)  (-80)  (-80)  (-80)  (-80)  (-80)  (-80)  (-80)  (-80)  (-80)  (-80)  (-80)  (-80)  (-80)  (-80)  (-80)
		 (-80)  (-80)  (-80)  (-80)  (-80)  (-80)  (-80)  (-80)  (-80)  (-80)  (-80)  (-80)  (-80)  (-80)  (-80)  (-80)  (-80)  (-80)  (-80)  (-80)  (-80)  (-80)  (-80)  (-80)  (-80)  (-80)  (-80)  (-80)  (-80)  (-80)  (-80)  (-80)  (-80)  (-80)  (-80)  (-80)  (-80)  (-80)
		 (-80)  (-80)  (-80)  (-80)  (-80)  (-80)  (-80)  (-80)  (-80)  (-80)  (-80)  (-80)  (-80)  (-80)  (-80)  (-80)  (-80)  (-80)  (-80)  (-80)  (-80)  (-80)  (-80)  (-80)  (-80)  (-80)  (-80)  (-80)  (-80)  (-80)  (-80)  (-80)  (-80)  (-80)  (-80)  (-80)  (-80)  (-80)
		 (-80)  (-80)  (-80)  (-80)  (-80)  (-80)  (-80)  (-80)  (-80)  (-80)  (-80)  (-80)  (-80)  (-80)  (-80)  (-80)  (-80)  (-80)  (-80)  (-80)  (-80)  (-80)  (-80)  (-80)  (-80)  (-80)  (-80)  (-80)  (-80)  (-80)  (-80)  (-80)  (-80)  (-80)  (-80)  (-80)  (-80)  (-80)
		 (-80)  (-80)  (-80)  (-80)  (-80)  (-80)  (-80)  (-80)  (-80)  (-80)  (-80)  (-80)  (-80)  (-80)  (-80)  (-80)  (-80)  (-80)  (-80)  (-80)  (-80)  (-80)  (-80)  (-80)  (-80)  (-80)  (-80)  (-80)  (-80)  (-80)  (-80)  (-80)  (-80)  (-80)  (-80)  (-80)  (-80)  (-80)
		 (-80)  (-80)  (-80)  (-80)  (-80)  (-80)  (-80)  (-80)  (-80)  (-80)  (-80)  (-80)  (-80)  (-80)  (-80)  (-80)  (-80)  (-80)  (-80)  (-80)  (-80)  (-80)  (-80)  (-80)  (-80)  (-80)  (-80)  (-80)  (-80)  (-80)  (-80)  (-80)  (-80)  (-80)  (-80)  (-80)  (-80)  (-80)
		 (-80)  (-80)  (-80)  (-80)  (-80)  (-80)  (-80)  (-80)  (-80)  (-80)  (-80)  (-80)  (-80)  (-80)  (-80)  (-80)  (-80)  (-80)  (-80)  (-80)  (-80)  (-80)  (-80)  (-80)  (-80)  (-80)  (-80)  (-80)  (-80)  (-80)  (-80)  (-80)  (-80)  (-80)  (-80)  (-80)  (-80)  (-80)
		 (-80)  (-80)  (-80)  (-80)  (-80)  (-80)  (-80)  (-80)  (-80)  (-80)  (-80)  (-80)  (-80)  (-80)  (-80)  (-80)  (-80)  (-80)  (-80)  (-80)  (-80)  (-80)  (-80)  (-80)  (-80)  (-80)  (-80)  (-80)  (-80)  (-80)  (-80)  (-80)  (-80)  (-80)  (-80)  (-80)  (-80)  (-80)
		 (-80)  (-80)  (-80)  (-80)  (-80)  (-80)  (-80)  (-80)  (-80)  (-80)  (-80)  (-80)  (-80)  (-80)  (-80)  (-80)  (-80)  (-80)  (-80)  (-80)  (-80)  (-80)  (-80)  (-80)  (-80)  (-80)  (-80)  (-80)  (-80)  (-80)  (-80)  (-80)  (-80)  (-80)  (-80)  (-80)  (-80)  (-80)
		 (-80)  (-80)  (-80)  (-80)  (-80)  (-80)  (-80)  (-80)  (-80)  (-80)  (-80)  (-80)  (-80)  (-80)  (-80)  (-80)  (-80)  (-80)  (-80)  (-80)  (-80)  (-80)  (-80)  (-80)  (-80)  (-80)  (-80)  (-80)  (-80)  (-80)  (-80)  (-80)  (-80)  (-80)  (-80)  (-80)  (-80)  (-80)
		 (-80)  (-80)  (-80)  (-80)  (-80)  (-80)  (-80)  (-80)  (-80)  (-80)  (-80)  (-80)  (-80)  (-80)  (-80)  (-80)  (-80)  (-80)  (-80)  (-80)  (-80)  (-80)  (-80)  (-80)  (-80)  (-80)  (-80)  (-80)  (-80)  (-80)  (-80)  (-80)  (-80)  (-80)  (-80)  (-80)  (-80)  (-80)
		 (-80)  (-80)  (-80)  (-80)  (-80)  (-80)  (-80)  (-80)  (-80)  (-80)  (-80)  (-80)  (-80)  (-80)  (-80)  (-80)  (-80)  (-80)  (-80)  (-80)  (-80)  (-80)  (-80)  (-80)  (-80)  (-80)  (-80)  (-80)  (-80)  (-80)  (-80)  (-80)  (-80)  (-80)  (-80)  (-80)  (-80)  (-80)
		 (-80)  (-80)  (-80)  (-80)  (-80)  (-80)  (-80)  (-80)  (-80)  (-80)  (-80)  (-80)  (-80)  (-80)  (-80)  (-80)  (-80)  (-80)  (-80)  (-80)  (-80)  (-80)  (-80)  (-80)  (-80)  (-80)  (-80)  (-80)  (-80)  (-80)  (-80)  (-80)  (-80)  (-80)  (-80)  (-80)  (-80)  (-80)
		 (-80)  (-80)  (-80)  (-80)  (-80)  (-80)  (-80)  (-80)  (-80)  (-80)  (-80)  (-80)  (-80)  (-80)  (-80)  (-80)  (-80)  (-80)  (-80)  (-80)  (-80)  (-80)  (-80)  (-80)  (-80)  (-80)  (-80)  (-80)  (-80)  (-80)  (-80)  (-80)  (-80)  (-80)  (-80)  (-80)  (-80)  (-80)
		 (-80)  (-80)  (-80)  (-80)  (-80)  (-80)  (-80)  (-80)  (-80)  (-80)  (-80)  (-80)  (-80)  (-80)  (-80)  (-80)  (-80)  (-80)  (-80)  (-80)  (-80)  (-80)  (-80)  (-80)  (-80)  (-80)  (-80)  (-80)  (-80)  (-80)  (-80)  (-80)  (-80)  (-80)  (-80)  (-80)  (-80)  (-80)
		 (-80)  (-80)  (-80)  (-80)  (-80)  (-80)  (-80)  (-80)  (-80)  (-80)  (-80)  (-80)  (-80)  (-80)  (-80)  (-80)  (-80)  (-80)  (-80)  (-80)  (-80)  (-80)  (-80)  (-80)  (-80)  (-80)  (-80)  (-80)  (-80)  (-80)  (-80)  (-80)  (-80)  (-80)  (-80)  (-80)  (-80)  (-80)
		 (-80)  (-80)  (-80)  (-80)  (-80)  (-80)  (-80)  (-80)  (-80)  (-80)  (-80)  (-80)  (-80)  (-80)  (-80)  (-80)  (-80)  (-80)  (-80)  (-80)  (-80)  (-80)  (-80)  (-80)  (-80)  (-80)  (-80)  (-80)  (-80)  (-80)  (-80)  (-80)  (-80)  (-80)  (-80)  (-80)  (-80)  (-80)
		 (-80)  (-80)  (-80)  (-80)  (-80)  (-80)  (-80)  (-80)  (-80)  (-80)  (-80)  (-80)  (-80)  (-80)  (-80)  (-80)  (-80)  (-80)  (-80)  (-80)  (-80)  (-80)  (-80)  (-80)  (-80)  (-80)  (-80)  (-80)  (-80)  (-80)  (-80)  (-80)  (-80)  (-80)  (-80)  (-80)  (-80)  (-80)
		 (-80)  (-80)  (-80)  (-80)  (-80)  (-80)  (-80)  (-80)  (-80)  (-80)  (-80)  (-80)  (-80)  (-80)  (-80)  (-80)  (-80)  (-80)  (-80)  (-80)  (-80)  (-80)  (-80)  (-80)  (-80)  (-80)  (-80)  (-80)  (-80)  (-80)  (-80)  (-80)  (-80)  (-80)  (-80)  (-80)  (-80)  (-80)
		 (-80)  (-80)  (-80)  (-80)  (-80)  (-80)  (-80)  (-80)  (-80)  (-80)  (-80)  (-80)  (-80)  (-80)  (-80)  (-80)  (-80)  (-80)  (-80)  (-80)  (-80)  (-80)  (-80)  (-80)  (-80)  (-80)  (-80)  (-80)  (-80)  (-80)  (-80)  (-80)  (-80)  (-80)  (-80)  (-80)  (-80)  (-80)
		 (-80)  (-80)  (-80)  (-80)  (-80)  (-80)  (-80)  (-80)  (-80)  (-80)  (-80)  (-80)  (-80)  (-80)  (-80)  (-80)  (-80)  (-80)  (-80)  (-80)  (-80)  (-80)  (-80)  (-80)  (-80)  (-80)  (-80)  (-80)  (-80)  (-80)  (-80)  (-80)  (-80)  (-80)  (-80)  (-80)  (-80)  (-80)
		 (-80)  (-80)  (-80)  (-80)  (-80)  (-80)  (-80)  (-80)  (-80)  (-80)  (-80)  (-80)  (-80)  (-80)  (-80)  (-80)  (-80)  (-80)  (-80)  (-80)  (-80)  (-80)  (-80)  (-80)  (-80)  (-80)  (-80)  (-80)  (-80)  (-80)  (-80)  (-80)  (-80)  (-80)  (-80)  (-80)  (-80)  (-80)
		 (-80)  (-80)  (-80)  (-80)  (-80)  (-80)  (-80)  (-80)  (-80)  (-80)  (-80)  (-80)  (-80)  (-80)  (-80)  (-80)  (-80)  (-80)  (-80)  (-80)  (-80)  (-80)  (-80)  (-80)  (-80)  (-80)  (-80)  (-80)  (-80)  (-80)  (-80)  (-80)  (-80)  (-80)  (-80)  (-80)  (-80)  (-80)
		 (-80)  (-80)  (-80)  (-80)  (-80)  (-80)  (-80)  (-80)  (-80)  (-80)  (-80)  (-80)  (-80)  (-80)  (-80)  (-80)  (-80)  (-80)  (-80)  (-80)  (-80)  (-80)  (-80)  (-80)  (-80)  (-80)  (-80)  (-80)  (-80)  (-80)  (-80)  (-80)  (-80)  (-80)  (-80)  (-80)  (-80)  (-80)
		 (-80)  (-80)  (-80)  (-80)  (-80)  (-80)  (-80)  (-80)  (-80)  (-80)  (-80)  (-80)  (-80)  (-80)  (-80)  (-80)  (-80)  (-80)  (-80)  (-80)  (-80)  (-80)  (-80)  (-80)  (-80)  (-80)  (-80)  (-80)  (-80)  (-80)  (-80)  (-80)  (-80)  (-80)  (-80)  (-80)  (-80)  (-80)
	>;

/********************************************************************************************************************************************************************************************************************************************************************************/
/* test limit for the pt7 testing */
/* including upper and lower bounds */
	pt7_hi_limits_row_03 = <38>;
	pt7_hi_limits_cols_03 = <38>;
	pt7_hi_limits_03 = <
		1700  1700  1700  1700  1700  1700  1700  1700  1700  1700  1700  1700  1700  1700  1700  1700  1700  1700  1700  1700  1700  1700  1700  1700  1700  1700  1700  1700  1700  1700  1700  1700  1700  1700  1700  1700  1700  1700
		1700  1700  1700  1700  1700  1700  1700  1700  1700  1700  1700  1700  1700  1700  1700  1700  1700  1700  1700  1700  1700  1700  1700  1700  1700  1700  1700  1700  1700  1700  1700  1700  1700  1700  1700  1700  1700  1700
		1700  1700  1700  1700  1700  1700  1700  1700  1700  1700  1700  1700  1700  1700  1700  1700  1700  1700  1700  1700  1700  1700  1700  1700  1700  1700  1700  1700  1700  1700  1700  1700  1700  1700  1700  1700  1700  1700
		1700  1700  1700  1700  1700  1700  1700  1700  1700  1700  1700  1700  1700  1700  1700  1700  1700  1700  1700  1700  1700  1700  1700  1700  1700  1700  1700  1700  1700  1700  1700  1700  1700  1700  1700  1700  1700  1700
		1700  1700  1700  1700  1700  1700  1700  1700  1700  1700  1700  1700  1700  1700  1700  1700  1700  1700  1700  1700  1700  1700  1700  1700  1700  1700  1700  1700  1700  1700  1700  1700  1700  1700  1700  1700  1700  1700
		1700  1700  1700  1700  1700  1700  1700  1700  1700  1700  1700  1700  1700  1700  1700  1700  1700  1700  1700  1700  1700  1700  1700  1700  1700  1700  1700  1700  1700  1700  1700  1700  1700  1700  1700  1700  1700  1700
		1700  1700  1700  1700  1700  1700  1700  1700  1700  1700  1700  1700  1700  1700  1700  1700  1700  1700  1700  1700  1700  1700  1700  1700  1700  1700  1700  1700  1700  1700  1700  1700  1700  1700  1700  1700  1700  1700
		1700  1700  1700  1700  1700  1700  1700  1700  1700  1700  1700  1700  1700  1700  1700  1700  1700  1700  1700  1700  1700  1700  1700  1700  1700  1700  1700  1700  1700  1700  1700  1700  1700  1700  1700  1700  1700  1700
		1700  1700  1700  1700  1700  1700  1700  1700  1700  1700  1700  1700  1700  1700  1700  1700  1700  1700  1700  1700  1700  1700  1700  1700  1700  1700  1700  1700  1700  1700  1700  1700  1700  1700  1700  1700  1700  1700
		1700  1700  1700  1700  1700  1700  1700  1700  1700  1700  1700  1700  1700  1700  1700  1700  1700  1700  1700  1700  1700  1700  1700  1700  1700  1700  1700  1700  1700  1700  1700  1700  1700  1700  1700  1700  1700  1700
		1700  1700  1700  1700  1700  1700  1700  1700  1700  1700  1700  1700  1700  1700  1700  1700  1700  1700  1700  1700  1700  1700  1700  1700  1700  1700  1700  1700  1700  1700  1700  1700  1700  1700  1700  1700  1700  1700
		1700  1700  1700  1700  1700  1700  1700  1700  1700  1700  1700  1700  1700  1700  1700  1700  1700  1700  1700  1700  1700  1700  1700  1700  1700  1700  1700  1700  1700  1700  1700  1700  1700  1700  1700  1700  1700  1700
		1700  1700  1700  1700  1700  1700  1700  1700  1700  1700  1700  1700  1700  1700  1700  1700  1700  1700  1700  1700  1700  1700  1700  1700  1700  1700  1700  1700  1700  1700  1700  1700  1700  1700  1700  1700  1700  1700
		1700  1700  1700  1700  1700  1700  1700  1700  1700  1700  1700  1700  1700  1700  1700  1700  1700  1700  1700  1700  1700  1700  1700  1700  1700  1700  1700  1700  1700  1700  1700  1700  1700  1700  1700  1700  1700  1700
		1700  1700  1700  1700  1700  1700  1700  1700  1700  1700  1700  1700  1700  1700  1700  1700  1700  1700  1700  1700  1700  1700  1700  1700  1700  1700  1700  1700  1700  1700  1700  1700  1700  1700  1700  1700  1700  1700
		1700  1700  1700  1700  1700  1700  1700  1700  1700  1700  1700  1700  1700  1700  1700  1700  1700  1700  1700  1700  1700  1700  1700  1700  1700  1700  1700  1700  1700  1700  1700  1700  1700  1700  1700  1700  1700  1700
		1700  1700  1700  1700  1700  1700  1700  1700  1700  1700  1700  1700  1700  1700  1700  1700  1700  1700  1700  1700  1700  1700  1700  1700  1700  1700  1700  1700  1700  1700  1700  1700  1700  1700  1700  1700  1700  1700
		1700  1700  1700  1700  1700  1700  1700  1700  1700  1700  1700  1700  1700  1700  1700  1700  1700  1700  1700  1700  1700  1700  1700  1700  1700  1700  1700  1700  1700  1700  1700  1700  1700  1700  1700  1700  1700  1700
		1700  1700  1700  1700  1700  1700  1700  1700  1700  1700  1700  1700  1700  1700  1700  1700  1700  1700  1700  1700  1700  1700  1700  1700  1700  1700  1700  1700  1700  1700  1700  1700  1700  1700  1700  1700  1700  1700
		1700  1700  1700  1700  1700  1700  1700  1700  1700  1700  1700  1700  1700  1700  1700  1700  1700  1700  1700  1700  1700  1700  1700  1700  1700  1700  1700  1700  1700  1700  1700  1700  1700  1700  1700  1700  1700  1700
		1700  1700  1700  1700  1700  1700  1700  1700  1700  1700  1700  1700  1700  1700  1700  1700  1700  1700  1700  1700  1700  1700  1700  1700  1700  1700  1700  1700  1700  1700  1700  1700  1700  1700  1700  1700  1700  1700
		1700  1700  1700  1700  1700  1700  1700  1700  1700  1700  1700  1700  1700  1700  1700  1700  1700  1700  1700  1700  1700  1700  1700  1700  1700  1700  1700  1700  1700  1700  1700  1700  1700  1700  1700  1700  1700  1700
		1700  1700  1700  1700  1700  1700  1700  1700  1700  1700  1700  1700  1700  1700  1700  1700  1700  1700  1700  1700  1700  1700  1700  1700  1700  1700  1700  1700  1700  1700  1700  1700  1700  1700  1700  1700  1700  1700
		1700  1700  1700  1700  1700  1700  1700  1700  1700  1700  1700  1700  1700  1700  1700  1700  1700  1700  1700  1700  1700  1700  1700  1700  1700  1700  1700  1700  1700  1700  1700  1700  1700  1700  1700  1700  1700  1700
		1700  1700  1700  1700  1700  1700  1700  1700  1700  1700  1700  1700  1700  1700  1700  1700  1700  1700  1700  1700  1700  1700  1700  1700  1700  1700  1700  1700  1700  1700  1700  1700  1700  1700  1700  1700  1700  1700
		1700  1700  1700  1700  1700  1700  1700  1700  1700  1700  1700  1700  1700  1700  1700  1700  1700  1700  1700  1700  1700  1700  1700  1700  1700  1700  1700  1700  1700  1700  1700  1700  1700  1700  1700  1700  1700  1700
		1700  1700  1700  1700  1700  1700  1700  1700  1700  1700  1700  1700  1700  1700  1700  1700  1700  1700  1700  1700  1700  1700  1700  1700  1700  1700  1700  1700  1700  1700  1700  1700  1700  1700  1700  1700  1700  1700
		1700  1700  1700  1700  1700  1700  1700  1700  1700  1700  1700  1700  1700  1700  1700  1700  1700  1700  1700  1700  1700  1700  1700  1700  1700  1700  1700  1700  1700  1700  1700  1700  1700  1700  1700  1700  1700  1700
		1700  1700  1700  1700  1700  1700  1700  1700  1700  1700  1700  1700  1700  1700  1700  1700  1700  1700  1700  1700  1700  1700  1700  1700  1700  1700  1700  1700  1700  1700  1700  1700  1700  1700  1700  1700  1700  1700
		1700  1700  1700  1700  1700  1700  1700  1700  1700  1700  1700  1700  1700  1700  1700  1700  1700  1700  1700  1700  1700  1700  1700  1700  1700  1700  1700  1700  1700  1700  1700  1700  1700  1700  1700  1700  1700  1700
		1700  1700  1700  1700  1700  1700  1700  1700  1700  1700  1700  1700  1700  1700  1700  1700  1700  1700  1700  1700  1700  1700  1700  1700  1700  1700  1700  1700  1700  1700  1700  1700  1700  1700  1700  1700  1700  1700
		1700  1700  1700  1700  1700  1700  1700  1700  20000 20000 1700  1700  1700  1700  1700  1700  1700  1700  1700  1700  1700  1700  1700  1700  1700  1700  1700  1700  1700  1700  1700  1700  1700  1700  1700  1700  1700  1700
		1700  1700  1700  1700  1700  1700  1700  1700  1700  1700  1700  1700  1700  1700  1700  1700  1700  1700  1700  1700  1700  1700  1700  1700  1700  1700  1700  1700  1700  1700  1700  1700  1700  1700  1700  1700  1700  1700
		1700  1700  1700  1700  1700  1700  1700  1700  1700  1700  1700  1700  1700  1700  1700  1700  1700  1700  1700  1700  1700  1700  1700  1700  1700  1700  1700  1700  1700  1700  1700  1700  1700  1700  1700  1700  1700  1700
		1700  1700  1700  1700  1700  1700  1700  1700  1700  1700  1700  1700  1700  1700  1700  1700  1700  1700  1700  1700  1700  1700  1700  1700  1700  1700  1700  1700  1700  1700  1700  1700  1700  1700  1700  1700  1700  1700
		1700  1700  1700  1700  1700  1700  1700  1700  1700  1700  1700  1700  1700  1700  1700  1700  1700  1700  1700  1700  1700  1700  1700  1700  1700  1700  1700  1700  1700  1700  1700  1700  1700  1700  1700  1700  1700  1700
		1700  1700  1700  1700  1700  1700  1700  1700  1700  1700  1700  1700  1700  1700  1700  1700  1700  1700  1700  1700  1700  1700  1700  1700  1700  1700  1700  1700  1700  1700  1700  1700  1700  1700  1700  1700  1700  1700
		1700  1700  1700  1700  1700  1700  1700  1700  1700  1700  1700  1700  1700  1700  1700  1700  1700  1700  1700  1700  1700  1700  1700  1700  1700  1700  1700  1700  1700  1700  1700  1700  1700  1700  1700  1700  1700  1700
	>;

	pt7_lo_limits_row_03 = <38>;
	pt7_lo_limits_cols_03 = <38>;
	pt7_lo_limits_03 = <
		300  300  300  300  300  300  300  300  300  300  300  300  300  300  300  300  300  300  300  300  300  300  300  300  300  300  300  300  300  300  300  300  300  300  300  300  300  300
		300  300  300  300  300  300  300  300  300  300  300  300  300  300  300  300  300  300  300  300  300  300  300  300  300  300  300  300  300  300  300  300  300  300  300  300  300  300
		300  300  300  300  300  300  300  300  300  300  300  300  300  300  300  300  300  300  300  300  300  300  300  300  300  300  300  300  300  300  300  300  300  300  300  300  300  300
		300  300  300  300  300  300  300  300  300  300  300  300  300  300  300  300  300  300  300  300  300  300  300  300  300  300  300  300  300  300  300  300  300  300  300  300  300  300
		300  300  300  300  300  300  300  300  300  300  300  300  300  300  300  300  300  300  300  300  300  300  300  300  300  300  300  300  300  300  300  300  300  300  300  300  300  300
		300  300  300  300  300  300  300  300  300  300  300  300  300  300  300  300  300  300  300  300  300  300  300  300  300  300  300  300  300  300  300  300  300  300  300  300  300  300
		300  300  300  300  300  300  300  300  300  300  300  300  300  300  300  300  300  300  300  300  300  300  300  300  300  300  300  300  300  300  300  300  300  300  300  300  300  300
		300  300  300  300  300  300  300  300  300  300  300  300  300  300  300  300  300  300  300  300  300  300  300  300  300  300  300  300  300  300  300  300  300  300  300  300  300  300
		300  300  300  300  300  300  300  300  300  300  300  300  300  300  300  300  300  300  300  300  300  300  300  300  300  300  300  300  300  300  300  300  300  300  300  300  300  300
		300  300  300  300  300  300  300  300  300  300  300  300  300  300  300  300  300  300  300  300  300  300  300  300  300  300  300  300  300  300  300  300  300  300  300  300  300  300
		300  300  300  300  300  300  300  300  300  300  300  300  300  300  300  300  300  300  300  300  300  300  300  300  300  300  300  300  300  300  300  300  300  300  300  300  300  300
		300  300  300  300  300  300  300  300  300  300  300  300  300  300  300  300  300  300  300  300  300  300  300  300  300  300  300  300  300  300  300  300  300  300  300  300  300  300
		300  300  300  300  300  300  300  300  300  300  300  300  300  300  300  300  300  300  300  300  300  300  300  300  300  300  300  300  300  300  300  300  300  300  300  300  300  300
		300  300  300  300  300  300  300  300  300  300  300  300  300  300  300  300  300  300  300  300  300  300  300  300  300  300  300  300  300  300  300  300  300  300  300  300  300  300
		300  300  300  300  300  300  300  300  300  300  300  300  300  300  300  300  300  300  300  300  300  300  300  300  300  300  300  300  300  300  300  300  300  300  300  300  300  300
		300  300  300  300  300  300  300  300  300  300  300  300  300  300  300  300  300  300  300  300  300  300  300  300  300  300  300  300  300  300  300  300  300  300  300  300  300  300
		300  300  300  300  300  300  300  300  300  300  300  300  300  300  300  300  300  300  300  300  300  300  300  300  300  300  300  300  300  300  300  300  300  300  300  300  300  300
		300  300  300  300  300  300  300  300  300  300  300  300  300  300  300  300  300  300  300  300  300  300  300  300  300  300  300  300  300  300  300  300  300  300  300  300  300  300
		300  300  300  300  300  300  300  300  300  300  300  300  300  300  300  300  300  300  300  300  300  300  300  300  300  300  300  300  300  300  300  300  300  300  300  300  300  300
		300  300  300  300  300  300  300  300  300  300  300  300  300  300  300  300  300  300  300  300  300  300  300  300  300  300  300  300  300  300  300  300  300  300  300  300  300  300
		300  300  300  300  300  300  300  300  300  300  300  300  300  300  300  300  300  300  300  300  300  300  300  300  300  300  300  300  300  300  300  300  300  300  300  300  300  300
		300  300  300  300  300  300  300  300  300  300  300  300  300  300  300  300  300  300  300  300  300  300  300  300  300  300  300  300  300  300  300  300  300  300  300  300  300  300
		300  300  300  300  300  300  300  300  300  300  300  300  300  300  300  300  300  300  300  300  300  300  300  300  300  300  300  300  300  300  300  300  300  300  300  300  300  300
		300  300  300  300  300  300  300  300  300  300  300  300  300  300  300  300  300  300  300  300  300  300  300  300  300  300  300  300  300  300  300  300  300  300  300  300  300  300
		300  300  300  300  300  300  300  300  300  300  300  300  300  300  300  300  300  300  300  300  300  300  300  300  300  300  300  300  300  300  300  300  300  300  300  300  300  300
		300  300  300  300  300  300  300  300  300  300  300  300  300  300  300  300  300  300  300  300  300  300  300  300  300  300  300  300  300  300  300  300  300  300  300  300  300  300
		300  300  300  300  300  300  300  300  300  300  300  300  300  300  300  300  300  300  300  300  300  300  300  300  300  300  300  300  300  300  300  300  300  300  300  300  300  300
		300  300  300  300  300  300  300  300  300  300  300  300  300  300  300  300  300  300  300  300  300  300  300  300  300  300  300  300  300  300  300  300  300  300  300  300  300  300
		300  300  300  300  300  300  300  300  300  300  300  300  300  300  300  300  300  300  300  300  300  300  300  300  300  300  300  300  300  300  300  300  300  300  300  300  300  300
		300  300  300  300  300  300  300  300  300  300  300  300  300  300  300  300  300  300  300  300  300  300  300  300  300  300  300  300  300  300  300  300  300  300  300  300  300  300
		300  300  300  300  300  300  300  300  300  300  300  300  300  300  300  300  300  300  300  300  300  300  300  300  300  300  300  300  300  300  300  300  300  300  300  300  300  300
		300  300  300  300  300  300  300  300  0    0    300  300  300  300  300  300  300  300  300  300  300  300  300  300  300  300  300  300  300  300  300  300  300  300  300  300  300  300
		300  300  300  300  300  300  300  300  300  300  300  300  300  300  300  300  300  300  300  300  300  300  300  300  300  300  300  300  300  300  300  300  300  300  300  300  300  300
		300  300  300  300  300  300  300  300  300  300  300  300  300  300  300  300  300  300  300  300  300  300  300  300  300  300  300  300  300  300  300  300  300  300  300  300  300  300
		300  300  300  300  300  300  300  300  300  300  300  300  300  300  300  300  300  300  300  300  300  300  300  300  300  300  300  300  300  300  300  300  300  300  300  300  300  300
		300  300  300  300  300  300  300  300  300  300  300  300  300  300  300  300  300  300  300  300  300  300  300  300  300  300  300  300  300  300  300  300  300  300  300  300  300  300
		300  300  300  300  300  300  300  300  300  300  300  300  300  300  300  300  300  300  300  300  300  300  300  300  300  300  300  300  300  300  300  300  300  300  300  300  300  300
		300  300  300  300  300  300  300  300  300  300  300  300  300  300  300  300  300  300  300  300  300  300  300  300  300  300  300  300  300  300  300  300  300  300  300  300  300  300
	>;

/* test limit for the pt11 testing */
/*  including upper and lower bounds */
	pt11_hi_limits_row_03 = <38>;
	pt11_hi_limits_cols_03 = <38>;
	pt11_hi_limits_03 = <
		 80  80  80  80  80  80  80  80  80  80  80  80  80  80  80  80  80  80  80  80  80  80  80  80  80  80  80  80  80  80  80  80  80  80  80  80  80  80
		 80  80  80  80  80  80  80  80  80  80  80  80  80  80  80  80  80  80  80  80  80  80  80  80  80  80  80  80  80  80  80  80  80  80  80  80  80  80
		 80  80  80  80  80  80  80  80  80  80  80  80  80  80  80  80  80  80  80  80  80  80  80  80  80  80  80  80  80  80  80  80  80  80  80  80  80  80
		 80  80  80  80  80  80  80  80  80  80  80  80  80  80  80  80  80  80  80  80  80  80  80  80  80  80  80  80  80  80  80  80  80  80  80  80  80  80
		 80  80  80  80  80  80  80  80  80  80  80  80  80  80  80  80  80  80  80  80  80  80  80  80  80  80  80  80  80  80  80  80  80  80  80  80  80  80
		 80  80  80  80  80  80  80  80  80  80  80  80  80  80  80  80  80  80  80  80  80  80  80  80  80  80  80  80  80  80  80  80  80  80  80  80  80  80
		 80  80  80  80  80  80  80  80  80  80  80  80  80  80  80  80  80  80  80  80  80  80  80  80  80  80  80  80  80  80  80  80  80  80  80  80  80  80
		 80  80  80  80  80  80  80  80  80  80  80  80  80  80  80  80  80  80  80  80  80  80  80  80  80  80  80  80  80  80  80  80  80  80  80  80  80  80
		 80  80  80  80  80  80  80  80  80  80  80  80  80  80  80  80  80  80  80  80  80  80  80  80  80  80  80  80  80  80  80  80  80  80  80  80  80  80
		 80  80  80  80  80  80  80  80  80  80  80  80  80  80  80  80  80  80  80  80  80  80  80  80  80  80  80  80  80  80  80  80  80  80  80  80  80  80
		 80  80  80  80  80  80  80  80  80  80  80  80  80  80  80  80  80  80  80  80  80  80  80  80  80  80  80  80  80  80  80  80  80  80  80  80  80  80
		 80  80  80  80  80  80  80  80  80  80  80  80  80  80  80  80  80  80  80  80  80  80  80  80  80  80  80  80  80  80  80  80  80  80  80  80  80  80
		 80  80  80  80  80  80  80  80  80  80  80  80  80  80  80  80  80  80  80  80  80  80  80  80  80  80  80  80  80  80  80  80  80  80  80  80  80  80
		 80  80  80  80  80  80  80  80  80  80  80  80  80  80  80  80  80  80  80  80  80  80  80  80  80  80  80  80  80  80  80  80  80  80  80  80  80  80
		 80  80  80  80  80  80  80  80  80  80  80  80  80  80  80  80  80  80  80  80  80  80  80  80  80  80  80  80  80  80  80  80  80  80  80  80  80  80
		 80  80  80  80  80  80  80  80  80  80  80  80  80  80  80  80  80  80  80  80  80  80  80  80  80  80  80  80  80  80  80  80  80  80  80  80  80  80
		 80  80  80  80  80  80  80  80  80  80  80  80  80  80  80  80  80  80  80  80  80  80  80  80  80  80  80  80  80  80  80  80  80  80  80  80  80  80
		 80  80  80  80  80  80  80  80  80  80  80  80  80  80  80  80  80  80  80  80  80  80  80  80  80  80  80  80  80  80  80  80  80  80  80  80  80  80
		 80  80  80  80  80  80  80  80  80  80  80  80  80  80  80  80  80  80  80  80  80  80  80  80  80  80  80  80  80  80  80  80  80  80  80  80  80  80
		 80  80  80  80  80  80  80  80  80  80  80  80  80  80  80  80  80  80  80  80  80  80  80  80  80  80  80  80  80  80  80  80  80  80  80  80  80  80
		 80  80  80  80  80  80  80  80  80  80  80  80  80  80  80  80  80  80  80  80  80  80  80  80  80  80  80  80  80  80  80  80  80  80  80  80  80  80
		 80  80  80  80  80  80  80  80  80  80  80  80  80  80  80  80  80  80  80  80  80  80  80  80  80  80  80  80  80  80  80  80  80  80  80  80  80  80
		 80  80  80  80  80  80  80  80  80  80  80  80  80  80  80  80  80  80  80  80  80  80  80  80  80  80  80  80  80  80  80  80  80  80  80  80  80  80
		 80  80  80  80  80  80  80  80  80  80  80  80  80  80  80  80  80  80  80  80  80  80  80  80  80  80  80  80  80  80  80  80  80  80  80  80  80  80
		 80  80  80  80  80  80  80  80  80  80  80  80  80  80  80  80  80  80  80  80  80  80  80  80  80  80  80  80  80  80  80  80  80  80  80  80  80  80
		 80  80  80  80  80  80  80  80  80  80  80  80  80  80  80  80  80  80  80  80  80  80  80  80  80  80  80  80  80  80  80  80  80  80  80  80  80  80
		 80  80  80  80  80  80  80  80  80  80  80  80  80  80  80  80  80  80  80  80  80  80  80  80  80  80  80  80  80  80  80  80  80  80  80  80  80  80
		 80  80  80  80  80  80  80  80  80  80  80  80  80  80  80  80  80  80  80  80  80  80  80  80  80  80  80  80  80  80  80  80  80  80  80  80  80  80
		 80  80  80  80  80  80  80  80  80  80  80  80  80  80  80  80  80  80  80  80  80  80  80  80  80  80  80  80  80  80  80  80  80  80  80  80  80  80
		 80  80  80  80  80  80  80  80  80  80  80  80  80  80  80  80  80  80  80  80  80  80  80  80  80  80  80  80  80  80  80  80  80  80  80  80  80  80
		 80  80  80  80  80  80  80  80  80  80  80  80  80  80  80  80  80  80  80  80  80  80  80  80  80  80  80  80  80  80  80  80  80  80  80  80  80  80
		 80  80  80  80  80  80  80  80  80  80  80  80  80  80  80  80  80  80  80  80  80  80  80  80  80  80  80  80  80  80  80  80  80  80  80  80  80  80
		 80  80  80  80  80  80  80  80  80  80  80  80  80  80  80  80  80  80  80  80  80  80  80  80  80  80  80  80  80  80  80  80  80  80  80  80  80  80
		 80  80  80  80  80  80  80  80  80  80  80  80  80  80  80  80  80  80  80  80  80  80  80  80  80  80  80  80  80  80  80  80  80  80  80  80  80  80
		 80  80  80  80  80  80  80  80  80  80  80  80  80  80  80  80  80  80  80  80  80  80  80  80  80  80  80  80  80  80  80  80  80  80  80  80  80  80
		 80  80  80  80  80  80  80  80  80  80  80  80  80  80  80  80  80  80  80  80  80  80  80  80  80  80  80  80  80  80  80  80  80  80  80  80  80  80
		 80  80  80  80  80  80  80  80  80  80  80  80  80  80  80  80  80  80  80  80  80  80  80  80  80  80  80  80  80  80  80  80  80  80  80  80  80  80
		 80  80  80  80  80  80  80  80  80  80  80  80  80  80  80  80  80  80  80  80  80  80  80  80  80  80  80  80  80  80  80  80  80  80  80  80  80  80
	>;

	pt11_lo_limits_row_03 = <38>;
	pt11_lo_limits_cols_03 = <38>;
	pt11_lo_limits_03 = <
		 (-80)  (-80)  (-80)  (-80)  (-80)  (-80)  (-80)  (-80)  (-80)  (-80)  (-80)  (-80)  (-80)  (-80)  (-80)  (-80)  (-80)  (-80)  (-80)  (-80)  (-80)  (-80)  (-80)  (-80)  (-80)  (-80)  (-80)  (-80)  (-80)  (-80)  (-80)  (-80)  (-80)  (-80)  (-80)  (-80)  (-80)  (-80)
		 (-80)  (-80)  (-80)  (-80)  (-80)  (-80)  (-80)  (-80)  (-80)  (-80)  (-80)  (-80)  (-80)  (-80)  (-80)  (-80)  (-80)  (-80)  (-80)  (-80)  (-80)  (-80)  (-80)  (-80)  (-80)  (-80)  (-80)  (-80)  (-80)  (-80)  (-80)  (-80)  (-80)  (-80)  (-80)  (-80)  (-80)  (-80)
		 (-80)  (-80)  (-80)  (-80)  (-80)  (-80)  (-80)  (-80)  (-80)  (-80)  (-80)  (-80)  (-80)  (-80)  (-80)  (-80)  (-80)  (-80)  (-80)  (-80)  (-80)  (-80)  (-80)  (-80)  (-80)  (-80)  (-80)  (-80)  (-80)  (-80)  (-80)  (-80)  (-80)  (-80)  (-80)  (-80)  (-80)  (-80)
		 (-80)  (-80)  (-80)  (-80)  (-80)  (-80)  (-80)  (-80)  (-80)  (-80)  (-80)  (-80)  (-80)  (-80)  (-80)  (-80)  (-80)  (-80)  (-80)  (-80)  (-80)  (-80)  (-80)  (-80)  (-80)  (-80)  (-80)  (-80)  (-80)  (-80)  (-80)  (-80)  (-80)  (-80)  (-80)  (-80)  (-80)  (-80)
		 (-80)  (-80)  (-80)  (-80)  (-80)  (-80)  (-80)  (-80)  (-80)  (-80)  (-80)  (-80)  (-80)  (-80)  (-80)  (-80)  (-80)  (-80)  (-80)  (-80)  (-80)  (-80)  (-80)  (-80)  (-80)  (-80)  (-80)  (-80)  (-80)  (-80)  (-80)  (-80)  (-80)  (-80)  (-80)  (-80)  (-80)  (-80)
		 (-80)  (-80)  (-80)  (-80)  (-80)  (-80)  (-80)  (-80)  (-80)  (-80)  (-80)  (-80)  (-80)  (-80)  (-80)  (-80)  (-80)  (-80)  (-80)  (-80)  (-80)  (-80)  (-80)  (-80)  (-80)  (-80)  (-80)  (-80)  (-80)  (-80)  (-80)  (-80)  (-80)  (-80)  (-80)  (-80)  (-80)  (-80)
		 (-80)  (-80)  (-80)  (-80)  (-80)  (-80)  (-80)  (-80)  (-80)  (-80)  (-80)  (-80)  (-80)  (-80)  (-80)  (-80)  (-80)  (-80)  (-80)  (-80)  (-80)  (-80)  (-80)  (-80)  (-80)  (-80)  (-80)  (-80)  (-80)  (-80)  (-80)  (-80)  (-80)  (-80)  (-80)  (-80)  (-80)  (-80)
		 (-80)  (-80)  (-80)  (-80)  (-80)  (-80)  (-80)  (-80)  (-80)  (-80)  (-80)  (-80)  (-80)  (-80)  (-80)  (-80)  (-80)  (-80)  (-80)  (-80)  (-80)  (-80)  (-80)  (-80)  (-80)  (-80)  (-80)  (-80)  (-80)  (-80)  (-80)  (-80)  (-80)  (-80)  (-80)  (-80)  (-80)  (-80)
		 (-80)  (-80)  (-80)  (-80)  (-80)  (-80)  (-80)  (-80)  (-80)  (-80)  (-80)  (-80)  (-80)  (-80)  (-80)  (-80)  (-80)  (-80)  (-80)  (-80)  (-80)  (-80)  (-80)  (-80)  (-80)  (-80)  (-80)  (-80)  (-80)  (-80)  (-80)  (-80)  (-80)  (-80)  (-80)  (-80)  (-80)  (-80)
		 (-80)  (-80)  (-80)  (-80)  (-80)  (-80)  (-80)  (-80)  (-80)  (-80)  (-80)  (-80)  (-80)  (-80)  (-80)  (-80)  (-80)  (-80)  (-80)  (-80)  (-80)  (-80)  (-80)  (-80)  (-80)  (-80)  (-80)  (-80)  (-80)  (-80)  (-80)  (-80)  (-80)  (-80)  (-80)  (-80)  (-80)  (-80)
		 (-80)  (-80)  (-80)  (-80)  (-80)  (-80)  (-80)  (-80)  (-80)  (-80)  (-80)  (-80)  (-80)  (-80)  (-80)  (-80)  (-80)  (-80)  (-80)  (-80)  (-80)  (-80)  (-80)  (-80)  (-80)  (-80)  (-80)  (-80)  (-80)  (-80)  (-80)  (-80)  (-80)  (-80)  (-80)  (-80)  (-80)  (-80)
		 (-80)  (-80)  (-80)  (-80)  (-80)  (-80)  (-80)  (-80)  (-80)  (-80)  (-80)  (-80)  (-80)  (-80)  (-80)  (-80)  (-80)  (-80)  (-80)  (-80)  (-80)  (-80)  (-80)  (-80)  (-80)  (-80)  (-80)  (-80)  (-80)  (-80)  (-80)  (-80)  (-80)  (-80)  (-80)  (-80)  (-80)  (-80)
		 (-80)  (-80)  (-80)  (-80)  (-80)  (-80)  (-80)  (-80)  (-80)  (-80)  (-80)  (-80)  (-80)  (-80)  (-80)  (-80)  (-80)  (-80)  (-80)  (-80)  (-80)  (-80)  (-80)  (-80)  (-80)  (-80)  (-80)  (-80)  (-80)  (-80)  (-80)  (-80)  (-80)  (-80)  (-80)  (-80)  (-80)  (-80)
		 (-80)  (-80)  (-80)  (-80)  (-80)  (-80)  (-80)  (-80)  (-80)  (-80)  (-80)  (-80)  (-80)  (-80)  (-80)  (-80)  (-80)  (-80)  (-80)  (-80)  (-80)  (-80)  (-80)  (-80)  (-80)  (-80)  (-80)  (-80)  (-80)  (-80)  (-80)  (-80)  (-80)  (-80)  (-80)  (-80)  (-80)  (-80)
		 (-80)  (-80)  (-80)  (-80)  (-80)  (-80)  (-80)  (-80)  (-80)  (-80)  (-80)  (-80)  (-80)  (-80)  (-80)  (-80)  (-80)  (-80)  (-80)  (-80)  (-80)  (-80)  (-80)  (-80)  (-80)  (-80)  (-80)  (-80)  (-80)  (-80)  (-80)  (-80)  (-80)  (-80)  (-80)  (-80)  (-80)  (-80)
		 (-80)  (-80)  (-80)  (-80)  (-80)  (-80)  (-80)  (-80)  (-80)  (-80)  (-80)  (-80)  (-80)  (-80)  (-80)  (-80)  (-80)  (-80)  (-80)  (-80)  (-80)  (-80)  (-80)  (-80)  (-80)  (-80)  (-80)  (-80)  (-80)  (-80)  (-80)  (-80)  (-80)  (-80)  (-80)  (-80)  (-80)  (-80)
		 (-80)  (-80)  (-80)  (-80)  (-80)  (-80)  (-80)  (-80)  (-80)  (-80)  (-80)  (-80)  (-80)  (-80)  (-80)  (-80)  (-80)  (-80)  (-80)  (-80)  (-80)  (-80)  (-80)  (-80)  (-80)  (-80)  (-80)  (-80)  (-80)  (-80)  (-80)  (-80)  (-80)  (-80)  (-80)  (-80)  (-80)  (-80)
		 (-80)  (-80)  (-80)  (-80)  (-80)  (-80)  (-80)  (-80)  (-80)  (-80)  (-80)  (-80)  (-80)  (-80)  (-80)  (-80)  (-80)  (-80)  (-80)  (-80)  (-80)  (-80)  (-80)  (-80)  (-80)  (-80)  (-80)  (-80)  (-80)  (-80)  (-80)  (-80)  (-80)  (-80)  (-80)  (-80)  (-80)  (-80)
		 (-80)  (-80)  (-80)  (-80)  (-80)  (-80)  (-80)  (-80)  (-80)  (-80)  (-80)  (-80)  (-80)  (-80)  (-80)  (-80)  (-80)  (-80)  (-80)  (-80)  (-80)  (-80)  (-80)  (-80)  (-80)  (-80)  (-80)  (-80)  (-80)  (-80)  (-80)  (-80)  (-80)  (-80)  (-80)  (-80)  (-80)  (-80)
		 (-80)  (-80)  (-80)  (-80)  (-80)  (-80)  (-80)  (-80)  (-80)  (-80)  (-80)  (-80)  (-80)  (-80)  (-80)  (-80)  (-80)  (-80)  (-80)  (-80)  (-80)  (-80)  (-80)  (-80)  (-80)  (-80)  (-80)  (-80)  (-80)  (-80)  (-80)  (-80)  (-80)  (-80)  (-80)  (-80)  (-80)  (-80)
		 (-80)  (-80)  (-80)  (-80)  (-80)  (-80)  (-80)  (-80)  (-80)  (-80)  (-80)  (-80)  (-80)  (-80)  (-80)  (-80)  (-80)  (-80)  (-80)  (-80)  (-80)  (-80)  (-80)  (-80)  (-80)  (-80)  (-80)  (-80)  (-80)  (-80)  (-80)  (-80)  (-80)  (-80)  (-80)  (-80)  (-80)  (-80)
		 (-80)  (-80)  (-80)  (-80)  (-80)  (-80)  (-80)  (-80)  (-80)  (-80)  (-80)  (-80)  (-80)  (-80)  (-80)  (-80)  (-80)  (-80)  (-80)  (-80)  (-80)  (-80)  (-80)  (-80)  (-80)  (-80)  (-80)  (-80)  (-80)  (-80)  (-80)  (-80)  (-80)  (-80)  (-80)  (-80)  (-80)  (-80)
		 (-80)  (-80)  (-80)  (-80)  (-80)  (-80)  (-80)  (-80)  (-80)  (-80)  (-80)  (-80)  (-80)  (-80)  (-80)  (-80)  (-80)  (-80)  (-80)  (-80)  (-80)  (-80)  (-80)  (-80)  (-80)  (-80)  (-80)  (-80)  (-80)  (-80)  (-80)  (-80)  (-80)  (-80)  (-80)  (-80)  (-80)  (-80)
		 (-80)  (-80)  (-80)  (-80)  (-80)  (-80)  (-80)  (-80)  (-80)  (-80)  (-80)  (-80)  (-80)  (-80)  (-80)  (-80)  (-80)  (-80)  (-80)  (-80)  (-80)  (-80)  (-80)  (-80)  (-80)  (-80)  (-80)  (-80)  (-80)  (-80)  (-80)  (-80)  (-80)  (-80)  (-80)  (-80)  (-80)  (-80)
		 (-80)  (-80)  (-80)  (-80)  (-80)  (-80)  (-80)  (-80)  (-80)  (-80)  (-80)  (-80)  (-80)  (-80)  (-80)  (-80)  (-80)  (-80)  (-80)  (-80)  (-80)  (-80)  (-80)  (-80)  (-80)  (-80)  (-80)  (-80)  (-80)  (-80)  (-80)  (-80)  (-80)  (-80)  (-80)  (-80)  (-80)  (-80)
		 (-80)  (-80)  (-80)  (-80)  (-80)  (-80)  (-80)  (-80)  (-80)  (-80)  (-80)  (-80)  (-80)  (-80)  (-80)  (-80)  (-80)  (-80)  (-80)  (-80)  (-80)  (-80)  (-80)  (-80)  (-80)  (-80)  (-80)  (-80)  (-80)  (-80)  (-80)  (-80)  (-80)  (-80)  (-80)  (-80)  (-80)  (-80)
		 (-80)  (-80)  (-80)  (-80)  (-80)  (-80)  (-80)  (-80)  (-80)  (-80)  (-80)  (-80)  (-80)  (-80)  (-80)  (-80)  (-80)  (-80)  (-80)  (-80)  (-80)  (-80)  (-80)  (-80)  (-80)  (-80)  (-80)  (-80)  (-80)  (-80)  (-80)  (-80)  (-80)  (-80)  (-80)  (-80)  (-80)  (-80)
		 (-80)  (-80)  (-80)  (-80)  (-80)  (-80)  (-80)  (-80)  (-80)  (-80)  (-80)  (-80)  (-80)  (-80)  (-80)  (-80)  (-80)  (-80)  (-80)  (-80)  (-80)  (-80)  (-80)  (-80)  (-80)  (-80)  (-80)  (-80)  (-80)  (-80)  (-80)  (-80)  (-80)  (-80)  (-80)  (-80)  (-80)  (-80)
		 (-80)  (-80)  (-80)  (-80)  (-80)  (-80)  (-80)  (-80)  (-80)  (-80)  (-80)  (-80)  (-80)  (-80)  (-80)  (-80)  (-80)  (-80)  (-80)  (-80)  (-80)  (-80)  (-80)  (-80)  (-80)  (-80)  (-80)  (-80)  (-80)  (-80)  (-80)  (-80)  (-80)  (-80)  (-80)  (-80)  (-80)  (-80)
		 (-80)  (-80)  (-80)  (-80)  (-80)  (-80)  (-80)  (-80)  (-80)  (-80)  (-80)  (-80)  (-80)  (-80)  (-80)  (-80)  (-80)  (-80)  (-80)  (-80)  (-80)  (-80)  (-80)  (-80)  (-80)  (-80)  (-80)  (-80)  (-80)  (-80)  (-80)  (-80)  (-80)  (-80)  (-80)  (-80)  (-80)  (-80)
		 (-80)  (-80)  (-80)  (-80)  (-80)  (-80)  (-80)  (-80)  (-80)  (-80)  (-80)  (-80)  (-80)  (-80)  (-80)  (-80)  (-80)  (-80)  (-80)  (-80)  (-80)  (-80)  (-80)  (-80)  (-80)  (-80)  (-80)  (-80)  (-80)  (-80)  (-80)  (-80)  (-80)  (-80)  (-80)  (-80)  (-80)  (-80)
		 (-80)  (-80)  (-80)  (-80)  (-80)  (-80)  (-80)  (-80)  (-80)  (-80)  (-80)  (-80)  (-80)  (-80)  (-80)  (-80)  (-80)  (-80)  (-80)  (-80)  (-80)  (-80)  (-80)  (-80)  (-80)  (-80)  (-80)  (-80)  (-80)  (-80)  (-80)  (-80)  (-80)  (-80)  (-80)  (-80)  (-80)  (-80)
		 (-80)  (-80)  (-80)  (-80)  (-80)  (-80)  (-80)  (-80)  (-80)  (-80)  (-80)  (-80)  (-80)  (-80)  (-80)  (-80)  (-80)  (-80)  (-80)  (-80)  (-80)  (-80)  (-80)  (-80)  (-80)  (-80)  (-80)  (-80)  (-80)  (-80)  (-80)  (-80)  (-80)  (-80)  (-80)  (-80)  (-80)  (-80)
		 (-80)  (-80)  (-80)  (-80)  (-80)  (-80)  (-80)  (-80)  (-80)  (-80)  (-80)  (-80)  (-80)  (-80)  (-80)  (-80)  (-80)  (-80)  (-80)  (-80)  (-80)  (-80)  (-80)  (-80)  (-80)  (-80)  (-80)  (-80)  (-80)  (-80)  (-80)  (-80)  (-80)  (-80)  (-80)  (-80)  (-80)  (-80)
		 (-80)  (-80)  (-80)  (-80)  (-80)  (-80)  (-80)  (-80)  (-80)  (-80)  (-80)  (-80)  (-80)  (-80)  (-80)  (-80)  (-80)  (-80)  (-80)  (-80)  (-80)  (-80)  (-80)  (-80)  (-80)  (-80)  (-80)  (-80)  (-80)  (-80)  (-80)  (-80)  (-80)  (-80)  (-80)  (-80)  (-80)  (-80)
		 (-80)  (-80)  (-80)  (-80)  (-80)  (-80)  (-80)  (-80)  (-80)  (-80)  (-80)  (-80)  (-80)  (-80)  (-80)  (-80)  (-80)  (-80)  (-80)  (-80)  (-80)  (-80)  (-80)  (-80)  (-80)  (-80)  (-80)  (-80)  (-80)  (-80)  (-80)  (-80)  (-80)  (-80)  (-80)  (-80)  (-80)  (-80)
		 (-80)  (-80)  (-80)  (-80)  (-80)  (-80)  (-80)  (-80)  (-80)  (-80)  (-80)  (-80)  (-80)  (-80)  (-80)  (-80)  (-80)  (-80)  (-80)  (-80)  (-80)  (-80)  (-80)  (-80)  (-80)  (-80)  (-80)  (-80)  (-80)  (-80)  (-80)  (-80)  (-80)  (-80)  (-80)  (-80)  (-80)  (-80)
		 (-80)  (-80)  (-80)  (-80)  (-80)  (-80)  (-80)  (-80)  (-80)  (-80)  (-80)  (-80)  (-80)  (-80)  (-80)  (-80)  (-80)  (-80)  (-80)  (-80)  (-80)  (-80)  (-80)  (-80)  (-80)  (-80)  (-80)  (-80)  (-80)  (-80)  (-80)  (-80)  (-80)  (-80)  (-80)  (-80)  (-80)  (-80)
	>;

 };
