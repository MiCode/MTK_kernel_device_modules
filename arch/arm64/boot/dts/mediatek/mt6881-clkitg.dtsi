// SPDX-License-Identifier: (GPL-2.0 OR MIT)
/*
 * Copyright (C) 2025 MediaTek Inc.
 * Author: Claude Yen <claude.yen@mediatek.com>
 */

&clkitg {
	status = "okay";
	bring-up@0 {
		compatible = "mediatek,clk-bring-up";
		reg = <0x0>;
	};
};
