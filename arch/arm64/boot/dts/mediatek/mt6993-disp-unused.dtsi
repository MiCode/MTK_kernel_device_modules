// SPDX-License-Identifier: (GPL-2.0 OR MIT)
/*
 * Copyright (C) 2025 MediaTek Inc.
 * Author: chia-cheng.hsu <Chia-cheng.Hsu@mediatek.com>
 */

/ {
	soc {
		dispsys_unused: dispsys-unused@0 {
			clocks =
				<&disp_vdisp_ao_config_clk VDISP_AO_DISP_PWM0_DISP>,
				<&disp_vdisp_ao_config_clk VDISP_AO_DISP_PWM1_DISP>,
				<&disp_vdisp_ao_config_clk VDISP_AO_DISP_BWM0_DISP>,
				<&disp_vdisp_ao_config_clk VDISP_AO_DISP_BWM1_DISP>,
				<&disp_vdisp_ao_config_clk VDISP_AO_DISP_BWR_DISP>,
				<&disp_vdisp_ao_config_clk VDISP_AO_DISP_DEBUG_TOP_DISP>,
				<&disp_vdisp_ao_config_clk VDISP_AO_DISP_CVFS_DISP>,
				<&dispsys_config_clk MM0_DISP_AAL0_DISP>,
				<&dispsys_config_clk MM0_DISP_C3D0_DISP>,
				<&dispsys_config_clk MM0_DISP_C3D1_DISP>,
				<&dispsys_config_clk MM0_DISP_CCORR0_DISP>,
				<&dispsys_config_clk MM0_DISP_CCORR1_DISP>,
				<&dispsys_config_clk MM0_DISP_COLOR0_DISP>,
				<&dispsys_config_clk MM0_DISP_DITHER0_DISP>,
				<&dispsys_config_clk MM0_DISP_DITHER1_DISP>,
				<&dispsys_config_clk MM0_DISP_DLI_ASYNC1_DISP>,
				<&dispsys_config_clk MM0_DISP_DLI_ASYNC2_DISP>,
				<&dispsys_config_clk MM0_DISP_DLI_ASYNC3_DISP>,
				<&dispsys_config_clk MM0_DISP_DLI_ASYNC4_DISP>,
				<&dispsys_config_clk MM0_DISP_DLI_ASYNC5_DISP>,
				<&dispsys_config_clk MM0_DISP_DLI_ASYNC6_DISP>,
				<&dispsys_config_clk MM0_DISP_DLI_ASYNC7_DISP>,
				<&dispsys_config_clk MM0_DISP_DLI_ASYNC8_DISP>,
				<&dispsys_config_clk MM0_DISP_DLI_ASYNC9_DISP>,
				<&dispsys_config_clk MM0_DISP_DLI_ASYNC10_DISP>,
				<&dispsys_config_clk MM0_DISP_DLI_ASYNC11_DISP>,
				<&dispsys_config_clk MM0_DISP_DLI_ASYNC12_DISP>,
				<&dispsys_config_clk MM0_DISP_DLI_ASYNC13_DISP>,
				<&dispsys_config_clk MM0_DISP_DLI_ASYNC14_DISP>,
				<&dispsys_config_clk MM0_DISP_DLI_ASYNC15_DISP>,
				<&dispsys_config_clk MM0_DISP_DLO_ASYNC1_DISP>,
				<&dispsys_config_clk MM0_DISP_DLO_ASYNC2_DISP>,
				<&dispsys_config_clk MM0_DISP_DLO_ASYNC3_DISP>,
				<&dispsys_config_clk MM0_DISP_DLO_ASYNC4_DISP>,
				<&dispsys_config_clk MM0_DISP_DLO_ASYNC5_DISP>,
				<&dispsys_config_clk MM0_DISP_DLO_ASYNC6_DISP>,
				<&dispsys_config_clk MM0_DISP_DLO_ASYNC7_DISP>,
				<&dispsys_config_clk MM0_DISP_DLO_ASYNC8_DISP>,
				<&dispsys_config_clk MM0_DISP_DLO_ASYNC9_DISP>,
				<&dispsys_config_clk MM0_DISP_DLO_ASYNC10_DISP>,
				<&dispsys_config_clk MM0_DISP_DLO_ASYNC11_DISP>,
				<&dispsys_config_clk MM0_DISP_DLO_ASYNC12_DISP>,
				<&dispsys_config_clk MM0_DISP_DLO_ASYNC13_DISP>,
				<&dispsys_config_clk MM0_DISP_DLO_ASYNC14_DISP>,
				<&dispsys_config_clk MM0_DISP_DLO_ASYNC15_DISP>,
				<&dispsys_config_clk MM0_DISP_DLO_ASYNC17_DISP>,
				<&dispsys_config_clk MM0_DISP_DLO_ASYNC18_DISP>,
				<&dispsys_config_clk MM0_DISP_DLO_ASYNC19_DISP>,
				<&dispsys_config_clk MM0_DISP_DLO_ASYNC20_DISP>,
				<&dispsys_config_clk MM0_DISP_RELAY5_DISP>,
				<&dispsys_config_clk MM0_DISP_GAMMA0_DISP>,
				<&dispsys_config_clk MM0_MDP_AAL0_DISP>,
				<&dispsys_config_clk MM0_DISP_POSTMASK0_DISP>,
				<&dispsys_config_clk MM0_MDP_RDMA0_DISP>,
				<&dispsys_config_clk MM0_DISP_SPR0_DISP>,
				<&dispsys_config_clk MM0_DISP_ODDMR0_DISP>,
				<&dispsys_config_clk MM0_MDP_RSZ0_DISP>,
				<&dispsys_config_clk MM0_DISP_TDSHP0_DISP>,
				<&dispsys_config_clk MM0_DISP_FAKE_ENG0_DISP>,
				<&dispsys_config_clk MM0_DISP_DBG_DISP>,
				<&disp0b_dispsys_config_clk MM0B_DISP_AAL0_DISP>,
				<&disp0b_dispsys_config_clk MM0B_DISP_C3D0_DISP>,
				<&disp0b_dispsys_config_clk MM0B_DISP_C3D1_DISP>,
				<&disp0b_dispsys_config_clk MM0B_DISP_CCORR0_DISP>,
				<&disp0b_dispsys_config_clk MM0B_DISP_CCORR1_DISP>,
				<&disp0b_dispsys_config_clk MM0B_DISP_COLOR0_DISP>,
				<&disp0b_dispsys_config_clk MM0B_DISP_DITHER0_DISP>,
				<&disp0b_dispsys_config_clk MM0B_DISP_DITHER1_DISP>,
				<&disp0b_dispsys_config_clk MM0B_DISP_DLI_ASYNC0_DISP>,
				<&disp0b_dispsys_config_clk MM0B_DISP_DLI_ASYNC1_DISP>,
				<&disp0b_dispsys_config_clk MM0B_DISP_DLI_ASYNC2_DISP>,
				<&disp0b_dispsys_config_clk MM0B_DISP_DLI_ASYNC3_DISP>,
				<&disp0b_dispsys_config_clk MM0B_DISP_DLI_ASYNC4_DISP>,
				<&disp0b_dispsys_config_clk MM0B_DISP_DLI_ASYNC5_DISP>,
				<&disp0b_dispsys_config_clk MM0B_DISP_DLI_ASYNC6_DISP>,
				<&disp0b_dispsys_config_clk MM0B_DISP_DLI_ASYNC7_DISP>,
				<&disp0b_dispsys_config_clk MM0B_DISP_DLI_ASYNC8_DISP>,
				<&disp0b_dispsys_config_clk MM0B_DISP_DLI_ASYNC9_DISP>,
				<&disp0b_dispsys_config_clk MM0B_DISP_DLI_ASYNC10_DISP>,
				<&disp0b_dispsys_config_clk MM0B_DISP_DLI_ASYNC11_DISP>,
				<&disp0b_dispsys_config_clk MM0B_DISP_DLI_ASYNC12_DISP>,
				<&disp0b_dispsys_config_clk MM0B_DISP_DLI_ASYNC13_DISP>,
				<&disp0b_dispsys_config_clk MM0B_DISP_DLI_ASYNC14_DISP>,
				<&disp0b_dispsys_config_clk MM0B_DISP_DLI_ASYNC15_DISP>,
				<&disp0b_dispsys_config_clk MM0B_DISP_DLO_ASYNC0_DISP>,
				<&disp0b_dispsys_config_clk MM0B_DISP_DLO_ASYNC1_DISP>,
				<&disp0b_dispsys_config_clk MM0B_DISP_DLO_ASYNC2_DISP>,
				<&disp0b_dispsys_config_clk MM0B_DISP_DLO_ASYNC3_DISP>,
				<&disp0b_dispsys_config_clk MM0B_DISP_DLO_ASYNC4_DISP>,
				<&disp0b_dispsys_config_clk MM0B_DISP_DLO_ASYNC5_DISP>,
				<&disp0b_dispsys_config_clk MM0B_DISP_DLO_ASYNC6_DISP>,
				<&disp0b_dispsys_config_clk MM0B_DISP_DLO_ASYNC7_DISP>,
				<&disp0b_dispsys_config_clk MM0B_DISP_DLO_ASYNC8_DISP>,
				<&disp0b_dispsys_config_clk MM0B_DISP_DLO_ASYNC9_DISP>,
				<&disp0b_dispsys_config_clk MM0B_DISP_DLO_ASYNC10_DISP>,
				<&disp0b_dispsys_config_clk MM0B_DISP_DLO_ASYNC11_DISP>,
				<&disp0b_dispsys_config_clk MM0B_DISP_DLO_ASYNC12_DISP>,
				<&disp0b_dispsys_config_clk MM0B_DISP_DLO_ASYNC13_DISP>,
				<&disp0b_dispsys_config_clk MM0B_DISP_DLO_ASYNC14_DISP>,
				<&disp0b_dispsys_config_clk MM0B_DISP_DLO_ASYNC15_DISP>,
				<&disp0b_dispsys_config_clk MM0B_DISP_DLO_ASYNC16_DISP>,
				<&disp0b_dispsys_config_clk MM0B_DISP_DLO_ASYNC17_DISP>,
				<&disp0b_dispsys_config_clk MM0B_DISP_DLO_ASYNC18_DISP>,
				<&disp0b_dispsys_config_clk MM0B_DISP_DLO_ASYNC19_DISP>,
				<&disp0b_dispsys_config_clk MM0B_DISP_DLO_ASYNC20_DISP>,
				<&disp0b_dispsys_config_clk MM0B_DISP_RELAY5_DISP>,
				<&disp0b_dispsys_config_clk MM0B_DISP_GAMMA0_DISP>,
				<&disp0b_dispsys_config_clk MM0B_MDP_AAL0_DISP>,
				<&disp0b_dispsys_config_clk MM0B_DISP_POSTMASK0_DISP>,
				<&disp0b_dispsys_config_clk MM0B_MDP_RDMA0_DISP>,
				<&disp0b_dispsys_config_clk MM0B_DISP_SPR0_DISP>,
				<&disp0b_dispsys_config_clk MM0B_DISP_ODDMR0_DISP>,
				<&disp0b_dispsys_config_clk MM0B_MDP_RSZ0_DISP>,
				<&disp0b_dispsys_config_clk MM0B_DISP_TDSHP0_DISP>,
				<&disp0b_dispsys_config_clk MM0B_DISP_FAKE_ENG0_DISP>,
				<&disp0b_dispsys_config_clk MM0B_DISP_DBG_DISP>,
				<&ovlsys_config_clk OVL_EXDMA0_DISP>,
				<&ovlsys_config_clk OVL_EXDMA1_DISP>,
				<&ovlsys_config_clk OVL_EXDMA2_DISP>,
				<&ovlsys_config_clk OVL_EXDMA3_DISP>,
				<&ovlsys_config_clk OVL_EXDMA4_DISP>,
				<&ovlsys_config_clk OVL_EXDMA5_DISP>,
				<&ovlsys_config_clk OVL_EXDMA6_DISP>,
				<&ovlsys_config_clk OVL_EXDMA7_DISP>,
				<&ovlsys_config_clk OVL_BLENDER0_DISP>,
				<&ovlsys_config_clk OVL_BLENDER1_DISP>,
				<&ovlsys_config_clk OVL_BLENDER2_DISP>,
				<&ovlsys_config_clk OVL_BLENDER3_DISP>,
				<&ovlsys_config_clk OVL_BLENDER4_DISP>,
				<&ovlsys_config_clk OVL_BLENDER5_DISP>,
				<&ovlsys_config_clk OVL_BLENDER6_DISP>,
				<&ovlsys_config_clk OVL_BLENDER7_DISP>,
				<&ovlsys_config_clk OVL_OUTPROC0_DISP>,
				<&ovlsys_config_clk OVL_OUTPROC1_DISP>,
				<&ovlsys_config_clk OVL_OUTPROC2_DISP>,
				<&ovlsys_config_clk OVL_OUTPROC3_DISP>,
				<&ovlsys_config_clk OVL_MDP_RSZ0_DISP>,
				<&ovlsys_config_clk OVL_ODPM0_DISP>,
				<&ovlsys_config_clk OVL_INLINEROT0_DISP>,
				<&ovlsys_config_clk OVL_FAKE_ENG0_DISP>,
				<&ovlsys_config_clk OVL_FAKE_ENG1_DISP>,
				<&ovlsys_config_clk OVL_FAKE_ENG2_DISP>,
				<&ovlsys_config_clk OVL_FAKE_ENG3_DISP>,
				<&ovlsys_config_clk OVL_DLI_ASYNC0_DISP>,
				<&ovlsys_config_clk OVL_DLI_ASYNC1_DISP>,
				<&ovlsys_config_clk OVL_DLI_ASYNC2_DISP>,
				<&ovlsys_config_clk OVL_DLI_ASYNC3_DISP>,
				<&ovlsys_config_clk OVL_DLI_ASYNC4_DISP>,
				<&ovlsys_config_clk OVL_DLI_ASYNC5_DISP>,
				<&ovlsys_config_clk OVL_DLI_ASYNC6_DISP>,
				<&ovlsys_config_clk OVL_DLI_ASYNC7_DISP>,
				<&ovlsys_config_clk OVL_DLI_ASYNC8_DISP>,
				<&ovlsys_config_clk OVL_DLI_ASYNC9_DISP>,
				<&ovlsys_config_clk OVL_DLI_ASYNC10_DISP>,
				<&ovlsys_config_clk OVL_DLI_ASYNC11_DISP>,
				<&ovlsys_config_clk OVL_DLI_ASYNC12_DISP>,
				<&ovlsys_config_clk OVL_DLO_ASYNC0_DISP>,
				<&ovlsys_config_clk OVL_DLO_ASYNC1_DISP>,
				<&ovlsys_config_clk OVL_DLO_ASYNC2_DISP>,
				<&ovlsys_config_clk OVL_DLO_ASYNC3_DISP>,
				<&ovlsys_config_clk OVL_DLO_ASYNC4_DISP>,
				<&ovlsys_config_clk OVL_DLO_ASYNC5_DISP>,
				<&ovlsys_config_clk OVL_DLO_ASYNC6_DISP>,
				<&ovlsys_config_clk OVL_DLO_ASYNC7_DISP>,
				<&ovlsys_config_clk OVL_DLO_ASYNC8_DISP>,
				<&ovlsys_config_clk OVL_DLO_ASYNC9_DISP>,
				<&ovlsys_config_clk OVL_DLO_ASYNC10_DISP>,
				<&ovlsys_config_clk OVL_DLO_ASYNC11_DISP>,
				<&ovlsys_config_clk OVL_DLO_ASYNC13_DISP>,
				<&ovlsys_config_clk OVL_DLO_ASYNC14_DISP>,
				<&ovlsys_config_clk OVL_DLO_ASYNC15_DISP>,
				<&ovlsys_config_clk OVLSYS_RELAY0_DISP>,
				<&ovlsys_config_clk OVL_DISP_DBG_DISP>,
				<&ovl1_ovlsys_config_clk OVL1_OVL_EXDMA0_DISP>,
				<&ovl1_ovlsys_config_clk OVL1_OVL_EXDMA1_DISP>,
				<&ovl1_ovlsys_config_clk OVL1_OVL_EXDMA2_DISP>,
				<&ovl1_ovlsys_config_clk OVL1_OVL_EXDMA3_DISP>,
				<&ovl1_ovlsys_config_clk OVL1_OVL_EXDMA4_DISP>,
				<&ovl1_ovlsys_config_clk OVL1_OVL_EXDMA5_DISP>,
				<&ovl1_ovlsys_config_clk OVL1_OVL_EXDMA6_DISP>,
				<&ovl1_ovlsys_config_clk OVL1_OVL_EXDMA7_DISP>,
				<&ovl1_ovlsys_config_clk OVL1_OVL_BLENDER0_DISP>,
				<&ovl1_ovlsys_config_clk OVL1_OVL_BLENDER1_DISP>,
				<&ovl1_ovlsys_config_clk OVL1_OVL_BLENDER2_DISP>,
				<&ovl1_ovlsys_config_clk OVL1_OVL_BLENDER3_DISP>,
				<&ovl1_ovlsys_config_clk OVL1_OVL_BLENDER4_DISP>,
				<&ovl1_ovlsys_config_clk OVL1_OVL_BLENDER5_DISP>,
				<&ovl1_ovlsys_config_clk OVL1_OVL_BLENDER6_DISP>,
				<&ovl1_ovlsys_config_clk OVL1_OVL_BLENDER7_DISP>,
				<&ovl1_ovlsys_config_clk OVL1_OVL_OUTPROC0_DISP>,
				<&ovl1_ovlsys_config_clk OVL1_OVL_OUTPROC1_DISP>,
				<&ovl1_ovlsys_config_clk OVL1_OVL_OUTPROC2_DISP>,
				<&ovl1_ovlsys_config_clk OVL1_OVL_OUTPROC3_DISP>,
				<&ovl1_ovlsys_config_clk OVL1_OVL_MDP_RSZ0_DISP>,
				<&ovl1_ovlsys_config_clk OVL1_OVL_ODPM0_DISP>,
				<&ovl1_ovlsys_config_clk OVL1_INLINEROT0_DISP>,
				<&ovl1_ovlsys_config_clk OVL1_OVL_FAKE_ENG0_DISP>,
				<&ovl1_ovlsys_config_clk OVL1_OVL_FAKE_ENG1_DISP>,
				<&ovl1_ovlsys_config_clk OVL1_OVL_FAKE_ENG2_DISP>,
				<&ovl1_ovlsys_config_clk OVL1_OVL_FAKE_ENG3_DISP>,
				<&ovl1_ovlsys_config_clk OVL1_OVL_DLI_ASYNC0_DISP>,
				<&ovl1_ovlsys_config_clk OVL1_OVL_DLI_ASYNC1_DISP>,
				<&ovl1_ovlsys_config_clk OVL1_OVL_DLI_ASYNC2_DISP>,
				<&ovl1_ovlsys_config_clk OVL1_OVL_DLI_ASYNC3_DISP>,
				<&ovl1_ovlsys_config_clk OVL1_OVL_DLI_ASYNC4_DISP>,
				<&ovl1_ovlsys_config_clk OVL1_OVL_DLI_ASYNC5_DISP>,
				<&ovl1_ovlsys_config_clk OVL1_OVL_DLI_ASYNC6_DISP>,
				<&ovl1_ovlsys_config_clk OVL1_OVL_DLI_ASYNC7_DISP>,
				<&ovl1_ovlsys_config_clk OVL1_OVL_DLI_ASYNC8_DISP>,
				<&ovl1_ovlsys_config_clk OVL1_OVL_DLI_ASYNC9_DISP>,
				<&ovl1_ovlsys_config_clk OVL1_OVL_DLI_ASYNC10_DISP>,
				<&ovl1_ovlsys_config_clk OVL1_OVL_DLI_ASYNC11_DISP>,
				<&ovl1_ovlsys_config_clk OVL1_OVL_DLI_ASYNC12_DISP>,
				<&ovl1_ovlsys_config_clk OVL1_OVL_DLO_ASYNC0_DISP>,
				<&ovl1_ovlsys_config_clk OVL1_OVL_DLO_ASYNC1_DISP>,
				<&ovl1_ovlsys_config_clk OVL1_OVL_DLO_ASYNC2_DISP>,
				<&ovl1_ovlsys_config_clk OVL1_OVL_DLO_ASYNC3_DISP>,
				<&ovl1_ovlsys_config_clk OVL1_OVL_DLO_ASYNC4_DISP>,
				<&ovl1_ovlsys_config_clk OVL1_OVL_DLO_ASYNC5_DISP>,
				<&ovl1_ovlsys_config_clk OVL1_OVL_DLO_ASYNC6_DISP>,
				<&ovl1_ovlsys_config_clk OVL1_OVL_DLO_ASYNC7_DISP>,
				<&ovl1_ovlsys_config_clk OVL1_OVL_DLO_ASYNC8_DISP>,
				<&ovl1_ovlsys_config_clk OVL1_OVL_DLO_ASYNC9_DISP>,
				<&ovl1_ovlsys_config_clk OVL1_OVL_DLO_ASYNC10_DISP>,
				<&ovl1_ovlsys_config_clk OVL1_OVL_DLO_ASYNC11_DISP>,
				<&ovl1_ovlsys_config_clk OVL1_OVL_DLO_ASYNC12_DISP>,
				<&ovl1_ovlsys_config_clk OVL1_OVL_DLO_ASYNC13_DISP>,
				<&ovl1_ovlsys_config_clk OVL1_OVL_DLO_ASYNC14_DISP>,
				<&ovl1_ovlsys_config_clk OVL1_OVL_DLO_ASYNC15_DISP>,
				<&ovl1_ovlsys_config_clk OVL1_OVLSYS_RELAY0_DISP>,
				<&ovl1_ovlsys_config_clk OVL1_DISP_DBG_DISP>,
				<&ovl2_ovlsys_config_clk OVL2_OVL_EXDMA0_DISP>,
				<&ovl2_ovlsys_config_clk OVL2_OVL_EXDMA1_DISP>,
				<&ovl2_ovlsys_config_clk OVL2_OVL_EXDMA2_DISP>,
				<&ovl2_ovlsys_config_clk OVL2_OVL_EXDMA3_DISP>,
				<&ovl2_ovlsys_config_clk OVL2_OVL_EXDMA4_DISP>,
				<&ovl2_ovlsys_config_clk OVL2_OVL_EXDMA5_DISP>,
				<&ovl2_ovlsys_config_clk OVL2_OVL_EXDMA6_DISP>,
				<&ovl2_ovlsys_config_clk OVL2_OVL_EXDMA7_DISP>,
				<&ovl2_ovlsys_config_clk OVL2_OVL_BLENDER0_DISP>,
				<&ovl2_ovlsys_config_clk OVL2_OVL_BLENDER1_DISP>,
				<&ovl2_ovlsys_config_clk OVL2_OVL_BLENDER2_DISP>,
				<&ovl2_ovlsys_config_clk OVL2_OVL_BLENDER3_DISP>,
				<&ovl2_ovlsys_config_clk OVL2_OVL_BLENDER4_DISP>,
				<&ovl2_ovlsys_config_clk OVL2_OVL_BLENDER5_DISP>,
				<&ovl2_ovlsys_config_clk OVL2_OVL_BLENDER6_DISP>,
				<&ovl2_ovlsys_config_clk OVL2_OVL_BLENDER7_DISP>,
				<&ovl2_ovlsys_config_clk OVL2_OVL_OUTPROC0_DISP>,
				<&ovl2_ovlsys_config_clk OVL2_OVL_OUTPROC1_DISP>,
				<&ovl2_ovlsys_config_clk OVL2_OVL_OUTPROC2_DISP>,
				<&ovl2_ovlsys_config_clk OVL2_OVL_OUTPROC3_DISP>,
				<&ovl2_ovlsys_config_clk OVL2_OVL_MDP_RSZ0_DISP>,
				<&ovl2_ovlsys_config_clk OVL2_OVL_ODPM0_DISP>,
				<&ovl2_ovlsys_config_clk OVL2_INLINEROT0_DISP>,
				<&ovl2_ovlsys_config_clk OVL2_OVL_FAKE_ENG0_DISP>,
				<&ovl2_ovlsys_config_clk OVL2_OVL_FAKE_ENG1_DISP>,
				<&ovl2_ovlsys_config_clk OVL2_OVL_FAKE_ENG2_DISP>,
				<&ovl2_ovlsys_config_clk OVL2_OVL_FAKE_ENG3_DISP>,
				<&ovl2_ovlsys_config_clk OVL2_OVL_DLI_ASYNC0_DISP>,
				<&ovl2_ovlsys_config_clk OVL2_OVL_DLI_ASYNC1_DISP>,
				<&ovl2_ovlsys_config_clk OVL2_OVL_DLI_ASYNC2_DISP>,
				<&ovl2_ovlsys_config_clk OVL2_OVL_DLI_ASYNC3_DISP>,
				<&ovl2_ovlsys_config_clk OVL2_OVL_DLI_ASYNC4_DISP>,
				<&ovl2_ovlsys_config_clk OVL2_OVL_DLI_ASYNC5_DISP>,
				<&ovl2_ovlsys_config_clk OVL2_OVL_DLI_ASYNC6_DISP>,
				<&ovl2_ovlsys_config_clk OVL2_OVL_DLI_ASYNC7_DISP>,
				<&ovl2_ovlsys_config_clk OVL2_OVL_DLI_ASYNC8_DISP>,
				<&ovl2_ovlsys_config_clk OVL2_OVL_DLI_ASYNC9_DISP>,
				<&ovl2_ovlsys_config_clk OVL2_OVL_DLI_ASYNC10_DISP>,
				<&ovl2_ovlsys_config_clk OVL2_OVL_DLI_ASYNC11_DISP>,
				<&ovl2_ovlsys_config_clk OVL2_OVL_DLI_ASYNC12_DISP>,
				<&ovl2_ovlsys_config_clk OVL2_OVL_DLO_ASYNC0_DISP>,
				<&ovl2_ovlsys_config_clk OVL2_OVL_DLO_ASYNC1_DISP>,
				<&ovl2_ovlsys_config_clk OVL2_OVL_DLO_ASYNC2_DISP>,
				<&ovl2_ovlsys_config_clk OVL2_OVL_DLO_ASYNC3_DISP>,
				<&ovl2_ovlsys_config_clk OVL2_OVL_DLO_ASYNC4_DISP>,
				<&ovl2_ovlsys_config_clk OVL2_OVL_DLO_ASYNC5_DISP>,
				<&ovl2_ovlsys_config_clk OVL2_OVL_DLO_ASYNC6_DISP>,
				<&ovl2_ovlsys_config_clk OVL2_OVL_DLO_ASYNC7_DISP>,
				<&ovl2_ovlsys_config_clk OVL2_OVL_DLO_ASYNC8_DISP>,
				<&ovl2_ovlsys_config_clk OVL2_OVL_DLO_ASYNC9_DISP>,
				<&ovl2_ovlsys_config_clk OVL2_OVL_DLO_ASYNC10_DISP>,
				<&ovl2_ovlsys_config_clk OVL2_OVL_DLO_ASYNC11_DISP>,
				<&ovl2_ovlsys_config_clk OVL2_OVL_DLO_ASYNC12_DISP>,
				<&ovl2_ovlsys_config_clk OVL2_OVL_DLO_ASYNC13_DISP>,
				<&ovl2_ovlsys_config_clk OVL2_OVL_DLO_ASYNC14_DISP>,
				<&ovl2_ovlsys_config_clk OVL2_OVL_DLO_ASYNC15_DISP>,
				<&ovl2_ovlsys_config_clk OVL2_OVLSYS_RELAY0_DISP>,
				<&ovl2_ovlsys_config_clk OVL2_DISP_DBG_DISP>,
				<&dispsys1_config_clk MM1_DISP_DLI_ASYNC21_DISP>,
				<&dispsys1_config_clk MM1_DISP_DLI_ASYNC22_DISP>,
				<&dispsys1_config_clk MM1_DISP_DLI_ASYNC23_DISP>,
				<&dispsys1_config_clk MM1_DISP_DLI_ASYNC24_DISP>,
				<&dispsys1_config_clk MM1_DISP_DLI_ASYNC25_DISP>,
				<&dispsys1_config_clk MM1_DISP_DLI_ASYNC26_DISP>,
				<&dispsys1_config_clk MM1_DISP_DLI_ASYNC27_DISP>,
				<&dispsys1_config_clk MM1_DISP_DLI_ASYNC28_DISP>,
				<&dispsys1_config_clk MM1_DISP_DLI_ASYNC31_DISP>,
				<&dispsys1_config_clk MM1_DISP_DLI_ASYNC32_DISP>,
				<&dispsys1_config_clk MM1_DISP_DLI_ASYNC33_DISP>,
				<&dispsys1_config_clk MM1_DISP_DLI_ASYNC34_DISP>,
				<&dispsys1_config_clk MM1_DISP_DLI_ASYNC35_DISP>,
				<&dispsys1_config_clk MM1_DISP_DLI_ASYNC36_DISP>,
				<&dispsys1_config_clk MM1_DISP_DLI_ASYNC37_DISP>,
				<&dispsys1_config_clk MM1_DISP_DLI_ASYNC38_DISP>,
				<&dispsys1_config_clk MM1_DISP_DLO_ASYNC31_DISP>,
				<&dispsys1_config_clk MM1_DISP_DLO_ASYNC32_DISP>,
				<&dispsys1_config_clk MM1_DISP_DLO_ASYNC33_DISP>,
				<&dispsys1_config_clk MM1_DISP_DLO_ASYNC34_DISP>,
				<&dispsys1_config_clk MM1_DISP_DLO_ASYNC35_DISP>,
				<&dispsys1_config_clk MM1_DISP_DLO_ASYNC36_DISP>,
				<&dispsys1_config_clk MM1_DISP_DLO_ASYNC37_DISP>,
				<&dispsys1_config_clk MM1_DISP_DLO_ASYNC38_DISP>,
				<&dispsys1_config_clk MM1_DISP_RELAY0_DISP>,
				<&dispsys1_config_clk MM1_DISP_RELAY1_DISP>,
				<&dispsys1_config_clk MM1_DISP_RELAY2_DISP>,
				<&dispsys1_config_clk MM1_DISP_RELAY3_DISP>,
				<&dispsys1_config_clk MM1_DISP_RELAY4_DISP>,
				<&dispsys1_config_clk MM1_DISP_DSI1_DISP>,
				<&dispsys1_config_clk MM1_DISP_DVO0_DISP>,
				<&dispsys1_config_clk MM1_DISP_WDMA0_DISP>,
				<&dispsys1_config_clk MM1_DISP_WDMA1_DISP>,
				<&dispsys1_config_clk MM1_DISP_DBI_COUNT0_DISP>,
				<&dispsys1_config_clk MM1_DISP_CHIST0_DISP>,
				<&dispsys1_config_clk MM1_DISP_CHIST1_DISP>,
				<&dispsys1_config_clk MM1_DISP_CHIST2_DISP>,
				<&dispsys1_config_clk MM1_DISP_POSTALIGN0_DISP>,
				<&dispsys1_config_clk MM1_DISP_SPLITTER0_DISP>,
				<&dispsys1_config_clk MM1_DISP_SPLITTER1_DISP>,
				<&dispsys1_config_clk MM1_DISP_DSC_WRAP0_DISP>,
				<&dispsys1_config_clk MM1_DISP_DSC_WRAP1_DISP>,
				<&dispsys1_config_clk MM1_DISP_R2Y0_DISP>,
				<&dispsys1_config_clk MM1_DISP_GDMA0_DISP>,
				<&dispsys1_config_clk MM1_DISP_MERGE0_DISP>,
				<&dispsys1_config_clk MM1_DISP_MERGE1_DISP>,
				<&dispsys1_config_clk MM1_DISP_FAKE_ENG1_DISP>,
				<&dispsys1_config_clk MM1_DISP_DBG_DISP>,
				<&disp1b_dispsys1_config_clk MM1B_DISP_DLI_ASYNC20_DISP>,
				<&disp1b_dispsys1_config_clk MM1B_DISP_DLI_ASYNC21_DISP>,
				<&disp1b_dispsys1_config_clk MM1B_DISP_DLI_ASYNC22_DISP>,
				<&disp1b_dispsys1_config_clk MM1B_DISP_DLI_ASYNC23_DISP>,
				<&disp1b_dispsys1_config_clk MM1B_DISP_DLI_ASYNC24_DISP>,
				<&disp1b_dispsys1_config_clk MM1B_DISP_DLI_ASYNC25_DISP>,
				<&disp1b_dispsys1_config_clk MM1B_DISP_DLI_ASYNC26_DISP>,
				<&disp1b_dispsys1_config_clk MM1B_DISP_DLI_ASYNC27_DISP>,
				<&disp1b_dispsys1_config_clk MM1B_DISP_DLI_ASYNC28_DISP>,
				<&disp1b_dispsys1_config_clk MM1B_DISP_DLI_ASYNC29_DISP>,
				<&disp1b_dispsys1_config_clk MM1B_DISP_DLI_ASYNC30_DISP>,
				<&disp1b_dispsys1_config_clk MM1B_DISP_DLI_ASYNC31_DISP>,
				<&disp1b_dispsys1_config_clk MM1B_DISP_DLI_ASYNC32_DISP>,
				<&disp1b_dispsys1_config_clk MM1B_DISP_DLI_ASYNC33_DISP>,
				<&disp1b_dispsys1_config_clk MM1B_DISP_DLI_ASYNC34_DISP>,
				<&disp1b_dispsys1_config_clk MM1B_DISP_DLI_ASYNC35_DISP>,
				<&disp1b_dispsys1_config_clk MM1B_DISP_DLI_ASYNC36_DISP>,
				<&disp1b_dispsys1_config_clk MM1B_DISP_DLI_ASYNC37_DISP>,
				<&disp1b_dispsys1_config_clk MM1B_DISP_DLI_ASYNC38_DISP>,
				<&disp1b_dispsys1_config_clk MM1B_DISP_DLO_ASYNC31_DISP>,
				<&disp1b_dispsys1_config_clk MM1B_DISP_DLO_ASYNC32_DISP>,
				<&disp1b_dispsys1_config_clk MM1B_DISP_DLO_ASYNC33_DISP>,
				<&disp1b_dispsys1_config_clk MM1B_DISP_DLO_ASYNC34_DISP>,
				<&disp1b_dispsys1_config_clk MM1B_DISP_DLO_ASYNC35_DISP>,
				<&disp1b_dispsys1_config_clk MM1B_DISP_DLO_ASYNC36_DISP>,
				<&disp1b_dispsys1_config_clk MM1B_DISP_DLO_ASYNC37_DISP>,
				<&disp1b_dispsys1_config_clk MM1B_DISP_DLO_ASYNC38_DISP>,
				<&disp1b_dispsys1_config_clk MM1B_DISP_RELAY0_DISP>,
				<&disp1b_dispsys1_config_clk MM1B_DISP_RELAY1_DISP>,
				<&disp1b_dispsys1_config_clk MM1B_DISP_RELAY2_DISP>,
				<&disp1b_dispsys1_config_clk MM1B_DISP_RELAY3_DISP>,
				<&disp1b_dispsys1_config_clk MM1B_DISP_RELAY4_DISP>,
				<&disp1b_dispsys1_config_clk MM1B_DISP_DSI0_DISP>,
				<&disp1b_dispsys1_config_clk MM1B_DISP_DSI1_DISP>,
				<&disp1b_dispsys1_config_clk MM1B_DISP_DVO0_DISP>,
				<&disp1b_dispsys1_config_clk MM1B_DISP_WDMA0_DISP>,
				<&disp1b_dispsys1_config_clk MM1B_DISP_WDMA1_DISP>,
				<&disp1b_dispsys1_config_clk MM1B_DISP_DBI_COUNT0_DISP>,
				<&disp1b_dispsys1_config_clk MM1B_DISP_CHIST0_DISP>,
				<&disp1b_dispsys1_config_clk MM1B_DISP_CHIST1_DISP>,
				<&disp1b_dispsys1_config_clk MM1B_DISP_CHIST2_DISP>,
				<&disp1b_dispsys1_config_clk MM1B_DISP_POSTALIGN0_DISP>,
				<&disp1b_dispsys1_config_clk MM1B_DISP_SPLITTER0_DISP>,
				<&disp1b_dispsys1_config_clk MM1B_DISP_SPLITTER1_DISP>,
				<&disp1b_dispsys1_config_clk MM1B_DISP_DSC_WRAP0_DISP>,
				<&disp1b_dispsys1_config_clk MM1B_DISP_DSC_WRAP1_DISP>,
				<&disp1b_dispsys1_config_clk MM1B_DISP_R2Y0_DISP>,
				<&disp1b_dispsys1_config_clk MM1B_DISP_GDMA0_DISP>,
				<&disp1b_dispsys1_config_clk MM1B_DISP_MERGE0_DISP>,
				<&disp1b_dispsys1_config_clk MM1B_DISP_MERGE1_DISP>,
				<&disp1b_dispsys1_config_clk MM1B_DISP_FAKE_ENG1_DISP>,
				<&disp1b_dispsys1_config_clk MM1B_DISP_DBG_DISP>,
				<&dispsys1_config_clk MM1_DISP_DLI_ASYNC20_DISP>,
				<&dispsys1_config_clk MM1_DISP_DLI_ASYNC29_DISP>,
				<&dispsys1_config_clk MM1_DISP_DLI_ASYNC30_DISP>,
				<&ovlsys_config_clk OVL_DLO_ASYNC12_DISP>,
				<&dispsys_config_clk MM0_DISP_DLI_ASYNC0_DISP>,
				<&dispsys_config_clk MM0_DISP_DLO_ASYNC0_DISP>,
				<&dispsys_config_clk MM0_DISP_DLO_ASYNC16_DISP>;
		};
	};
};
