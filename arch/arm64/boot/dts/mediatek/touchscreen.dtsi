/*
 * Copyright (C) 2010 - 2023 Novatek, Inc.
 *
 * $Revision$
 * $Date$
 *
 * This program is free software; you can redistribute it and/or modify
 * it under the terms of the GNU General Public License as published by
 * the Free Software Foundation; either version 2 of the License, or
 * (at your option) any later version.
 *
 * This program is distributed in the hope that it will be useful, but WITHOUT
 * ANY WARRANTY; without even the implied warranty of MERCHANTABILITY or
 * FITNESS FOR A PARTICULAR PURPOSE.  See the GNU General Public License for
 * more details.
 *
 */


&spi0 {
	status = "okay";
	#address-cells = <1>;
	#size-cells = <0>;

	touch@0 {
		compatible = "novatek,NVT-ts-spi","focaltech,fts","chipone-tddi";
		reg = <0>; //Same as CS ID
		status = "ok";

		spi-max-frequency = <9600000>;	//4800000,9600000,15000000,19200000
/*************** Chipone TDDI touchscreen driver device tree source include file ***************/
		chipone,rst-gpio = <&pio 92 0x00>;
		chipone,irq-gpio = <&pio 1 0x2001>;
		//chipone,cs-gpio = <&msm_gpio 8 0>;
		chipone,x-res = <720>;
		chipone,y-res = <1600>;

        /* Charger detect */
		chipone,touch-charger-detect-enable;
		chipone,touch-charger-detect-type = "notify"; /* notify, poll */
		chipone,touch-charger-detect-psy-name = "charger";
		chipone,touch-charger-detect-psp = "POWER_SUPPLY_PROP_ONLINE";
		chipone,touch-charger-detect-psp-poll-interval = <1000>;

        /* Earjack detect */
		chipone,touch-earjack-detect-enable;
		/* MTK:  /sys/bus/platform/drivers/Accdet_Driver/state,
		Sprd: /sys/kernel/headset/state
		QCOM: None, and disable it */
		chipone,touch-earjack-state-filepath = "/sys/bus/platform/drivers/Accdet_Driver/state";
		chipone,touch-earjack-poll-interval = <1000>;

        /* For tp selftest */
		chipone,test-reset-pin;
		chipone,test-int-pin;
		chipone,test-rawdata;
		chipone,test-rawdata-frames      = <1>;
		chipone,rawdata-min              = <1110>;
		chipone,rawdata-max              = <3010>;
		chipone,test-noise;
		chipone,test-noise-frames        = <50>;
		chipone,noise-max                = <120>;
		chipone,test-open;
		chipone,open-min                 = <1700>;
		chipone,test-short;
		chipone,short-min                = <1800>;
		chipone,test-compensate-cap;
		chipone,compensate-cap-min       = <1>;
		chipone,compensate-cap-max       = <127>;

		/* gesture data test */
		chipone,test-gesture-rawdata;
		chipone,test-gesture-rawdata-frames = <1>;
		chipone,gesture-rawdata-min = <100>;
		chipone,gesture-rawdata-max = <10000>;

		chipone,test-gesture-lp-rawdata;
		chipone,test-gesture-lp-rawdata-frames = <1>;
		chipone,gesture-lp-rawdata-min = <100>;
		chipone,gesture-lp-rawdata-max = <10000>;

		chipone,test-gesture-noise;
		chipone,test-gesture-noise-frames = <50>;
		chipone,gesture-noise-max = <1000>;

		chipone,test-gesture-lp-noise;
		chipone,test-gesture-lp-noise-frames = <50>;
		chipone,gesture-lp-noise-max = <1000>;
		/*************** Focaltech FT8057M device tree ***************/
		focaltech,reset-gpio = <&pio 92 0x00>;
		focaltech,irq-gpio = <&pio 1 0x2001>;
		focaltech,max-touch-number = <10>;
		focaltech,display-coords =  <0 0 719 1599>;
		/*************** Novatek NT36528 device tree ***************/
		novatek,reset-gpio = <&pio 92 0x00>;
		novatek,irq-gpio = <&pio 1 0x2001>;
		//panel = <&dsi_panel_p15a>;
		//novatek,pen-support;

		//novatek,spi-rd-fast-addr = <0x03F310>;

		/* MP */
		novatek,mp-support-dt;

		/* for Xiaomi P15A NT36528A CSOT 6.9" panel module */
		novatek-mp-criteria-59AE@0 {
			#address-cells = <1>;
			#size-cells = <0>;
			compatible = "novatek-mp-criteria-59AE";

			/* MP Config */
			IC_X_CFG_SIZE = <18>;
			IC_Y_CFG_SIZE = <32>;
			IC_KEY_CFG_SIZE = <4>;
			X_Channel = <18>;
			Y_Channel = <32>;
			AIN_X = <0 1 2 3 4 5 6 7 8 9 10 11 12 13 14 15 16 17>;
			AIN_Y = <0 1 2 3 4 5 6 7 8 9 10 11 12 13 14 15 16 17 18 19 20 21 22 23 24 25 26 27 28 29 30 31>;
			AIN_KEY = <0 1 2 0xFF>;

			/* MP Criteria */
			PS_Config_Lmt_Short_Rawdata_P = <
				14008 14008 14008 14008 14008 14008 14008 14008 14008 14008 14008 14008 14008 14008 14008 14008 14008 14008
				14008 14008 14008 14008 14008 14008 14008 14008 14008 14008 14008 14008 14008 14008 14008 14008 14008 14008
				14008 14008 14008 14008 14008 14008 14008 14008 14008 14008 14008 14008 14008 14008 14008 14008 14008 14008
				14008 14008 14008 14008 14008 14008 14008 14008 14008 14008 14008 14008 14008 14008 14008 14008 14008 14008
				14008 14008 14008 14008 14008 14008 14008 14008 14008 14008 14008 14008 14008 14008 14008 14008 14008 14008
				14008 14008 14008 14008 14008 14008 14008 14008 14008 14008 14008 14008 14008 14008 14008 14008 14008 14008
				14008 14008 14008 14008 14008 14008 14008 14008 14008 14008 14008 14008 14008 14008 14008 14008 14008 14008
				14008 14008 14008 14008 14008 14008 14008 14008 14008 14008 14008 14008 14008 14008 14008 14008 14008 14008
				14008 14008 14008 14008 14008 14008 14008 14008 14008 14008 14008 14008 14008 14008 14008 14008 14008 14008
				14008 14008 14008 14008 14008 14008 14008 14008 14008 14008 14008 14008 14008 14008 14008 14008 14008 14008
				14008 14008 14008 14008 14008 14008 14008 14008 14008 14008 14008 14008 14008 14008 14008 14008 14008 14008
				14008 14008 14008 14008 14008 14008 14008 14008 14008 14008 14008 14008 14008 14008 14008 14008 14008 14008
				14008 14008 14008 14008 14008 14008 14008 14008 14008 14008 14008 14008 14008 14008 14008 14008 14008 14008
				14008 14008 14008 14008 14008 14008 14008 14008 14008 14008 14008 14008 14008 14008 14008 14008 14008 14008
				14008 14008 14008 14008 14008 14008 14008 14008 14008 14008 14008 14008 14008 14008 14008 14008 14008 14008
				14008 14008 14008 14008 14008 14008 14008 14008 14008 14008 14008 14008 14008 14008 14008 14008 14008 14008
				14008 14008 14008 14008 14008 14008 14008 14008 14008 14008 14008 14008 14008 14008 14008 14008 14008 14008
				14008 14008 14008 14008 14008 14008 14008 14008 14008 14008 14008 14008 14008 14008 14008 14008 14008 14008
				14008 14008 14008 14008 14008 14008 14008 14008 14008 14008 14008 14008 14008 14008 14008 14008 14008 14008
				14008 14008 14008 14008 14008 14008 14008 14008 14008 14008 14008 14008 14008 14008 14008 14008 14008 14008
				14008 14008 14008 14008 14008 14008 14008 14008 14008 14008 14008 14008 14008 14008 14008 14008 14008 14008
				14008 14008 14008 14008 14008 14008 14008 14008 14008 14008 14008 14008 14008 14008 14008 14008 14008 14008
				14008 14008 14008 14008 14008 14008 14008 14008 14008 14008 14008 14008 14008 14008 14008 14008 14008 14008
				14008 14008 14008 14008 14008 14008 14008 14008 14008 14008 14008 14008 14008 14008 14008 14008 14008 14008
				14008 14008 14008 14008 14008 14008 14008 14008 14008 14008 14008 14008 14008 14008 14008 14008 14008 14008
				14008 14008 14008 14008 14008 14008 14008 14008 14008 14008 14008 14008 14008 14008 14008 14008 14008 14008
				14008 14008 14008 14008 14008 14008 14008 14008 14008 14008 14008 14008 14008 14008 14008 14008 14008 14008
				14008 14008 14008 14008 14008 14008 14008 14008 14008 14008 14008 14008 14008 14008 14008 14008 14008 14008
				14008 14008 14008 14008 14008 14008 14008 14008 14008 14008 14008 14008 14008 14008 14008 14008 14008 14008
				14008 14008 14008 14008 14008 14008 14008 14008 14008 14008 14008 14008 14008 14008 14008 14008 14008 14008
				14008 14008 14008 14008 14008 14008 14008 14008 14008 14008 14008 14008 14008 14008 14008 14008 14008 14008
				14008 14008 14008 14008 14008 14008 14008 14008 14008 14008 14008 14008 14008 14008 14008 14008 14008 14008
				14008 14008 14008>;

			PS_Config_Lmt_Short_Rawdata_N = <
				10100 10100 10100 10100 10100 10100 10100 10100 10100 10100 10100 10100 10100 10100 10100 10100 10100 10100
				10100 10100 10100 10100 10100 10100 10100 10100 10100 10100 10100 10100 10100 10100 10100 10100 10100 10100
				10100 10100 10100 10100 10100 10100 10100 10100 10100 10100 10100 10100 10100 10100 10100 10100 10100 10100
				10100 10100 10100 10100 10100 10100 10100 10100 10100 10100 10100 10100 10100 10100 10100 10100 10100 10100
				10100 10100 10100 10100 10100 10100 10100 10100 10100 10100 10100 10100 10100 10100 10100 10100 10100 10100
				10100 10100 10100 10100 10100 10100 10100 10100 10100 10100 10100 10100 10100 10100 10100 10100 10100 10100
				10100 10100 10100 10100 10100 10100 10100 10100 10100 10100 10100 10100 10100 10100 10100 10100 10100 10100
				10100 10100 10100 10100 10100 10100 10100 10100 10100 10100 10100 10100 10100 10100 10100 10100 10100 10100
				10100 10100 10100 10100 10100 10100 10100 10100 10100 10100 10100 10100 10100 10100 10100 10100 10100 10100
				10100 10100 10100 10100 10100 10100 10100 10100 10100 10100 10100 10100 10100 10100 10100 10100 10100 10100
				10100 10100 10100 10100 10100 10100 10100 10100 10100 10100 10100 10100 10100 10100 10100 10100 10100 10100
				10100 10100 10100 10100 10100 10100 10100 10100 10100 10100 10100 10100 10100 10100 10100 10100 10100 10100
				10100 10100 10100 10100 10100 10100 10100 10100 10100 10100 10100 10100 10100 10100 10100 10100 10100 10100
				10100 10100 10100 10100 10100 10100 10100 10100 10100 10100 10100 10100 10100 10100 10100 10100 10100 10100
				10100 10100 10100 10100 10100 10100 10100 10100 10100 10100 10100 10100 10100 10100 10100 10100 10100 10100
				10100 10100 10100 10100 10100 10100 10100 10100 10100 10100 10100 10100 10100 10100 10100 10100 10100 10100
				10100 10100 10100 10100 10100 10100 10100 10100 10100 10100 10100 10100 10100 10100 10100 10100 10100 10100
				10100 10100 10100 10100 10100 10100 10100 10100 10100 10100 10100 10100 10100 10100 10100 10100 10100 10100
				10100 10100 10100 10100 10100 10100 10100 10100 10100 10100 10100 10100 10100 10100 10100 10100 10100 10100
				10100 10100 10100 10100 10100 10100 10100 10100 10100 10100 10100 10100 10100 10100 10100 10100 10100 10100
				10100 10100 10100 10100 10100 10100 10100 10100 10100 10100 10100 10100 10100 10100 10100 10100 10100 10100
				10100 10100 10100 10100 10100 10100 10100 10100 10100 10100 10100 10100 10100 10100 10100 10100 10100 10100
				10100 10100 10100 10100 10100 10100 10100 10100 10100 10100 10100 10100 10100 10100 10100 10100 10100 10100
				10100 10100 10100 10100 10100 10100 10100 10100 10100 10100 10100 10100 10100 10100 10100 10100 10100 10100
				10100 10100 10100 10100 10100 10100 10100 10100 10100 10100 10100 10100 10100 10100 10100 10100 10100 10100
				10100 10100 10100 10100 10100 10100 10100 10100 10100 10100 10100 10100 10100 10100 10100 10100 10100 10100
				10100 10100 10100 10100 10100 10100 10100 10100 10100 10100 10100 10100 10100 10100 10100 10100 10100 10100
				10100 10100 10100 10100 10100 10100 10100 10100 10100 10100 10100 10100 10100 10100 10100 10100 10100 10100
				10100 10100 10100 10100 10100 10100 10100 10100 10100 10100 10100 10100 10100 10100 10100 10100 10100 10100
				10100 10100 10100 10100 10100 10100 10100 10100 10100 10100 10100 10100 10100 10100 10100 10100 10100 10100
				10100 10100 10100 10100 10100 10100 10100 10100 10100 10100 10100 10100 10100 10100 10100 10100 10100 10100
				10100 10100 10100 10100 10100 10100 10100 10100 10100 10100 10100 10100 10100 10100 10100 10100 10100 10100
				10100 10100 10100>;

			PS_Config_Lmt_Open_Rawdata_P = <
				65535 2422 2373 2339 2275 2208 2171 65535 1907 1975 65535 2232 2261 2304 2342 2358 2408 65535
				2556 2502 2461 2429 2363 2307 2289 2241 2258 2349 2328 2373 2377 2421 2453 2464 2505 2472
				2611 2551 2520 2485 2426 2366 2335 2279 2290 2384 2353 2408 2425 2470 2499 2512 2541 2512
				2666 2601 2573 2533 2468 2415 2393 2338 2353 2408 2384 2443 2458 2498 2530 2548 2580 2563
				2688 2621 2591 2556 2492 2430 2405 2356 2366 2538 2516 2561 2584 2622 2652 2667 2699 2695
				2741 2671 2633 2600 2535 2477 2451 2393 2407 2531 2499 2554 2575 2617 2646 2663 2696 2703
				2815 2744 2712 2677 2611 2547 2524 2463 2479 2517 2499 2542 2562 2610 2638 2654 2685 2703
				2884 2815 2779 2744 2681 2619 2586 2524 2537 2583 2563 2607 2632 2674 2699 2713 2745 2771
				2915 2835 2797 2761 2699 2635 2604 2552 2563 2695 2670 2723 2740 2785 2813 2825 2856 2902
				2950 2876 2845 2801 2731 2671 2635 2573 2584 2638 2612 2663 2682 2724 2758 2775 2806 2859
				3044 2961 2927 2887 2818 2751 2720 2657 2667 2731 2694 2747 2771 2815 2849 2856 2890 2955
				3087 3002 2975 2927 2859 2794 2769 2708 2720 2738 2709 2758 2782 2822 2853 2877 2904 2976
				3142 3062 3031 2992 2915 2853 2828 2761 2785 2789 2768 2813 2838 2880 2905 2932 2955 3028
				3142 3058 3024 2983 2912 2848 2810 2752 2764 2810 2786 2835 2860 2899 2934 2955 2979 3063
				3304 3220 3184 3146 3067 3002 2974 2913 2925 2873 2852 2905 2926 2967 3002 3014 3044 3125
				3389 3308 3269 3224 3154 3088 3053 2993 3004 3017 2996 3042 3063 3104 3133 3154 3178 3268
				3437 3349 3318 3268 3202 3133 3104 3041 3046 3086 3067 3122 3146 3192 3231 3244 3266 3353
				3476 3391 3363 3310 3235 3171 3139 3076 3086 3058 3034 3088 3116 3167 3206 3227 3252 3338
				3646 3552 3524 3475 3398 3331 3300 3234 3245 3206 3181 3237 3259 3308 3342 3364 3388 3475
				3620 3538 3510 3455 3377 3314 3277 3212 3221 3261 3245 3297 3324 3370 3413 3437 3458 3539
				3690 3615 3585 3534 3462 3385 3345 3282 3294 3308 3293 3343 3368 3409 3447 3472 3497 3585
				3770 3692 3661 3608 3528 3459 3422 3357 3368 3373 3353 3401 3426 3461 3504 3521 3543 3630
				3821 3753 3718 3674 3601 3534 3493 3431 3438 3444 3422 3468 3487 3529 3576 3591 3616 3699
				3900 3849 3823 3766 3688 3620 3580 3511 3518 3490 3475 3528 3557 3602 3641 3668 3686 3773
				4018 3984 3956 3903 3821 3755 3716 3658 3661 3529 3511 3562 3598 3654 3692 3725 3746 3830
				4102 4075 4056 3991 3907 3835 3795 3725 3731 3625 3608 3655 3685 3730 3769 3794 3822 3898
				4113 4103 4067 4012 3927 3854 3818 3741 3742 3693 3685 3725 3765 3804 3839 3874 3899 3976
				3905 4221 4186 4130 4050 3970 3933 3861 3868 3766 3748 3798 3832 3877 3916 3949 3976 3745
				3976 4327 4301 4245 4169 4099 4039 3989 3993 3829 3818 3870 3900 3942 3991 4014 4042 3800
				3947 4332 4295 4235 4150 4073 4019 3958 3947 3856 3850 3899 3937 3975 4022 4047 4074 3808
				4019 4491 4456 4396 4327 4255 4199 4145 4133 3963 3945 3998 4026 4074 4115 4143 4172 3846
				4288 4346 4589 4533 4451 4378 4327 4274 4264 4049 4046 4099 4127 4172 4220 4245 4039 4094
				5120 5120 5120>;

			PS_Config_Lmt_Open_Rawdata_N = <
				(-65535) 1038 1017 1003 975 946 931 (-65535) 817 847 (-65535) 956 969 988 1004 1010 1032 (-65535)
				1096 1072 1055 1041 1013 989 981 961 968 1007 998 1017 1019 1037 1051 1056 1073 1060
				1119 1093 1080 1065 1040 1014 1001 977 982 1022 1009 1032 1039 1058 1071 1076 1089 1076
				1142 1115 1103 1085 1058 1035 1025 1002 1009 1032 1022 1047 1054 1070 1084 1092 1106 1099
				1152 1123 1111 1096 1068 1042 1031 1010 1014 1088 1078 1097 1108 1124 1136 1143 1157 1155
				1175 1145 1129 1114 1087 1061 1051 1025 1031 1085 1071 1094 1103 1121 1134 1141 1156 1159
				1207 1176 1162 1147 1119 1091 1082 1055 1063 1079 1071 1090 1098 1118 1130 1138 1151 1159
				1236 1207 1191 1176 1149 1123 1108 1082 1087 1107 1099 1117 1128 1146 1157 1163 1177 1187
				1249 1215 1199 1183 1157 1129 1116 1094 1099 1155 1144 1167 1174 1193 1205 1211 1224 1244
				1264 1232 1219 1201 1171 1145 1129 1103 1108 1130 1120 1141 1150 1168 1182 1189 1202 1225
				1304 1269 1255 1237 1208 1179 1166 1139 1143 1171 1154 1177 1187 1207 1221 1224 1238 1267
				1323 1286 1275 1255 1225 1198 1187 1160 1166 1174 1161 1182 1192 1210 1223 1233 1244 1276
				1346 1312 1299 1282 1249 1223 1212 1183 1193 1195 1186 1205 1216 1234 1245 1256 1267 1298
				1346 1310 1296 1279 1248 1220 1204 1180 1184 1204 1194 1215 1226 1243 1258 1267 1277 1313
				1416 1380 1364 1348 1315 1286 1274 1249 1253 1231 1222 1245 1254 1271 1286 1292 1304 1339
				1453 1418 1401 1382 1352 1324 1309 1283 1288 1293 1284 1304 1313 1330 1343 1352 1362 1400
				1473 1435 1422 1400 1372 1343 1330 1303 1306 1322 1315 1338 1348 1368 1385 1390 1400 1437
				1490 1453 1441 1418 1387 1359 1345 1318 1322 1310 1300 1324 1336 1357 1374 1383 1394 1430
				1562 1522 1510 1489 1456 1427 1414 1386 1391 1374 1363 1387 1397 1418 1432 1442 1452 1489
				1552 1516 1504 1481 1447 1420 1405 1376 1381 1397 1391 1413 1424 1444 1463 1473 1482 1517
				1582 1549 1537 1514 1484 1451 1433 1406 1412 1418 1411 1433 1444 1461 1477 1488 1499 1537
				1616 1582 1569 1546 1512 1483 1466 1439 1444 1445 1437 1457 1468 1483 1502 1509 1519 1556
				1637 1609 1594 1574 1543 1514 1497 1471 1474 1476 1466 1486 1495 1513 1532 1539 1550 1585
				1672 1649 1639 1614 1580 1552 1534 1505 1508 1496 1489 1512 1525 1544 1561 1572 1580 1617
				1722 1708 1696 1673 1637 1609 1592 1568 1569 1513 1505 1526 1542 1566 1582 1597 1606 1642
				1758 1747 1738 1711 1675 1643 1627 1597 1599 1553 1546 1567 1579 1598 1615 1626 1638 1670
				1763 1759 1743 1720 1683 1652 1636 1603 1604 1583 1579 1597 1613 1630 1645 1660 1671 1704
				1673 1809 1794 1770 1736 1702 1685 1655 1658 1614 1606 1628 1642 1661 1678 1693 1704 1605
				1704 1855 1843 1819 1787 1757 1731 1709 1711 1641 1636 1658 1672 1690 1711 1720 1732 1628
				1691 1856 1841 1815 1778 1745 1723 1696 1691 1652 1650 1671 1687 1703 1724 1735 1746 1632
				1723 1925 1910 1884 1855 1823 1799 1777 1771 1699 1691 1714 1726 1746 1763 1775 1788 1648
				1838 1862 1967 1943 1907 1876 1855 1832 1828 1735 1734 1757 1769 1788 1808 1819 1731 1754
				(-511) (-511) (-511)>;

			PS_Config_Lmt_FW_Rawdata_P = <
				65535 1110 1085 1082 1107 1133 1134 65535 1098 1128 65535 1114 1081 1148 1119 1126 1133 65535
				1099 1099 1128 1142 1077 1135 1096 1119 1123 1124 1130 1078 1137 1093 1138 1127 1098 1123
				1144 1141 1116 1106 1137 1093 1113 1124 1107 1091 1121 1128 1091 1145 1109 1105 1130 1088
				1141 1100 1133 1140 1107 1116 1113 1117 1102 1123 1095 1082 1141 1089 1119 1155 1105 1133
				1105 1120 1120 1130 1099 1126 1126 1102 1096 1116 1106 1106 1099 1134 1107 1110 1141 1114
				1117 1119 1106 1121 1140 1088 1127 1106 1105 1128 1131 1102 1123 1116 1099 1103 1120 1092
				1123 1091 1123 1145 1106 1116 1114 1091 1112 1106 1124 1121 1084 1154 1095 1078 1149 1117
				1119 1121 1124 1120 1109 1114 1100 1106 1138 1084 1110 1116 1120 1093 1145 1130 1089 1120
				1127 1107 1102 1128 1099 1121 1121 1095 1105 1151 1098 1081 1133 1078 1152 1114 1103 1133
				1126 1119 1114 1126 1109 1126 1095 1117 1113 1103 1119 1113 1117 1138 1107 1106 1134 1084
				1141 1084 1109 1117 1119 1096 1165 1070 1102 1114 1117 1119 1113 1134 1085 1137 1116 1078
				1099 1106 1123 1079 1114 1117 1110 1117 1124 1140 1137 1114 1092 1148 1077 1145 1120 1084
				1128 1112 1086 1128 1095 1137 1099 1100 1127 1130 1113 1092 1145 1113 1133 1116 1074 1142
				1117 1105 1093 1133 1095 1142 1121 1102 1133 1123 1123 1116 1102 1138 1088 1145 1098 1085
				1123 1149 1091 1154 1068 1137 1121 1079 1148 1103 1120 1100 1086 1128 1098 1110 1107 1099
				1105 1105 1120 1112 1133 1092 1123 1120 1095 1110 1113 1114 1110 1126 1095 1119 1119 1117
				1084 1113 1123 1098 1128 1091 1133 1128 1116 1133 1112 1071 1176 1095 1175 1078 1145 1149
				1084 1106 1163 1092 1155 1106 1121 1099 1137 1099 1126 1092 1119 1124 1103 1147 1082 1100
				1085 1106 1123 1109 1106 1099 1126 1114 1123 1131 1099 1137 1099 1173 1109 1161 1095 1093
				1140 1103 1109 1088 1117 1098 1134 1096 1121 1098 1147 1123 1092 1159 1105 1144 1099 1078
				1127 1089 1131 1086 1130 1096 1112 1156 1109 1156 1093 1127 1120 1126 1109 1161 1074 1113
				1126 1133 1103 1113 1093 1114 1089 1116 1099 1088 1163 1102 1133 1098 1120 1089 1152 1098
				1147 1095 1109 1064 1102 1131 1089 1162 1110 1119 1102 1106 1126 1086 1138 1078 1138 1106
				1109 1141 1086 1088 1119 1117 1124 1096 1144 1137 1079 1134 1103 1123 1102 1098 1133 1116
				1126 1123 1112 1134 1103 1131 1116 1093 1114 1137 1133 1102 1133 1102 1119 1096 1130 1114
				1116 1113 1107 1121 1084 1119 1098 1120 1117 1138 1148 1107 1135 1088 1145 1114 1106 1093
				1113 1107 1113 1102 1135 1086 1133 1113 1117 1103 1123 1091 1149 1081 1119 1140 1116 1098
				1084 1135 1110 1072 1137 1086 1121 1100 1088 1131 1088 1119 1100 1112 1152 1050 1128 1086
				1084 1124 1103 1082 1137 1107 1127 1098 1103 1098 1105 1109 1131 1112 1114 1126 1079 1130
				1119 1093 1149 1126 1093 1141 1119 1105 1099 1099 1116 1089 1145 1134 1092 1107 1124 1102
				1133 1100 1088 1135 1138 1099 1133 1091 1096 1137 1140 1106 1117 1123 1103 1100 1113 1116
				1121 1133 1113 1102 1113 1127 1112 1093 1072 1109 1145 1107 1124 1067 1134 1137 1127 1092
				3840 3840 3840>;

			PS_Config_Lmt_FW_Rawdata_N = <
				(-65535) 476 465 464 475 485 486 (-65535) 470 484 (-65535) 478 463 492 479 482 485 (-65535)
				471 471 484 490 461 487 470 479 481 482 484 462 487 469 488 483 470 481
				490 489 478 474 487 469 477 482 475 467 481 484 467 491 475 473 484 466
				489 472 485 488 475 478 477 479 472 481 469 464 489 467 479 495 473 485
				473 480 480 484 471 482 482 472 470 478 474 474 471 486 475 476 489 478
				479 479 474 481 488 466 483 474 473 484 485 472 481 478 471 473 480 468
				481 467 481 491 474 478 478 467 476 474 482 481 464 494 469 462 493 479
				479 481 482 480 475 478 472 474 488 464 476 478 480 469 491 484 467 480
				483 475 472 484 471 481 481 469 473 493 470 463 485 462 494 478 473 485
				482 479 478 482 475 482 469 479 477 473 479 477 479 488 475 474 486 464
				489 464 475 479 479 470 499 458 472 478 479 479 477 486 465 487 478 462
				471 474 481 463 478 479 476 479 482 488 487 478 468 492 461 491 480 464
				484 476 466 484 469 487 471 472 483 484 477 468 491 477 485 478 460 490
				479 473 469 485 469 490 481 472 485 481 481 478 472 488 466 491 470 465
				481 493 467 494 458 487 481 463 492 473 480 472 466 484 470 476 475 471
				473 473 480 476 485 468 481 480 469 476 477 478 476 482 469 479 479 479
				464 477 481 470 484 467 485 484 478 485 476 459 504 469 503 462 491 493
				464 474 499 468 495 474 481 471 487 471 482 468 479 482 473 491 464 472
				465 474 481 475 474 471 482 478 481 485 471 487 471 503 475 497 469 469
				488 473 475 466 479 470 486 470 481 470 491 481 468 497 473 490 471 462
				483 467 485 466 484 470 476 496 475 496 469 483 480 482 475 497 460 477
				482 485 473 477 469 478 467 478 471 466 499 472 485 470 480 467 494 470
				491 469 475 456 472 485 467 498 476 479 472 474 482 466 488 462 488 474
				475 489 466 466 479 479 482 470 490 487 463 486 473 481 472 470 485 478
				482 481 476 486 473 485 478 469 478 487 485 472 485 472 479 470 484 478
				478 477 475 481 464 479 470 480 479 488 492 475 487 466 491 478 474 469
				477 475 477 472 487 466 485 477 479 473 481 467 493 463 479 488 478 470
				464 487 476 460 487 466 481 472 466 485 466 479 472 476 494 450 484 466
				464 482 473 464 487 475 483 470 473 470 473 475 485 476 478 482 463 484
				479 469 493 482 469 489 479 473 471 471 478 467 491 486 468 475 482 472
				485 472 466 487 488 471 485 467 470 487 488 474 479 481 473 472 477 478
				481 485 477 472 477 483 476 469 460 475 491 475 482 457 486 487 483 468
				240 240 240>;

			PS_Config_Lmt_FW_CC_P = <
				65535 29 29 28 26 25 25 65535 22 22 65535 25 26 26 28 29 29 65535
				30 29 29 28 26 26 25 23 22 22 23 25 26 26 28 29 29 30
				30 29 29 28 26 26 25 23 23 23 23 25 26 26 28 29 29 30
				30 29 29 28 26 26 25 23 23 23 25 25 26 28 28 29 30 30
				30 29 29 28 26 26 25 23 23 23 25 26 26 28 28 29 30 30
				30 29 28 28 26 26 25 23 22 23 25 25 26 26 28 29 29 30
				30 29 29 28 26 26 25 25 23 23 25 25 26 28 28 29 30 30
				30 29 28 26 26 25 25 23 22 23 25 25 26 28 28 29 30 30
				30 29 29 28 26 26 25 25 23 23 25 25 26 28 28 29 29 30
				30 29 29 28 26 26 25 25 23 23 25 25 26 28 28 29 29 30
				30 29 29 28 26 26 25 25 23 23 25 26 26 28 29 29 30 30
				30 29 28 28 26 26 25 23 23 23 25 26 26 28 28 29 29 30
				30 29 29 28 28 26 25 25 23 23 25 26 26 28 28 29 29 30
				30 29 29 28 28 26 25 25 23 23 25 26 26 28 29 29 30 30
				30 29 29 28 28 26 26 25 23 23 25 26 26 28 28 29 29 30
				30 29 29 28 28 26 26 25 23 23 25 26 26 28 29 29 30 30
				32 30 29 29 28 28 26 26 25 25 25 26 28 28 29 29 30 30
				32 30 29 29 28 28 26 26 25 25 25 26 28 28 29 29 30 32
				32 30 30 29 29 28 26 26 25 25 26 28 28 29 29 30 30 32
				32 30 30 29 29 28 28 26 25 26 26 28 28 29 29 30 30 32
				32 32 30 30 29 29 28 28 26 26 28 28 29 29 30 30 32 32
				32 30 30 30 29 29 28 26 26 26 28 28 29 29 30 30 32 33
				33 32 30 30 30 29 29 28 28 26 28 29 29 29 30 30 32 33
				33 32 32 32 30 30 29 28 28 28 28 29 29 30 30 32 32 33
				33 33 32 32 30 30 29 29 29 28 29 29 30 30 32 32 32 33
				33 33 32 32 30 30 30 29 29 29 29 29 30 30 32 32 33 33
				34 33 33 32 32 32 30 30 29 29 29 30 30 32 32 32 33 34
				36 33 33 33 32 32 32 30 30 29 30 30 30 32 32 33 33 36
				36 34 33 33 33 32 32 32 32 30 30 30 32 32 33 33 33 36
				36 34 33 33 33 33 32 32 32 30 30 32 32 32 33 33 33 36
				36 34 34 33 33 33 32 32 32 32 32 32 33 33 34 34 34 37
				36 36 34 34 33 33 33 33 33 32 32 33 33 33 33 34 36 37
				314 314 314>;

			PS_Config_Lmt_FW_CC_N = <
				(-65535) 13 13 12 12 11 11 (-65535) 10 10 (-65535) 11 12 12 12 13 13 (-65535)
				14 13 13 12 12 12 11 11 10 10 11 11 12 12 12 13 13 14
				14 13 13 12 12 12 11 11 11 11 11 11 12 12 12 13 13 14
				14 13 13 12 12 12 11 11 11 11 11 11 12 12 12 13 14 14
				14 13 13 12 12 12 11 11 11 11 11 12 12 12 12 13 14 14
				14 13 12 12 12 12 11 11 10 11 11 11 12 12 12 13 13 14
				14 13 13 12 12 12 11 11 11 11 11 11 12 12 12 13 14 14
				14 13 12 12 12 11 11 11 10 11 11 11 12 12 12 13 14 14
				14 13 13 12 12 12 11 11 11 11 11 11 12 12 12 13 13 14
				14 13 13 12 12 12 11 11 11 11 11 11 12 12 12 13 13 14
				14 13 13 12 12 12 11 11 11 11 11 12 12 12 13 13 14 14
				14 13 12 12 12 12 11 11 11 11 11 12 12 12 12 13 13 14
				14 13 13 12 12 12 11 11 11 11 11 12 12 12 12 13 13 14
				14 13 13 12 12 12 11 11 11 11 11 12 12 12 13 13 14 14
				14 13 13 12 12 12 12 11 11 11 11 12 12 12 12 13 13 14
				14 13 13 12 12 12 12 11 11 11 11 12 12 12 13 13 14 14
				14 14 13 13 12 12 12 12 11 11 11 12 12 12 13 13 14 14
				14 14 13 13 12 12 12 12 11 11 11 12 12 12 13 13 14 14
				14 14 14 13 13 12 12 12 11 11 12 12 12 13 13 14 14 14
				14 14 14 13 13 12 12 12 11 12 12 12 12 13 13 14 14 14
				14 14 14 14 13 13 12 12 12 12 12 12 13 13 14 14 14 14
				14 14 14 14 13 13 12 12 12 12 12 12 13 13 14 14 14 15
				15 14 14 14 14 13 13 12 12 12 12 13 13 13 14 14 14 15
				15 14 14 14 14 14 13 12 12 12 12 13 13 14 14 14 14 15
				15 15 14 14 14 14 13 13 13 12 13 13 14 14 14 14 14 15
				15 15 14 14 14 14 14 13 13 13 13 13 14 14 14 14 15 15
				16 15 15 14 14 14 14 14 13 13 13 14 14 14 14 14 15 16
				16 15 15 15 14 14 14 14 14 13 14 14 14 14 14 15 15 16
				16 16 15 15 15 14 14 14 14 14 14 14 14 14 15 15 15 16
				16 16 15 15 15 15 14 14 14 14 14 14 14 14 15 15 15 16
				16 16 16 15 15 15 14 14 14 14 14 14 15 15 16 16 16 17
				16 16 16 16 15 15 15 15 15 14 14 15 15 15 15 16 16 17
				0 0 0>;

			PS_Config_Lmt_FW_Diff_P = <
				 65535 50 50 50 50 50 50 65535 50 50 65535 50 50 50 50 50 50 65535
				 50 50 50 50 50 50 50 50 50 50 50 50 50 50 50 50 50 50
				 50 50 50 50 50 50 50 50 50 50 50 50 50 50 50 50 50 50
				 50 50 50 50 50 50 50 50 50 50 50 50 50 50 50 50 50 50
				 50 50 50 50 50 50 50 50 50 50 50 50 50 50 50 50 50 50
				 50 50 50 50 50 50 50 50 50 50 50 50 50 50 50 50 50 50
				 50 50 50 50 50 50 50 50 50 50 50 50 50 50 50 50 50 50
				 50 50 50 50 50 50 50 50 50 50 50 50 50 50 50 50 50 50
				 50 50 50 50 50 50 50 50 50 50 50 50 50 50 50 50 50 50
				 50 50 50 50 50 50 50 50 50 50 50 50 50 50 50 50 50 50
				 50 50 50 50 50 50 50 50 50 50 50 50 50 50 50 50 50 50
				 50 50 50 50 50 50 50 50 50 50 50 50 50 50 50 50 50 50
				 50 50 50 50 50 50 50 50 50 50 50 50 50 50 50 50 50 50
				 50 50 50 50 50 50 50 50 50 50 50 50 50 50 50 50 50 50
				 50 50 50 50 50 50 50 50 50 50 50 50 50 50 50 50 50 50
				 50 50 50 50 50 50 50 50 50 50 50 50 50 50 50 50 50 50
				 50 50 50 50 50 50 50 50 50 50 50 50 50 50 50 50 50 50
				 50 50 50 50 50 50 50 50 50 50 50 50 50 50 50 50 50 50
				 50 50 50 50 50 50 50 50 50 50 50 50 50 50 50 50 50 50
				 50 50 50 50 50 50 50 50 50 50 50 50 50 50 50 50 50 50
				 50 50 50 50 50 50 50 50 50 50 50 50 50 50 50 50 50 50
				 50 50 50 50 50 50 50 50 50 50 50 50 50 50 50 50 50 50
				 50 50 50 50 50 50 50 50 50 50 50 50 50 50 50 50 50 50
				 50 50 50 50 50 50 50 50 50 50 50 50 50 50 50 50 50 50
				 50 50 50 50 50 50 50 50 50 50 50 50 50 50 50 50 50 50
				 50 50 50 50 50 50 50 50 50 50 50 50 50 50 50 50 50 50
				 50 50 50 50 50 50 50 50 50 50 50 50 50 50 50 50 50 50
				 50 50 50 50 50 50 50 50 50 50 50 50 50 50 50 50 50 50
				 50 50 50 50 50 50 50 50 50 50 50 50 50 50 50 50 50 50
				 50 50 50 50 50 50 50 50 50 50 50 50 50 50 50 50 50 50
				 50 50 50 50 50 50 50 50 50 50 50 50 50 50 50 50 50 50
				 50 50 50 50 50 50 50 50 50 50 50 50 50 50 50 50 50 50
				75 75 75>;

			PS_Config_Lmt_FW_Diff_N = <
				(-65535) (-50) (-50) (-50) (-50) (-50) (-50) (-65535) (-50) (-50) (-65535) (-50) (-50) (-50) (-50) (-50) (-50) (-65535)
				(-50) (-50) (-50) (-50) (-50) (-50) (-50) (-50) (-50) (-50) (-50) (-50) (-50) (-50) (-50) (-50) (-50) (-50)
				(-50) (-50) (-50) (-50) (-50) (-50) (-50) (-50) (-50) (-50) (-50) (-50) (-50) (-50) (-50) (-50) (-50) (-50)
				(-50) (-50) (-50) (-50) (-50) (-50) (-50) (-50) (-50) (-50) (-50) (-50) (-50) (-50) (-50) (-50) (-50) (-50)
				(-50) (-50) (-50) (-50) (-50) (-50) (-50) (-50) (-50) (-50) (-50) (-50) (-50) (-50) (-50) (-50) (-50) (-50)
				(-50) (-50) (-50) (-50) (-50) (-50) (-50) (-50) (-50) (-50) (-50) (-50) (-50) (-50) (-50) (-50) (-50) (-50)
				(-50) (-50) (-50) (-50) (-50) (-50) (-50) (-50) (-50) (-50) (-50) (-50) (-50) (-50) (-50) (-50) (-50) (-50)
				(-50) (-50) (-50) (-50) (-50) (-50) (-50) (-50) (-50) (-50) (-50) (-50) (-50) (-50) (-50) (-50) (-50) (-50)
				(-50) (-50) (-50) (-50) (-50) (-50) (-50) (-50) (-50) (-50) (-50) (-50) (-50) (-50) (-50) (-50) (-50) (-50)
				(-50) (-50) (-50) (-50) (-50) (-50) (-50) (-50) (-50) (-50) (-50) (-50) (-50) (-50) (-50) (-50) (-50) (-50)
				(-50) (-50) (-50) (-50) (-50) (-50) (-50) (-50) (-50) (-50) (-50) (-50) (-50) (-50) (-50) (-50) (-50) (-50)
				(-50) (-50) (-50) (-50) (-50) (-50) (-50) (-50) (-50) (-50) (-50) (-50) (-50) (-50) (-50) (-50) (-50) (-50)
				(-50) (-50) (-50) (-50) (-50) (-50) (-50) (-50) (-50) (-50) (-50) (-50) (-50) (-50) (-50) (-50) (-50) (-50)
				(-50) (-50) (-50) (-50) (-50) (-50) (-50) (-50) (-50) (-50) (-50) (-50) (-50) (-50) (-50) (-50) (-50) (-50)
				(-50) (-50) (-50) (-50) (-50) (-50) (-50) (-50) (-50) (-50) (-50) (-50) (-50) (-50) (-50) (-50) (-50) (-50)
				(-50) (-50) (-50) (-50) (-50) (-50) (-50) (-50) (-50) (-50) (-50) (-50) (-50) (-50) (-50) (-50) (-50) (-50)
				(-50) (-50) (-50) (-50) (-50) (-50) (-50) (-50) (-50) (-50) (-50) (-50) (-50) (-50) (-50) (-50) (-50) (-50)
				(-50) (-50) (-50) (-50) (-50) (-50) (-50) (-50) (-50) (-50) (-50) (-50) (-50) (-50) (-50) (-50) (-50) (-50)
				(-50) (-50) (-50) (-50) (-50) (-50) (-50) (-50) (-50) (-50) (-50) (-50) (-50) (-50) (-50) (-50) (-50) (-50)
				(-50) (-50) (-50) (-50) (-50) (-50) (-50) (-50) (-50) (-50) (-50) (-50) (-50) (-50) (-50) (-50) (-50) (-50)
				(-50) (-50) (-50) (-50) (-50) (-50) (-50) (-50) (-50) (-50) (-50) (-50) (-50) (-50) (-50) (-50) (-50) (-50)
				(-50) (-50) (-50) (-50) (-50) (-50) (-50) (-50) (-50) (-50) (-50) (-50) (-50) (-50) (-50) (-50) (-50) (-50)
				(-50) (-50) (-50) (-50) (-50) (-50) (-50) (-50) (-50) (-50) (-50) (-50) (-50) (-50) (-50) (-50) (-50) (-50)
				(-50) (-50) (-50) (-50) (-50) (-50) (-50) (-50) (-50) (-50) (-50) (-50) (-50) (-50) (-50) (-50) (-50) (-50)
				(-50) (-50) (-50) (-50) (-50) (-50) (-50) (-50) (-50) (-50) (-50) (-50) (-50) (-50) (-50) (-50) (-50) (-50)
				(-50) (-50) (-50) (-50) (-50) (-50) (-50) (-50) (-50) (-50) (-50) (-50) (-50) (-50) (-50) (-50) (-50) (-50)
				(-50) (-50) (-50) (-50) (-50) (-50) (-50) (-50) (-50) (-50) (-50) (-50) (-50) (-50) (-50) (-50) (-50) (-50)
				(-50) (-50) (-50) (-50) (-50) (-50) (-50) (-50) (-50) (-50) (-50) (-50) (-50) (-50) (-50) (-50) (-50) (-50)
				(-50) (-50) (-50) (-50) (-50) (-50) (-50) (-50) (-50) (-50) (-50) (-50) (-50) (-50) (-50) (-50) (-50) (-50)
				(-50) (-50) (-50) (-50) (-50) (-50) (-50) (-50) (-50) (-50) (-50) (-50) (-50) (-50) (-50) (-50) (-50) (-50)
				(-50) (-50) (-50) (-50) (-50) (-50) (-50) (-50) (-50) (-50) (-50) (-50) (-50) (-50) (-50) (-50) (-50) (-50)
				(-50) (-50) (-50) (-50) (-50) (-50) (-50) (-50) (-50) (-50) (-50) (-50) (-50) (-50) (-50) (-50) (-50) (-50)
				(-75) (-75) (-75)>;

			PS_Config_Diff_Test_Frame = <50>;
		};
		
		/* for Xiaomi P15A NT36528A Truly 6.9" panel module */
		novatek-mp-criteria-59AF@0 {
			#address-cells = <1>;
			#size-cells = <0>;
			compatible = "novatek-mp-criteria-59AF";

			/* MP Config */
			IC_X_CFG_SIZE = <18>;
			IC_Y_CFG_SIZE = <32>;
			IC_KEY_CFG_SIZE = <4>;
			X_Channel = <18>;
			Y_Channel = <32>;
			AIN_X = <0 1 2 3 4 5 6 7 8 9 10 11 12 13 14 15 16 17>;
			AIN_Y = <0 1 2 3 4 5 6 7 8 9 10 11 12 13 14 15 16 17 18 19 20 21 22 23 24 25 26 27 28 29 30 31>;
			AIN_KEY = <0 1 2 0xFF>;

			/* MP Criteria 250513 3rd spec with Truly P2.0 panel phone data*/
			PS_Config_Lmt_Short_Rawdata_P = <
				14008	14008	14008	14008	14008	14008	14008	14008	14008	14008	14008	14008	14008	14008	14008	14008	14008	14008
				14008	14008	14008	14008	14008	14008	14008	14008	14008	14008	14008	14008	14008	14008	14008	14008	14008	14008
				14008	14008	14008	14008	14008	14008	14008	14008	14008	14008	14008	14008	14008	14008	14008	14008	14008	14008
				14008	14008	14008	14008	14008	14008	14008	14008	14008	14008	14008	14008	14008	14008	14008	14008	14008	14008
				14008	14008	14008	14008	14008	14008	14008	14008	14008	14008	14008	14008	14008	14008	14008	14008	14008	14008
				14008	14008	14008	14008	14008	14008	14008	14008	14008	14008	14008	14008	14008	14008	14008	14008	14008	14008
				14008	14008	14008	14008	14008	14008	14008	14008	14008	14008	14008	14008	14008	14008	14008	14008	14008	14008
				14008	14008	14008	14008	14008	14008	14008	14008	14008	14008	14008	14008	14008	14008	14008	14008	14008	14008
				14008	14008	14008	14008	14008	14008	14008	14008	14008	14008	14008	14008	14008	14008	14008	14008	14008	14008
				14008	14008	14008	14008	14008	14008	14008	14008	14008	14008	14008	14008	14008	14008	14008	14008	14008	14008
				14008	14008	14008	14008	14008	14008	14008	14008	14008	14008	14008	14008	14008	14008	14008	14008	14008	14008
				14008	14008	14008	14008	14008	14008	14008	14008	14008	14008	14008	14008	14008	14008	14008	14008	14008	14008
				14008	14008	14008	14008	14008	14008	14008	14008	14008	14008	14008	14008	14008	14008	14008	14008	14008	14008
				14008	14008	14008	14008	14008	14008	14008	14008	14008	14008	14008	14008	14008	14008	14008	14008	14008	14008
				14008	14008	14008	14008	14008	14008	14008	14008	14008	14008	14008	14008	14008	14008	14008	14008	14008	14008
				14008	14008	14008	14008	14008	14008	14008	14008	14008	14008	14008	14008	14008	14008	14008	14008	14008	14008
				14008	14008	14008	14008	14008	14008	14008	14008	14008	14008	14008	14008	14008	14008	14008	14008	14008	14008
				14008	14008	14008	14008	14008	14008	14008	14008	14008	14008	14008	14008	14008	14008	14008	14008	14008	14008
				14008	14008	14008	14008	14008	14008	14008	14008	14008	14008	14008	14008	14008	14008	14008	14008	14008	14008
				14008	14008	14008	14008	14008	14008	14008	14008	14008	14008	14008	14008	14008	14008	14008	14008	14008	14008
				14008	14008	14008	14008	14008	14008	14008	14008	14008	14008	14008	14008	14008	14008	14008	14008	14008	14008
				14008	14008	14008	14008	14008	14008	14008	14008	14008	14008	14008	14008	14008	14008	14008	14008	14008	14008
				14008	14008	14008	14008	14008	14008	14008	14008	14008	14008	14008	14008	14008	14008	14008	14008	14008	14008
				14008	14008	14008	14008	14008	14008	14008	14008	14008	14008	14008	14008	14008	14008	14008	14008	14008	14008
				14008	14008	14008	14008	14008	14008	14008	14008	14008	14008	14008	14008	14008	14008	14008	14008	14008	14008
				14008	14008	14008	14008	14008	14008	14008	14008	14008	14008	14008	14008	14008	14008	14008	14008	14008	14008
				14008	14008	14008	14008	14008	14008	14008	14008	14008	14008	14008	14008	14008	14008	14008	14008	14008	14008
				14008	14008	14008	14008	14008	14008	14008	14008	14008	14008	14008	14008	14008	14008	14008	14008	14008	14008
				14008	14008	14008	14008	14008	14008	14008	14008	14008	14008	14008	14008	14008	14008	14008	14008	14008	14008
				14008	14008	14008	14008	14008	14008	14008	14008	14008	14008	14008	14008	14008	14008	14008	14008	14008	14008
				14008	14008	14008	14008	14008	14008	14008	14008	14008	14008	14008	14008	14008	14008	14008	14008	14008	14008
				14008	14008	14008	14008	14008	14008	14008	14008	14008	14008	14008	14008	14008	14008	14008	14008	14008	14008
				14008 14008 14008>;

			PS_Config_Lmt_Short_Rawdata_N = <
				10100	10100	10100	10100	10100	10100	10100	10100	10100	10100	10100	10100	10100	10100	10100	10100	10100	10100
				10100	10100	10100	10100	10100	10100	10100	10100	10100	10100	10100	10100	10100	10100	10100	10100	10100	10100
				10100	10100	10100	10100	10100	10100	10100	10100	10100	10100	10100	10100	10100	10100	10100	10100	10100	10100
				10100	10100	10100	10100	10100	10100	10100	10100	10100	10100	10100	10100	10100	10100	10100	10100	10100	10100
				10100	10100	10100	10100	10100	10100	10100	10100	10100	10100	10100	10100	10100	10100	10100	10100	10100	10100
				10100	10100	10100	10100	10100	10100	10100	10100	10100	10100	10100	10100	10100	10100	10100	10100	10100	10100
				10100	10100	10100	10100	10100	10100	10100	10100	10100	10100	10100	10100	10100	10100	10100	10100	10100	10100
				10100	10100	10100	10100	10100	10100	10100	10100	10100	10100	10100	10100	10100	10100	10100	10100	10100	10100
				10100	10100	10100	10100	10100	10100	10100	10100	10100	10100	10100	10100	10100	10100	10100	10100	10100	10100
				10100	10100	10100	10100	10100	10100	10100	10100	10100	10100	10100	10100	10100	10100	10100	10100	10100	10100
				10100	10100	10100	10100	10100	10100	10100	10100	10100	10100	10100	10100	10100	10100	10100	10100	10100	10100
				10100	10100	10100	10100	10100	10100	10100	10100	10100	10100	10100	10100	10100	10100	10100	10100	10100	10100
				10100	10100	10100	10100	10100	10100	10100	10100	10100	10100	10100	10100	10100	10100	10100	10100	10100	10100
				10100	10100	10100	10100	10100	10100	10100	10100	10100	10100	10100	10100	10100	10100	10100	10100	10100	10100
				10100	10100	10100	10100	10100	10100	10100	10100	10100	10100	10100	10100	10100	10100	10100	10100	10100	10100
				10100	10100	10100	10100	10100	10100	10100	10100	10100	10100	10100	10100	10100	10100	10100	10100	10100	10100
				10100	10100	10100	10100	10100	10100	10100	10100	10100	10100	10100	10100	10100	10100	10100	10100	10100	10100
				10100	10100	10100	10100	10100	10100	10100	10100	10100	10100	10100	10100	10100	10100	10100	10100	10100	10100
				10100	10100	10100	10100	10100	10100	10100	10100	10100	10100	10100	10100	10100	10100	10100	10100	10100	10100
				10100	10100	10100	10100	10100	10100	10100	10100	10100	10100	10100	10100	10100	10100	10100	10100	10100	10100
				10100	10100	10100	10100	10100	10100	10100	10100	10100	10100	10100	10100	10100	10100	10100	10100	10100	10100
				10100	10100	10100	10100	10100	10100	10100	10100	10100	10100	10100	10100	10100	10100	10100	10100	10100	10100
				10100	10100	10100	10100	10100	10100	10100	10100	10100	10100	10100	10100	10100	10100	10100	10100	10100	10100
				10100	10100	10100	10100	10100	10100	10100	10100	10100	10100	10100	10100	10100	10100	10100	10100	10100	10100
				10100	10100	10100	10100	10100	10100	10100	10100	10100	10100	10100	10100	10100	10100	10100	10100	10100	10100
				10100	10100	10100	10100	10100	10100	10100	10100	10100	10100	10100	10100	10100	10100	10100	10100	10100	10100
				10100	10100	10100	10100	10100	10100	10100	10100	10100	10100	10100	10100	10100	10100	10100	10100	10100	10100
				10100	10100	10100	10100	10100	10100	10100	10100	10100	10100	10100	10100	10100	10100	10100	10100	10100	10100
				10100	10100	10100	10100	10100	10100	10100	10100	10100	10100	10100	10100	10100	10100	10100	10100	10100	10100
				10100	10100	10100	10100	10100	10100	10100	10100	10100	10100	10100	10100	10100	10100	10100	10100	10100	10100
				10100	10100	10100	10100	10100	10100	10100	10100	10100	10100	10100	10100	10100	10100	10100	10100	10100	10100
				10100	10100	10100	10100	10100	10100	10100	10100	10100	10100	10100	10100	10100	10100	10100	10100	10100	10100
				10000 10000 10000>;

			PS_Config_Lmt_Open_Rawdata_P = <
				65535	2857	2874	2864	2841	2813	2803	2744	65535	65535	2720	2759	2771	2775	2773	2772	2754	65535
				2971	2990	2978	2968	2941	2898	2890	2867	2863	2752	2750	2754	2762	2790	2794	2793	2797	2832 
				3011	3027	3021	3017	2995	2968	2955	2939	2927	2794	2803	2814	2817	2831	2835	2825	2827	2866 
				2948	2983	2976	2965	2939	2913	2899	2885	2869	2792	2801	2808	2815	2825	2828	2824	2831	2870 
				3028	3077	3067	3058	3038	3013	2999	2985	2968	2856	2860	2873	2876	2894	2901	2891	2898	2932 
				3100	3156	3140	3130	3105	3080	3067	3053	3041	2878	2883	2892	2895	2905	2908	2898	2911	2939 
				3003	3023	2979	2971	2943	2908	2905	2883	2873	2982	2988	2999	2986	2995	3000	2990	3027	2916 
				3063	3065	3030	3020	2992	2961	2954	2939	2922	3010	3018	3025	3024	3032	3032	3024	3052	2955 
				3076	3077	3042	3030	3009	2986	2985	2975	2958	3039	3045	3059	3051	3066	3065	3052	3083	2996 
				3132	3128	3095	3081	3055	3031	3028	3013	2995	3041	3051	3062	3055	3066	3067	3055	3081	3011 
				3172	3164	3129	3122	3094	3069	3067	3051	3035	3139	3153	3161	3164	3177	3177	3164	3193	3132 
				3223	3210	3175	3165	3136	3108	3105	3083	3072	3165	3174	3185	3185	3196	3198	3189	3220	3171 
				3248	3228	3192	3185	3157	3129	3132	3109	3101	3133	3149	3150	3146	3160	3156	3142	3170	3133 
				3319	3305	3265	3261	3235	3205	3199	3182	3168	3192	3209	3214	3221	3237	3238	3231	3258	3224 
				3353	3335	3297	3293	3266	3237	3231	3214	3202	3315	3324	3336	3326	3342	3347	3333	3368	3364 
				3410	3389	3356	3345	3318	3298	3293	3280	3263	3235	3245	3252	3249	3259	3268	3261	3291	3290 
				3473	3450	3419	3412	3392	3366	3361	3345	3326	3353	3356	3370	3367	3378	3377	3360	3391	3403 
				3532	3504	3476	3461	3431	3402	3398	3373	3356	3350	3357	3373	3368	3380	3384	3373	3398	3416 
				3556	3528	3503	3500	3468	3441	3441	3415	3405	3429	3444	3447	3448	3455	3454	3447	3472	3493 
				3534	3501	3473	3473	3448	3426	3422	3405	3388	3415	3426	3429	3427	3433	3433	3420	3443	3469 
				3686	3650	3615	3613	3585	3555	3550	3529	3515	3441	3457	3465	3465	3472	3476	3454	3478	3511 
				3720	3689	3662	3657	3634	3602	3597	3581	3562	3542	3562	3574	3583	3599	3605	3591	3608	3636 
				3749	3711	3688	3676	3648	3619	3608	3590	3562	3627	3641	3657	3658	3669	3669	3650	3665	3692 
				3823	3787	3762	3746	3716	3685	3672	3653	3627	3615	3627	3640	3640	3651	3651	3637	3657	3685 
				3949	3905	3884	3879	3847	3818	3811	3788	3762	3717	3735	3746	3752	3770	3774	3762	3770	3797 
				3924	3892	3875	3860	3828	3800	3791	3769	3745	3776	3794	3808	3811	3825	3826	3815	3825	3850 
				3958	3928	3905	3900	3874	3843	3836	3812	3788	3787	3808	3816	3815	3823	3828	3818	3833	3867 
				4042	4007	3986	3979	3942	3916	3906	3881	3857	3832	3846	3857	3865	3875	3886	3877	3888	3927 
				3654	4039	4025	4019	3986	3958	3944	3921	3895	3882	3902	3916	3916	3934	3944	3928	3930	3578 
				3697	4110	4099	4080	4050	4022	4005	3980	3952	3912	3930	3947	3956	3972	3975	3959	3962	3595 
				3752	4274	4260	4245	4207	4175	4161	4138	4113	3996	4015	4025	4031	4045	4043	4031	4038	3573 
				3664	3949	4239	4238	4204	4172	4164	4140	4113	4014	4032	4050	4057	4073	4082	4067	3793	3553 
				5120 5120 5120>;

			PS_Config_Lmt_Open_Rawdata_N = <
				(-65535)	1225	1232	1228	1217	1205	1201	1176	(-65535)	(-65535)	1166	1183	1187	1189	1189	1188	1180	(-65535)
				1273	1282	1276	1272	1261	1242	1238	1229	1227	1180	1178	1180	1184	1196	1198	1197	1199	1214                
				1291	1297	1295	1293	1283	1272	1267	1259	1255	1198	1201	1206	1207	1213	1215	1211	1211	1228                
				1264	1279	1276	1271	1259	1249	1243	1237	1229	1196	1201	1204	1207	1211	1212	1210	1213	1230                
				1298	1319	1315	1310	1302	1291	1285	1279	1272	1224	1226	1231	1232	1240	1243	1239	1242	1256                
				1328	1352	1346	1342	1331	1320	1315	1309	1303	1234	1235	1240	1241	1245	1246	1242	1247	1259                
				1287	1295	1277	1273	1261	1246	1245	1235	1231	1278	1280	1285	1280	1283	1286	1282	1297	1250                
				1313	1313	1298	1294	1282	1269	1266	1259	1252	1290	1294	1297	1296	1300	1300	1296	1308	1267                
				1318	1319	1304	1298	1289	1280	1279	1275	1268	1303	1305	1311	1307	1314	1313	1308	1321	1284                
				1342	1340	1327	1321	1309	1299	1298	1291	1283	1303	1307	1312	1309	1314	1315	1309	1321	1291                
				1360	1356	1341	1338	1326	1315	1315	1307	1301	1345	1351	1355	1356	1361	1361	1356	1369	1342                
				1381	1376	1361	1357	1344	1332	1331	1321	1316	1357	1360	1365	1365	1370	1370	1367	1380	1359                
				1392	1384	1368	1365	1353	1341	1342	1333	1329	1343	1349	1350	1348	1354	1352	1346	1358	1343                
				1423	1417	1399	1397	1387	1373	1371	1364	1358	1368	1375	1378	1381	1387	1388	1385	1396	1382                
				1437	1429	1413	1411	1400	1387	1385	1378	1372	1421	1424	1430	1426	1432	1435	1429	1444	1442                
				1462	1453	1438	1433	1422	1414	1411	1406	1399	1387	1391	1394	1393	1397	1400	1397	1411	1410                
				1489	1478	1465	1462	1454	1442	1441	1433	1426	1437	1438	1444	1443	1448	1447	1440	1453	1459                
				1514	1502	1490	1483	1471	1458	1456	1445	1438	1436	1439	1445	1444	1448	1450	1445	1456	1464                
				1524	1512	1501	1500	1486	1475	1475	1463	1459	1469	1476	1477	1478	1481	1480	1477	1488	1497                
				1514	1501	1489	1489	1478	1468	1466	1459	1452	1463	1468	1469	1469	1471	1471	1466	1475	1487                
				1580	1564	1549	1549	1537	1523	1522	1513	1507	1475	1481	1485	1485	1488	1490	1480	1490	1505                
				1594	1581	1570	1567	1558	1544	1541	1535	1526	1518	1526	1532	1535	1543	1545	1539	1546	1558                
				1607	1591	1580	1576	1564	1551	1546	1538	1526	1555	1561	1567	1568	1573	1573	1564	1571	1582                
				1639	1623	1612	1606	1592	1579	1574	1565	1555	1549	1555	1560	1560	1565	1565	1559	1567	1579                
				1693	1673	1664	1663	1649	1636	1633	1624	1612	1593	1601	1606	1608	1616	1618	1612	1616	1627                
				1682	1668	1661	1654	1640	1628	1625	1615	1605	1618	1626	1632	1633	1639	1640	1635	1639	1650                
				1696	1684	1673	1672	1660	1647	1644	1634	1624	1623	1632	1636	1635	1639	1640	1636	1643	1657                
				1732	1717	1708	1705	1690	1678	1674	1663	1653	1642	1648	1653	1657	1661	1666	1661	1666	1683                
				1566	1731	1725	1723	1708	1696	1690	1681	1669	1664	1672	1678	1678	1686	1690	1684	1684	1534                
				1585	1762	1757	1748	1736	1724	1717	1706	1694	1676	1684	1691	1696	1702	1703	1697	1698	1541                
				1608	1832	1826	1819	1803	1789	1783	1774	1763	1712	1721	1725	1727	1733	1733	1727	1730	1531                
				1570	1693	1817	1816	1802	1788	1784	1774	1763	1720	1728	1736	1739	1745	1750	1743	1625	1523                
				(-511) (-511) (-511)>;

			PS_Config_Lmt_FW_Rawdata_P = <
				65535	1107	1138	1121	1114	1114	1106	1119	65535	65535	1119	1124	1133	1137	1140	1098	1133	65535
				1112	1119	1114	1130	1123	1117	1137	1127	1126	1151	1106	1084	1099	1092	1081	1145	1110	1137 
				1135	1116	1133	1106	1102	1110	1127	1116	1126	1121	1110	1107	1116	1119	1121	1123	1102	1134 
				1117	1130	1134	1109	1112	1116	1113	1105	1137	1107	1142	1145	1154	1155	1138	1124	1133	1109 
				1095	1138	1127	1120	1112	1121	1123	1120	1124	1114	1119	1124	1123	1121	1123	1110	1119	1106 
				1119	1114	1126	1126	1113	1109	1105	1096	1140	1103	1137	1119	1127	1135	1106	1138	1148	1142 
				1131	1109	1107	1137	1134	1127	1130	1141	1141	1126	1124	1130	1121	1128	1137	1092	1107	1102 
				1148	1099	1128	1128	1120	1106	1119	1106	1128	1123	1124	1124	1133	1128	1133	1112	1134	1127 
				1127	1127	1114	1120	1131	1130	1130	1095	1105	1113	1107	1098	1113	1098	1106	1133	1135	1095 
				1123	1126	1131	1106	1099	1105	1095	1103	1119	1114	1109	1128	1128	1130	1131	1140	1131	1114 
				1098	1123	1082	1133	1161	1161	1086	1082	1084	1121	1105	1099	1121	1107	1103	1106	1131	1086 
				1137	1114	1105	1105	1099	1092	1079	1100	1117	1119	1110	1112	1102	1109	1114	1107	1127	1141 
				1119	1131	1121	1119	1116	1109	1120	1128	1123	1126	1106	1110	1117	1113	1106	1085	1151	1107 
				1121	1130	1096	1102	1099	1109	1110	1123	1106	1100	1105	1100	1109	1106	1102	1085	1156	1113 
				1126	1149	1105	1095	1105	1106	1098	1092	1121	1141	1138	1130	1113	1116	1120	1127	1110	1130 
				1116	1128	1117	1130	1141	1142	1138	1130	1123	1137	1123	1126	1119	1121	1128	1126	1089	1147 
				1106	1131	1149	1148	1124	1131	1135	1134	1119	1109	1120	1133	1130	1102	1098	1088	1156	1120 
				1120	1124	1124	1124	1121	1117	1123	1131	1128	1102	1074	1077	1086	1095	1106	1113	1140	1130 
				1130	1109	1121	1113	1109	1109	1112	1106	1109	1127	1112	1105	1110	1106	1093	1106	1155	1133 
				1127	1144	1100	1109	1107	1099	1102	1100	1114	1109	1121	1137	1127	1124	1112	1124	1102	1116 
				1134	1147	1100	1107	1112	1103	1098	1103	1128	1092	1124	1127	1128	1140	1134	1155	1092	1084 
				1140	1121	1113	1121	1119	1119	1116	1124	1140	1116	1100	1102	1096	1093	1089	1102	1135	1113 
				1133	1127	1113	1107	1117	1107	1114	1105	1128	1112	1124	1114	1137	1126	1116	1121	1124	1109 
				1112	1116	1126	1098	1100	1112	1121	1121	1114	1130	1105	1106	1109	1119	1130	1138	1116	1128 
				1116	1119	1114	1120	1113	1113	1124	1120	1098	1120	1130	1128	1126	1131	1123	1116	1123	1112 
				1102	1096	1158	1148	1149	1156	1154	1148	1116	1128	1138	1133	1135	1137	1124	1135	1128	1133 
				1103	1096	1141	1138	1140	1130	1128	1126	1117	1123	1078	1088	1089	1091	1105	1092	1117	1128 
				1137	1112	1141	1142	1128	1128	1117	1123	1137	1109	1113	1107	1095	1102	1114	1123	1114	1112 
				1131	1140	1102	1113	1098	1086	1103	1109	1117	1137	1119	1109	1119	1120	1119	1124	1120	1127 
				1135	1121	1127	1116	1148	1148	1144	1144	1110	1114	1110	1105	1119	1123	1124	1128	1121	1138 
				1116	1106	1127	1126	1127	1130	1128	1127	1131	1114	1113	1109	1106	1099	1105	1100	1128	1147 
				1105	1134	1123	1116	1134	1142	1159	1144	1088	1149	1103	1110	1116	1114	1120	1123	1138	1120 
				3840 3840 3840>;

			PS_Config_Lmt_FW_Rawdata_N = <
				(-65535)	475	488	481	478	478	474	479	(-65535)	(-65535)	479	482	485	487	488	470	485	(-65535)
				476	479	478	484	481	479	487	483	482	493	474	464	471	468	463	491	476	487                       
				487	478	485	474	472	476	483	478	482	481	476	475	478	479	481	481	472	486                       
				479	484	486	475	476	478	477	473	487	475	490	491	494	495	488	482	485	475                       
				469	488	483	480	476	481	481	480	482	478	479	482	481	481	481	476	479	474                       
				479	478	482	482	477	475	473	470	488	473	487	479	483	487	474	488	492	490                       
				485	475	475	487	486	483	484	489	489	482	482	484	481	484	487	468	475	472                       
				492	471	484	484	480	474	479	474	484	481	482	482	485	484	485	476	486	483                       
				483	483	478	480	485	484	484	469	473	477	475	470	477	470	474	485	487	469                       
				481	482	485	474	471	473	469	473	479	478	475	484	484	484	485	488	485	478                       
				470	481	464	485	497	497	466	464	464	481	473	471	481	475	473	474	485	466                       
				487	478	473	473	471	468	463	472	479	479	476	476	472	475	478	475	483	489                       
				479	485	481	479	478	475	480	484	481	482	474	476	479	477	474	465	493	475                       
				481	484	470	472	471	475	476	481	474	472	473	472	475	474	472	465	496	477                       
				482	493	473	469	473	474	470	468	481	489	488	484	477	478	480	483	476	484                       
				478	484	479	484	489	490	488	484	481	487	481	482	479	481	484	482	467	491                       
				474	485	493	492	482	485	487	486	479	475	480	485	484	472	470	466	496	480                       
				480	482	482	482	481	479	481	485	484	472	460	461	466	469	474	477	488	484                       
				484	475	481	477	475	475	476	474	475	483	476	473	476	474	469	474	495	485                       
				483	490	472	475	475	471	472	472	478	475	481	487	483	482	476	482	472	478                       
				486	491	472	475	476	473	470	473	484	468	482	483	484	488	486	495	468	464                       
				488	481	477	481	479	479	478	482	488	478	472	472	470	469	467	472	487	477                       
				485	483	477	475	479	475	478	473	484	476	482	478	487	482	478	481	482	475                       
				476	478	482	470	472	476	481	481	478	484	473	474	475	479	484	488	478	484                       
				478	479	478	480	477	477	482	480	470	480	484	484	482	485	481	478	481	476                       
				472	470	496	492	493	496	494	492	478	484	488	485	487	487	482	487	484	485                       
				473	470	489	488	488	484	484	482	479	481	462	466	467	467	473	468	479	484                       
				487	476	489	490	484	484	479	481	487	475	477	475	469	472	478	481	478	476                       
				485	488	472	477	470	466	473	475	479	487	479	475	479	480	479	482	480	483                       
				487	481	483	478	492	492	490	490	476	478	476	473	479	481	482	484	481	488                       
				478	474	483	482	483	484	484	483	485	478	477	475	474	471	473	472	484	491                       
				473	486	481	478	486	490	497	490	466	493	473	476	478	478	480	481	488	480                       
				240 240 240>;

			PS_Config_Lmt_FW_CC_P = <
				65535	47	47	46	46	46	46	44	65535	65535	44	46	46	46	46	46	47	65535
				50	48	46	46	46	46	46	46	46	46	46	46	46	46	46	46	47	50         
				51	48	47	46	46	46	46	46	46	46	46	46	46	46	46	47	48	51         
				51	48	47	46	46	46	46	46	46	46	46	46	46	46	46	47	48	51         
				51	50	47	47	47	47	46	46	47	47	46	46	46	46	46	47	48	51         
				51	50	47	47	47	47	47	47	47	47	46	46	46	46	47	47	48	51         
				51	50	48	46	46	46	46	46	46	46	46	46	46	46	46	48	50	51         
				51	50	48	46	46	46	46	46	46	46	46	46	46	46	46	48	50	51         
				52	50	48	46	46	46	46	47	47	47	46	46	46	46	46	48	50	51         
				51	50	47	46	46	46	46	46	46	46	46	46	46	46	46	48	50	51         
				52	50	48	46	46	46	47	47	47	47	47	47	46	47	47	48	50	52         
				52	50	48	46	46	46	46	47	47	47	46	46	46	46	46	48	50	51         
				52	50	47	46	46	46	46	46	47	47	47	47	47	47	47	48	50	52         
				52	50	48	46	46	46	46	46	47	47	47	47	47	47	46	48	50	52         
				52	50	48	47	47	47	47	47	47	47	47	47	47	47	47	48	50	52         
				52	50	48	47	46	46	47	47	47	47	47	47	47	47	47	48	50	52         
				52	50	48	47	47	47	47	47	47	47	47	47	47	47	47	48	50	52         
				52	50	48	47	47	47	47	47	47	47	47	47	47	47	47	48	50	52         
				52	50	48	47	47	47	47	47	47	47	47	47	47	47	47	48	51	52         
				52	50	48	47	47	47	47	47	47	47	47	47	47	47	47	48	50	52         
				54	51	48	47	47	47	47	47	47	48	47	47	47	47	47	48	51	54         
				52	51	48	47	47	47	47	47	47	47	47	47	47	47	47	48	51	52         
				54	51	50	48	48	48	48	48	48	48	47	47	47	47	48	48	51	54         
				54	51	50	48	48	48	48	48	48	48	48	48	48	48	48	50	51	54         
				55	52	50	48	48	48	48	48	50	48	48	48	48	48	48	50	51	54         
				54	51	50	48	48	48	48	48	48	48	48	48	48	48	48	50	51	54         
				54	51	50	48	48	48	48	48	48	48	48	48	48	48	48	50	51	54         
				54	51	50	48	48	48	48	48	48	48	48	48	48	48	48	50	51	54         
				52	52	50	50	48	48	48	48	50	48	48	48	48	48	48	50	51	51         
				51	51	50	48	48	48	48	48	48	48	48	48	48	48	48	50	51	51         
				51	52	50	48	48	48	48	48	48	48	48	48	48	48	48	50	51	51         
				51	51	50	48	48	48	48	48	48	48	48	48	48	48	48	50	50	51         
				314 314 314>;

			PS_Config_Lmt_FW_CC_N = <
				(-65535)	21	21	20	20	20	20	20	(-65535)	(-65535)	20	20	20	20	20	20	21	(-65535)
				22	22	20	20	20	20	20	20	20	20	20	20	20	20	20	20	21	22                        
				23	22	21	20	20	20	20	20	20	20	20	20	20	20	20	21	22	23                        
				23	22	21	20	20	20	20	20	20	20	20	20	20	20	20	21	22	23                        
				23	22	21	21	21	21	20	20	21	21	20	20	20	20	20	21	22	23                        
				23	22	21	21	21	21	21	21	21	21	20	20	20	20	21	21	22	23                        
				23	22	22	20	20	20	20	20	20	20	20	20	20	20	20	22	22	23                        
				23	22	22	20	20	20	20	20	20	20	20	20	20	20	20	22	22	23                        
				24	22	22	20	20	20	20	21	21	21	20	20	20	20	20	22	22	23                        
				23	22	21	20	20	20	20	20	20	20	20	20	20	20	20	22	22	23                        
				24	22	22	20	20	20	21	21	21	21	21	21	20	21	21	22	22	24                        
				24	22	22	20	20	20	20	21	21	21	20	20	20	20	20	22	22	23                        
				24	22	21	20	20	20	20	20	21	21	21	21	21	21	21	22	22	24                        
				24	22	22	20	20	20	20	20	21	21	21	21	21	21	20	22	22	24                        
				24	22	22	21	21	21	21	21	21	21	21	21	21	21	21	22	22	24                        
				24	22	22	21	20	20	21	21	21	21	21	21	21	21	21	22	22	24                        
				24	22	22	21	21	21	21	21	21	21	21	21	21	21	21	22	22	24                        
				24	22	22	21	21	21	21	21	21	21	21	21	21	21	21	22	22	24                        
				24	22	22	21	21	21	21	21	21	21	21	21	21	21	21	22	23	24                        
				24	22	22	21	21	21	21	21	21	21	21	21	21	21	21	22	22	24                        
				24	23	22	21	21	21	21	21	21	22	21	21	21	21	21	22	23	24                        
				24	23	22	21	21	21	21	21	21	21	21	21	21	21	21	22	23	24                        
				24	23	22	22	22	22	22	22	22	22	21	21	21	21	22	22	23	24                        
				24	23	22	22	22	22	22	22	22	22	22	22	22	22	22	22	23	24                        
				25	24	22	22	22	22	22	22	22	22	22	22	22	22	22	22	23	24                        
				24	23	22	22	22	22	22	22	22	22	22	22	22	22	22	22	23	24                        
				24	23	22	22	22	22	22	22	22	22	22	22	22	22	22	22	23	24                        
				24	23	22	22	22	22	22	22	22	22	22	22	22	22	22	22	23	24                        
				24	24	22	22	22	22	22	22	22	22	22	22	22	22	22	22	23	23                        
				23	23	22	22	22	22	22	22	22	22	22	22	22	22	22	22	23	23                        
				23	24	22	22	22	22	22	22	22	22	22	22	22	22	22	22	23	23                        
				23	23	22	22	22	22	22	22	22	22	22	22	22	22	22	22	22	23                        
				0 0 0>;

			PS_Config_Lmt_FW_Diff_P = <
				65535	50	50	50	50	50	50	50	65535	65535	50	50	50	50	50	50	50	65535
				50	50	50	50	50	50	50	50	50	50	50	50	50	50	50	50	50	50         
				50	50	50	50	50	50	50	50	50	50	50	50	50	50	50	50	50	50         
				50	50	50	50	50	50	50	50	50	50	50	50	50	50	50	50	50	50         
				50	50	50	50	50	50	50	50	50	50	50	50	50	50	50	50	50	50         
				50	50	50	50	50	50	50	50	50	50	50	50	50	50	50	50	50	50         
				50	50	50	50	50	50	50	50	50	50	50	50	50	50	50	50	50	50         
				50	50	50	50	50	50	50	50	50	50	50	50	50	50	50	50	50	50         
				50	50	50	50	50	50	50	50	50	50	50	50	50	50	50	50	50	50         
				50	50	50	50	50	50	50	50	50	50	50	50	50	50	50	50	50	50         
				50	50	50	50	50	50	50	50	50	50	50	50	50	50	50	50	50	50         
				50	50	50	50	50	50	50	50	50	50	50	50	50	50	50	50	50	50         
				50	50	50	50	50	50	50	50	50	50	50	50	50	50	50	50	50	50         
				50	50	50	50	50	50	50	50	50	50	50	50	50	50	50	50	50	50         
				50	50	50	50	50	50	50	50	50	50	50	50	50	50	50	50	50	50         
				50	50	50	50	50	50	50	50	50	50	50	50	50	50	50	50	50	50         
				50	50	50	50	50	50	50	50	50	50	50	50	50	50	50	50	50	50         
				50	50	50	50	50	50	50	50	50	50	50	50	50	50	50	50	50	50         
				50	50	50	50	50	50	50	50	50	50	50	50	50	50	50	50	50	50         
				50	50	50	50	50	50	50	50	50	50	50	50	50	50	50	50	50	50         
				50	50	50	50	50	50	50	50	50	50	50	50	50	50	50	50	50	50         
				50	50	50	50	50	50	50	50	50	50	50	50	50	50	50	50	50	50         
				50	50	50	50	50	50	50	50	50	50	50	50	50	50	50	50	50	50         
				50	50	50	50	50	50	50	50	50	50	50	50	50	50	50	50	50	50         
				50	50	50	50	50	50	50	50	50	50	50	50	50	50	50	50	50	50         
				50	50	50	50	50	50	50	50	50	50	50	50	50	50	50	50	50	50         
				50	50	50	50	50	50	50	50	50	50	50	50	50	50	50	50	50	50         
				50	50	50	50	50	50	50	50	50	50	50	50	50	50	50	50	50	50         
				50	50	50	50	50	50	50	50	50	50	50	50	50	50	50	50	50	50         
				50	50	50	50	50	50	50	50	50	50	50	50	50	50	50	50	50	50         
				50	50	50	50	50	50	50	50	50	50	50	50	50	50	50	50	50	50         
				50	50	50	50	50	50	50	50	50	50	50	50	50	50	50	50	50	50         
				75 75 75>;

			PS_Config_Lmt_FW_Diff_N = <
				(-65535)	(-50)	(-50)	(-50)	(-50)	(-50)	(-50)	(-50)	(-65535)	(-65535)	(-50)	(-50)	(-50)	(-50)	(-50)	(-50)	(-50)	(-65535)
				(-50)	(-50)	(-50)	(-50)	(-50)	(-50)	(-50)	(-50)	(-50)	(-50)	(-50)	(-50)	(-50)	(-50)	(-50)	(-50)	(-50)	(-50)               
				(-50)	(-50)	(-50)	(-50)	(-50)	(-50)	(-50)	(-50)	(-50)	(-50)	(-50)	(-50)	(-50)	(-50)	(-50)	(-50)	(-50)	(-50)               
				(-50)	(-50)	(-50)	(-50)	(-50)	(-50)	(-50)	(-50)	(-50)	(-50)	(-50)	(-50)	(-50)	(-50)	(-50)	(-50)	(-50)	(-50)               
				(-50)	(-50)	(-50)	(-50)	(-50)	(-50)	(-50)	(-50)	(-50)	(-50)	(-50)	(-50)	(-50)	(-50)	(-50)	(-50)	(-50)	(-50)               
				(-50)	(-50)	(-50)	(-50)	(-50)	(-50)	(-50)	(-50)	(-50)	(-50)	(-50)	(-50)	(-50)	(-50)	(-50)	(-50)	(-50)	(-50)               
				(-50)	(-50)	(-50)	(-50)	(-50)	(-50)	(-50)	(-50)	(-50)	(-50)	(-50)	(-50)	(-50)	(-50)	(-50)	(-50)	(-50)	(-50)               
				(-50)	(-50)	(-50)	(-50)	(-50)	(-50)	(-50)	(-50)	(-50)	(-50)	(-50)	(-50)	(-50)	(-50)	(-50)	(-50)	(-50)	(-50)               
				(-50)	(-50)	(-50)	(-50)	(-50)	(-50)	(-50)	(-50)	(-50)	(-50)	(-50)	(-50)	(-50)	(-50)	(-50)	(-50)	(-50)	(-50)               
				(-50)	(-50)	(-50)	(-50)	(-50)	(-50)	(-50)	(-50)	(-50)	(-50)	(-50)	(-50)	(-50)	(-50)	(-50)	(-50)	(-50)	(-50)               
				(-50)	(-50)	(-50)	(-50)	(-50)	(-50)	(-50)	(-50)	(-50)	(-50)	(-50)	(-50)	(-50)	(-50)	(-50)	(-50)	(-50)	(-50)               
				(-50)	(-50)	(-50)	(-50)	(-50)	(-50)	(-50)	(-50)	(-50)	(-50)	(-50)	(-50)	(-50)	(-50)	(-50)	(-50)	(-50)	(-50)               
				(-50)	(-50)	(-50)	(-50)	(-50)	(-50)	(-50)	(-50)	(-50)	(-50)	(-50)	(-50)	(-50)	(-50)	(-50)	(-50)	(-50)	(-50)               
				(-50)	(-50)	(-50)	(-50)	(-50)	(-50)	(-50)	(-50)	(-50)	(-50)	(-50)	(-50)	(-50)	(-50)	(-50)	(-50)	(-50)	(-50)               
				(-50)	(-50)	(-50)	(-50)	(-50)	(-50)	(-50)	(-50)	(-50)	(-50)	(-50)	(-50)	(-50)	(-50)	(-50)	(-50)	(-50)	(-50)               
				(-50)	(-50)	(-50)	(-50)	(-50)	(-50)	(-50)	(-50)	(-50)	(-50)	(-50)	(-50)	(-50)	(-50)	(-50)	(-50)	(-50)	(-50)               
				(-50)	(-50)	(-50)	(-50)	(-50)	(-50)	(-50)	(-50)	(-50)	(-50)	(-50)	(-50)	(-50)	(-50)	(-50)	(-50)	(-50)	(-50)               
				(-50)	(-50)	(-50)	(-50)	(-50)	(-50)	(-50)	(-50)	(-50)	(-50)	(-50)	(-50)	(-50)	(-50)	(-50)	(-50)	(-50)	(-50)               
				(-50)	(-50)	(-50)	(-50)	(-50)	(-50)	(-50)	(-50)	(-50)	(-50)	(-50)	(-50)	(-50)	(-50)	(-50)	(-50)	(-50)	(-50)               
				(-50)	(-50)	(-50)	(-50)	(-50)	(-50)	(-50)	(-50)	(-50)	(-50)	(-50)	(-50)	(-50)	(-50)	(-50)	(-50)	(-50)	(-50)               
				(-50)	(-50)	(-50)	(-50)	(-50)	(-50)	(-50)	(-50)	(-50)	(-50)	(-50)	(-50)	(-50)	(-50)	(-50)	(-50)	(-50)	(-50)               
				(-50)	(-50)	(-50)	(-50)	(-50)	(-50)	(-50)	(-50)	(-50)	(-50)	(-50)	(-50)	(-50)	(-50)	(-50)	(-50)	(-50)	(-50)               
				(-50)	(-50)	(-50)	(-50)	(-50)	(-50)	(-50)	(-50)	(-50)	(-50)	(-50)	(-50)	(-50)	(-50)	(-50)	(-50)	(-50)	(-50)               
				(-50)	(-50)	(-50)	(-50)	(-50)	(-50)	(-50)	(-50)	(-50)	(-50)	(-50)	(-50)	(-50)	(-50)	(-50)	(-50)	(-50)	(-50)               
				(-50)	(-50)	(-50)	(-50)	(-50)	(-50)	(-50)	(-50)	(-50)	(-50)	(-50)	(-50)	(-50)	(-50)	(-50)	(-50)	(-50)	(-50)               
				(-50)	(-50)	(-50)	(-50)	(-50)	(-50)	(-50)	(-50)	(-50)	(-50)	(-50)	(-50)	(-50)	(-50)	(-50)	(-50)	(-50)	(-50)               
				(-50)	(-50)	(-50)	(-50)	(-50)	(-50)	(-50)	(-50)	(-50)	(-50)	(-50)	(-50)	(-50)	(-50)	(-50)	(-50)	(-50)	(-50)               
				(-50)	(-50)	(-50)	(-50)	(-50)	(-50)	(-50)	(-50)	(-50)	(-50)	(-50)	(-50)	(-50)	(-50)	(-50)	(-50)	(-50)	(-50)               
				(-50)	(-50)	(-50)	(-50)	(-50)	(-50)	(-50)	(-50)	(-50)	(-50)	(-50)	(-50)	(-50)	(-50)	(-50)	(-50)	(-50)	(-50)               
				(-50)	(-50)	(-50)	(-50)	(-50)	(-50)	(-50)	(-50)	(-50)	(-50)	(-50)	(-50)	(-50)	(-50)	(-50)	(-50)	(-50)	(-50)               
				(-50)	(-50)	(-50)	(-50)	(-50)	(-50)	(-50)	(-50)	(-50)	(-50)	(-50)	(-50)	(-50)	(-50)	(-50)	(-50)	(-50)	(-50)               
				(-50)	(-50)	(-50)	(-50)	(-50)	(-50)	(-50)	(-50)	(-50)	(-50)	(-50)	(-50)	(-50)	(-50)	(-50)	(-50)	(-50)	(-50)               
				(-75) (-75) (-75)>;

			PS_Config_Diff_Test_Frame = <50>;
		};
	};
};