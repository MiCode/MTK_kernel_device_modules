// SPDX-License-Identifier: (GPL-2.0 OR MIT)
/*
 * Copyright (C) 2022 MediaTek Inc.
 */
/dts-v1/;
/plugin/;
#include <dt-bindings/interrupt-controller/arm-gic.h>
#include <dt-bindings/interrupt-controller/irq.h>
#include <dt-bindings/phy/phy.h>
#include <dt-bindings/pinctrl/mt6991-pinfunc.h>
#include <dt-bindings/clock/mt6991-clk.h>
#include <dt-bindings/power/mt6991-power.h>
#include <dt-bindings/memory/mt6991-smi-pd.h>
#include <dt-bindings/clock/mmdvfs-clk.h>
#include <dt-bindings/mmdvfs/mmdvfs-clk-mt6991.h>
#include <dt-bindings/mminfra/mminfra-mt6991.h>
#include <dt-bindings/clock/mmdvfs-clk.h>
#include <dt-bindings/mminfra/mminfra-mt6991.h>

&chosen {
bootargs_ext = "rcu_nocbs=0-7";
};

&seninf_top {
	ccf-apply;
	clocks = <&cam_vcore_r1a_clk CLK_VCORE>,
		<&cam_vcore_r1a_clk CLK_2MM0_SUBCOMMON_DCM_DIS_CAMRAW>,
		<&cam_vcore_r1a_clk CLK_CAM_V_MM0_SUBCOMM_CAMRAW>,
		<&cam_main_r1a_clk CLK_CAM_MAIN_SENINF_CAM_SENINF>,
		<&cam_main_r1a_clk CLK_CAM_MAIN_CAM_CAM_SENINF>,
		<&cam_main_r1a_clk CLK_CAM_MAIN_CAMTG_CAM_SENINF>,
		//<&cam_main_r1a_clk CLK_CAM_MAIN_CAM_ASG_CAM_SENINF>,
		<&cksys_gp2_clk CLK_CK2_SENINF0_SEL>,
		<&cksys_gp2_clk CLK_CK2_SENINF1_SEL>,
		<&cksys_gp2_clk CLK_CK2_SENINF2_SEL>,
		<&cksys_gp2_clk CLK_CK2_SENINF3_SEL>,
		<&cksys_gp2_clk CLK_CK2_SENINF4_SEL>,
		<&cksys_gp2_clk CLK_CK2_SENINF5_SEL>,
		//<&cksys_gp2_clk CLK_CK2_CAMTM_SEL>,
		<&cksys_clk CLK_CK_OSC_D4>,
		<&cksys_gp2_clk CLK_CK2_UNIVPLL2_D4_D2>,
		<&cksys_gp2_clk CLK_CK2_MAINPLL2_D6>,
		<&cksys_gp2_clk CLK_CK2_UNIVPLL2_D6>,
		<&cksys_gp2_clk CLK_CK2_UNIVPLL2_D5>,
		<&mmdvfs_mux MMDVFS_USER_CAM>,

		// add  virtual power domain node
		<&mm_pd_clk  MT6991_PD_CAM_VCORE_SENINF>,
		<&mm_pd_clk  MT6991_PD_CAM_MAIN_SENINF>,
		<&mm_pd_clk  MT6991_PD_CSI_BS_RX_SENINF>,
		<&mm_pd_clk  MT6991_PD_CSI_LS_RX_SENINF>;

	clock-names = "clk_cam_vcore_cg0",
		"clk_cam_vcore_cg2",
		"clk_cam_vcore_cg3",
		"clk_cam_seninf",
		"clk_cam_cam",
		"clk_cam_camtg",
		//"clk_cam_asg",
		"clk_top_seninf",
		"clk_top_seninf1",
		"clk_top_seninf2",
		"clk_top_seninf3",
		"clk_top_seninf4",
		"clk_top_seninf5",
		//"clk_top_camtm", // already en by hw when cam_vcore en
		"clk_top_aov_step0",
		"clk_top_ap_step0",
		"clk_top_ap_step1",
		"clk_top_ap_step2",
		"clk_top_ap_step3",
		"mmdvfs_mux",

		// add  virtual power domain node
		"clk_virtual_cam_core",
		"clk_virtual_cam_main",
		"clk_virtual_csi_bs_rx",
		"clk_virtual_csi_ls_rx";
};

&camisp_vcore {
	clocks = <&mm_pd_clk MT6991_PD_CAM_VCORE_CAMISP_VCORE>,
		<&cksys_gp2_clk CLK_CK2_CAM>,
		<&cksys_gp2_clk CLK_CK2_CAMTM>,
		<&vlp_cksys_clk CLK_VLP_CK_CAMTG0_SEL>,
		<&cam_vcore_r1a_clk CLK_VCORE_CAMRAW>,
		<&cam_vcore_r1a_clk CLK_2MM0_SUBCOMMON_DCM_DIS_CAMRAW>,
		<&cam_vcore_r1a_clk CLK_CAM_V_MM0_SUBCOMM_CAMRAW>;
	clock-names = "camsys_pd_cam_vcore_camisp",
		"topckgen_top_cam_sel",
		"topckgen_top_camtm_sel",
		"vlpckgen_vlp_camtg_sel",
		"camsys_vcore",
		"camsys_v_dcm_dis",
		"camsys_v_mm0_subcomm";
	ccf-apply;
};

&camisp {
	clocks = <&mm_pd_clk MT6991_PD_CAM_MAIN_CAMISP>,
		<&cam_main_r1a_clk CLK_CAM_MAIN_SENINF_CAM_SENINF>,
		<&cam_main_r1a_clk CLK_CAM_MAIN_CAM_CAMRAWA>,
		<&cam_main_r1a_clk CLK_CAM_MAIN_CAMTG_CAMRAWA>,
		<&cam_main_r1a_clk CLK_CAM_MAIN_ADLRD_CAMRAWA>,
		<&cam_main_r1a_clk CLK_CAM_MAIN_ADLWR_CAMRAWA>,
		<&cam_main_r1a_clk CLK_CAM_MAIN_CAM_QOF_CON_1_CAMRAW>,
		<&cam_main_r1a_clk CLK_CAM_MAIN_CAM_SUBA_CAMRAWA>,
		<&cam_main_r1a_clk CLK_CAM_MAIN_CAM_SUBB_CAMRAWB>,
		<&cam_main_r1a_clk CLK_CAM_MAIN_CAM_SUBC_CAMRAWC>,
		<&cam_main_r1a_clk CLK_CAM_MAIN_CAM2MM0_GALS_CAMRAWA>,
		<&cam_main_r1a_clk CLK_CAM_MAIN_CAM2MM1_GALS_CAMRAWA>,
		<&cam_main_r1a_clk CLK_CAM_MAIN_CAM2SYS_GALS_CAMRAWA>,
		<&cam_main_r1a_clk CLK_CAM_MAIN_CAM2MM2_GALS_CAMRAWA>,
		<&mmdvfs_mux MMDVFS_USER_CAM>;
	clock-names = "camsys_pd_cam_main_camisp",
		"clk_cam_seninf",
		"camsys_cam_cgpdn",
		"camsys_camtg_cgpdn",
		"camsys_adlrd_cgpdn",
		"camsys_adlwr_cgpdn",
		"camsys_qof_cgpdn",
		"camsys_suba_cgpdn",
		"camsys_subb_cgpdn",
		"camsys_subc_cgpdn",
		"camsys_cam2mm0_gals_cgpdn",
		"camsys_cam2mm1_gals_cgpdn",
		"camsys_cam2sys_gals_cgpdn",
		"camsys_cam2mm2_gals_cgpdn",
		"mmdvfs_mux";
};

&cam_bwr {
	clocks = <&mm_pd_clk MT6991_PD_CAM_MAIN_CAM_BWR>,
		<&cam_main_r1a_clk CLK_CAM_MAIN_CAM>,
		<&cam_main_r1a_clk CLK_CAM_MAIN_CAM_BWR_CON_1_CAMBWR>;
	clock-names = "camsys_pd_cam_main_bwr",
		"camsys_cam_cgpdn",
		"camsys_bwr_cgpdn";
};

&cam_raw_a {
	clocks = <&mm_pd_clk MT6991_PD_CAM_RAWA_CAM_RAW_A>,
		<&camsys_rawa_clk CLK_CAM_RA_LARBX_CAMRAWA>,
		<&camsys_rawa_clk CLK_CAM_RA_CAM_CAMRAWA>,
		<&camsys_rawa_clk CLK_CAM_RA_CAMTG_CAMRAWA>,
		<&camsys_rawa_clk CLK_CAM_RA_RAW2MM_GALS_CAMRAWA>,
		<&camsys_rawa_clk CLK_CAM_RA_YUV2RAW2MM_GALS_CAMRAWA>;
	clock-names = "camsys_pd_cam_rawa",
		"camsys_rawa_larbx_cgpdn",
		"camsys_rawa_cam_cgpdn",
		"camsys_rawa_camtg_cgpdn",
		"camsys_rawa_raw2mm_gals_cgpdn",
		"camsys_rawa_yuv2raw2mm_gals_cgpdn";
};

&cam_rms_a {
	clocks = <&mm_pd_clk MT6991_PD_CAM_RMSA_CAM_RMSA>,
		<&camsys_rmsa_clk CLK_CAMSYS_RMSA_LARBX_CAMRAWA>,
		<&camsys_rmsa_clk CLK_CAMSYS_RMSA_CAM_CAMRAWA>,
		<&camsys_rmsa_clk CLK_CAMSYS_RMSA_CAMTG_CAMRAWA>;
	clock-names = "camsys_pd_cam_rmsa",
		"camsys_rmsa_larbx_cgpdn",
		"camsys_rmsa_cam_cgpdn",
		"camsys_rmsa_camtg_cgpdn";
};

&cam_yuv_a {
	clocks = <&mm_pd_clk MT6991_PD_CAM_RAWA_CAM_YUV_A>,
		<&camsys_yuva_clk CLK_CAM_YA_LARBX_CAMRAWA>,
		<&camsys_yuva_clk CLK_CAM_YA_CAM_CAMRAWA>,
		<&camsys_yuva_clk CLK_CAM_YA_CAMTG_CAMRAWA>;
	clock-names = "camsys_pd_cam_yuva",
		"camsys_yuva_larbx_cgpdn",
		"camsys_yuva_cam_cgpdn",
		"camsys_yuva_camtg_cgpdn";
};

&cam_raw_b {
	clocks = <&mm_pd_clk MT6991_PD_CAM_RAWB_CAM_RAW_B>,
		<&camsys_rawb_clk CLK_CAM_RB_LARBX_CAMRAWB>,
		<&camsys_rawb_clk CLK_CAM_RB_CAM_CAMRAWB>,
		<&camsys_rawb_clk CLK_CAM_RB_CAMTG_CAMRAWB>,
		<&camsys_rawb_clk CLK_CAM_RB_RAW2MM_GALS_CAMRAWB>,
		<&camsys_rawb_clk CLK_CAM_RB_YUV2RAW2MM_GALS_CAMRAWB>;
	clock-names = "camsys_pd_cam_rawb",
		"camsys_rawb_larbx_cgpdn",
		"camsys_rawb_cam_cgpdn",
		"camsys_rawb_camtg_cgpdn",
		"camsys_rawb_raw2mm_gals_cgpdn",
		"camsys_rawb_yuv2raw2mm_gals_cgpdn";
};

&cam_rms_b {
	clocks =  <&mm_pd_clk MT6991_PD_CAM_RMSB_CAM_RMSB>,
		<&camsys_rmsb_clk CLK_CAMSYS_RMSB_LARBX_CAMRAWB>,
		<&camsys_rmsb_clk CLK_CAMSYS_RMSB_CAM_CAMRAWB>,
		<&camsys_rmsb_clk CLK_CAMSYS_RMSB_CAMTG_CAMRAWB>;
	clock-names = "camsys_pd_cam_rmsb",
		"camsys_rmsb_larbx_cgpdn",
		"camsys_rmsb_cam_cgpdn",
		"camsys_rmsb_camtg_cgpdn";
};

&cam_yuv_b {
	clocks = <&mm_pd_clk MT6991_PD_CAM_RAWB_CAM_YUV_B>,
		<&camsys_yuvb_clk CLK_CAM_YB_LARBX_CAMRAWB>,
		<&camsys_yuvb_clk CLK_CAM_YB_CAM_CAMRAWB>,
		<&camsys_yuvb_clk CLK_CAM_YB_CAMTG_CAMRAWB>;
	clock-names = "camsys_pd_cam_yuvb",
		"camsys_yuvb_larbx_cgpdn",
		"camsys_yuvb_cam_cgpdn",
		"camsys_yuvb_camtg_cgpdn";
};

&cam_raw_c {
	clocks = <&mm_pd_clk MT6991_PD_CAM_RAWC_CAM_RAW_C>,
		<&camsys_rawc_clk CLK_CAM_RC_LARBX_CAMRAWC>,
		<&camsys_rawc_clk CLK_CAM_RC_CAM_CAMRAWC>,
		<&camsys_rawc_clk CLK_CAM_RC_CAMTG_CAMRAWC>,
		<&camsys_rawc_clk CLK_CAM_RC_RAW2MM_GALS_CAMRAWC>,
		<&camsys_rawc_clk CLK_CAM_RC_YUV2RAW2MM_GALS_CAMRAWC>;
	clock-names = "camsys_pd_cam_rawc",
		"camsys_rawc_larbx_cgpdn",
		"camsys_rawc_cam_cgpdn",
		"camsys_rawc_camtg_cgpdn",
		"camsys_rawc_raw2mm_gals_cgpdn",
		"camsys_rawc_yuv2raw2mm_gals_cgpdn";
};

&cam_rms_c {
	clocks = <&mm_pd_clk MT6991_PD_CAM_RMSC_CAM_RMSC>,
		<&camsys_rmsc_clk CLK_CAMSYS_RMSC_LARBX_CAMRAWC>,
		<&camsys_rmsc_clk CLK_CAMSYS_RMSC_CAM_CAMRAWC>,
		<&camsys_rmsc_clk CLK_CAMSYS_RMSC_CAMTG_CAMRAWC>;
	clock-names = "camsys_pd_cam_rmsc",
		"camsys_rmsc_larbx_cgpdn",
		"camsys_rmsc_cam_cgpdn",
		"camsys_rmsc_camtg_cgpdn";
};

&cam_yuv_c {
	clocks = <&mm_pd_clk MT6991_PD_CAM_RAWC_CAM_YUV_C>,
		<&camsys_yuvc_clk CLK_CAM_YC_LARBX_CAMRAWC>,
		<&camsys_yuvc_clk CLK_CAM_YC_CAM_CAMRAWC>,
		<&camsys_yuvc_clk CLK_CAM_YC_CAMTG_CAMRAWC>;
	clock-names = "camsys_pd_cam_yuvc",
		"camsys_yuvc_larbx_cgpdn",
		"camsys_yuvc_cam_cgpdn",
		"camsys_yuvc_camtg_cgpdn";
};

&camsv1 {
	clocks =<&mm_pd_clk MT6991_PD_CAM_MAIN_CAMSV1>,
		<&cam_main_r1a_clk CLK_CAM_MAIN_CAM>,
		<&cam_main_r1a_clk CLK_CAM_MAIN_LARB14_CAMSV>,
		<&cam_main_r1a_clk CLK_CAM_MAIN_CAMSV_TOP_CAMSV>,
		<&cam_main_r1a_clk CLK_CAM_MAIN_CAM2MM0_GALS_CAMSV>,
		<&cam_main_r1a_clk CLK_CAM_MAIN_CAM2MM1_GALS_CAMSV>,
		<&cam_main_r1a_clk CLK_CAM_MAIN_CAM2SYS_GALS_CAMSV>,
		<&cam_main_r1a_clk CLK_CAM_MAIN_CAM2MM2_GALS_CAMSV>,
		<&cam_main_r1a_clk CLK_CAM_MAIN_CAMSV_A_CON_1_CAMSV>;
	clock-names = "cam_main_pdn",
		"cam_main_cam_cgpdn",
		"cam_main_larb14_con",
		"cam_main_camsv_top_con",
		"cam_main_cam2mm0_gals_con",
		"cam_main_cam2mm1_gals_con",
		"cam_main_cam2sys_gals_con",
		"cam_main_cam2mm2_gals_con",
		"cam_main_camsv_a_con";
};

&camsv2 {
	clocks =<&mm_pd_clk MT6991_PD_CAM_MAIN_CAMSV2>,
		<&cam_main_r1a_clk CLK_CAM_MAIN_CAM>,
		<&cam_main_r1a_clk CLK_CAM_MAIN_LARB13_CAMSV>,
		<&cam_main_r1a_clk CLK_CAM_MAIN_CAMSV_TOP_CAMSV>,
		<&cam_main_r1a_clk CLK_CAM_MAIN_CAM2MM0_GALS_CAMSV>,
		<&cam_main_r1a_clk CLK_CAM_MAIN_CAM2MM1_GALS_CAMSV>,
		<&cam_main_r1a_clk CLK_CAM_MAIN_CAM2SYS_GALS_CAMSV>,
		<&cam_main_r1a_clk CLK_CAM_MAIN_CAM2MM2_GALS_CAMSV>,
		<&cam_main_r1a_clk CLK_CAM_MAIN_CAMSV_B_CON_1_CAMSV>;
	clock-names = "cam_main_pdn",
		"cam_main_cam_cgpdn",
		"cam_main_larb13_con",
		"cam_main_camsv_top_con",
		"cam_main_cam2mm0_gals_con",
		"cam_main_cam2mm1_gals_con",
		"cam_main_cam2sys_gals_con",
		"cam_main_cam2mm2_gals_con",
		"cam_main_camsv_b_con";
};

&camsv3 {
	clocks =<&mm_pd_clk MT6991_PD_CAM_MAIN_CAMSV3>,
		<&cam_main_r1a_clk CLK_CAM_MAIN_CAM>,
		<&cam_main_r1a_clk CLK_CAM_MAIN_LARB29_CAMSV>,
		<&cam_main_r1a_clk CLK_CAM_MAIN_CAMSV_TOP_CAMSV>,
		<&cam_main_r1a_clk CLK_CAM_MAIN_CAM2MM0_GALS_CAMSV>,
		<&cam_main_r1a_clk CLK_CAM_MAIN_CAM2MM1_GALS_CAMSV>,
		<&cam_main_r1a_clk CLK_CAM_MAIN_CAM2SYS_GALS_CAMSV>,
		<&cam_main_r1a_clk CLK_CAM_MAIN_CAM2MM2_GALS_CAMSV>,
		<&cam_main_r1a_clk CLK_CAM_MAIN_CAMSV_C_CON_1_CAMSV>;
	clock-names = "cam_main_pdn",
		"cam_main_cam_cgpdn",
		"cam_main_larb29_con",
		"cam_main_camsv_top_con",
		"cam_main_cam2mm0_gals_con",
		"cam_main_cam2mm1_gals_con",
		"cam_main_cam2sys_gals_con",
		"cam_main_cam2mm2_gals_con",
		"cam_main_camsv_c_con";
};

&camsv4 {
	clocks =<&mm_pd_clk MT6991_PD_CAM_MAIN_CAMSV4>,
		<&cam_main_r1a_clk CLK_CAM_MAIN_CAM>,
		<&cam_main_r1a_clk CLK_CAM_MAIN_LARB29_CAMSV>,
		<&cam_main_r1a_clk CLK_CAM_MAIN_CAMSV_TOP_CAMSV>,
		<&cam_main_r1a_clk CLK_CAM_MAIN_CAM2MM0_GALS_CAMSV>,
		<&cam_main_r1a_clk CLK_CAM_MAIN_CAM2MM1_GALS_CAMSV>,
		<&cam_main_r1a_clk CLK_CAM_MAIN_CAM2SYS_GALS_CAMSV>,
		<&cam_main_r1a_clk CLK_CAM_MAIN_CAM2MM2_GALS_CAMSV>,
		<&cam_main_r1a_clk CLK_CAM_MAIN_CAMSV_D_CON_1_CAMSV>;
	clock-names = "cam_main_pdn",
		"cam_main_cam_cgpdn",
		"cam_main_larb29_con",
		"cam_main_camsv_top_con",
		"cam_main_cam2mm0_gals_con",
		"cam_main_cam2mm1_gals_con",
		"cam_main_cam2sys_gals_con",
		"cam_main_cam2mm2_gals_con",
		"cam_main_camsv_d_con";
};

&camsv5 {
	clocks =<&mm_pd_clk MT6991_PD_CAM_MAIN_CAMSV5>,
		<&cam_main_r1a_clk CLK_CAM_MAIN_CAM>,
		<&cam_main_r1a_clk CLK_CAM_MAIN_LARB29_CAMSV>,
		<&cam_main_r1a_clk CLK_CAM_MAIN_CAMSV_TOP_CAMSV>,
		<&cam_main_r1a_clk CLK_CAM_MAIN_CAM2MM0_GALS_CAMSV>,
		<&cam_main_r1a_clk CLK_CAM_MAIN_CAM2MM1_GALS_CAMSV>,
		<&cam_main_r1a_clk CLK_CAM_MAIN_CAM2SYS_GALS_CAMSV>,
		<&cam_main_r1a_clk CLK_CAM_MAIN_CAM2MM2_GALS_CAMSV>,
		<&cam_main_r1a_clk CLK_CAM_MAIN_CAMSV_E_CON_1_CAMSV>;
	clock-names = "cam_main_pdn",
		"cam_main_cam_cgpdn",
		"cam_main_larb29_con",
		"cam_main_camsv_top_con",
		"cam_main_cam2mm0_gals_con",
		"cam_main_cam2mm1_gals_con",
		"cam_main_cam2sys_gals_con",
		"cam_main_cam2mm2_gals_con",
		"cam_main_camsv_e_con";
};

&camsv6 {
	clocks =<&mm_pd_clk MT6991_PD_CAM_MAIN_CAMSV6>,
		<&cam_main_r1a_clk CLK_CAM_MAIN_CAM>,
		<&cam_main_r1a_clk CLK_CAM_MAIN_LARB29_CAMSV>,
		<&cam_main_r1a_clk CLK_CAM_MAIN_CAMSV_TOP_CAMSV>,
		<&cam_main_r1a_clk CLK_CAM_MAIN_CAM2MM0_GALS_CAMSV>,
		<&cam_main_r1a_clk CLK_CAM_MAIN_CAM2MM1_GALS_CAMSV>,
		<&cam_main_r1a_clk CLK_CAM_MAIN_CAM2SYS_GALS_CAMSV>,
		<&cam_main_r1a_clk CLK_CAM_MAIN_CAM2MM2_GALS_CAMSV>,
		<&cam_main_r1a_clk CLK_CAM_MAIN_CAMSV_CON_1_CAMSV>;
	clock-names = "cam_main_pdn",
		"cam_main_cam_cgpdn",
		"cam_main_larb29_con",
		"cam_main_camsv_top_con",
		"cam_main_cam2mm0_gals_con",
		"cam_main_cam2mm1_gals_con",
		"cam_main_cam2sys_gals_con",
		"cam_main_cam2mm2_gals_con",
		"cam_main_camsv_f_con";
};

&mraw1 {
	clocks =<&mm_pd_clk MT6991_PD_CAM_MRAW_MRAW1>,
		<&cam_main_r1a_clk CLK_CAM_MAIN_CAM>,
		<&cam_main_r1a_clk CLK_CAM_MAIN_CAM_MRAW>,
		<&cam_main_r1a_clk CLK_CAM_MAIN_CAM2MM0_GALS>,
		<&cam_main_r1a_clk CLK_CAM_MAIN_CAM2MM1_GALS>,
		<&camsys_mraw_clk CLK_CAM_MR_LARBX_PDAF>,
		<&camsys_mraw_clk CLK_CAM_MR_GALS_PDAF>,
		<&camsys_mraw_clk CLK_CAM_MR_CAMTG_PDAF>,
		<&camsys_mraw_clk CLK_CAM_MR_MRAW0_PDAF>;
	clock-names = "cam_main_mraw_pdn",
		"cam_main_cam_cgpdn",
		"cam_main_mraw_cg_con",
		"cam_main_cam2mm0_gals_con",
		"cam_main_cam2mm1_gals_con",
		"camsys_mraw_larbx",
		"camsys_mraw_gals",
		"camsys_mraw_camtg",
		"camsys_main_mraw0";
};

&mraw2 {
	clocks =<&mm_pd_clk MT6991_PD_CAM_MRAW_MRAW2>,
		<&cam_main_r1a_clk CLK_CAM_MAIN_CAM>,
		<&cam_main_r1a_clk CLK_CAM_MAIN_CAM_MRAW>,
		<&cam_main_r1a_clk CLK_CAM_MAIN_CAM2MM0_GALS>,
		<&cam_main_r1a_clk CLK_CAM_MAIN_CAM2MM1_GALS>,
		<&camsys_mraw_clk CLK_CAM_MR_LARBX_PDAF>,
		<&camsys_mraw_clk CLK_CAM_MR_GALS_PDAF>,
		<&camsys_mraw_clk CLK_CAM_MR_CAMTG_PDAF>,
		<&camsys_mraw_clk CLK_CAM_MR_MRAW1_PDAF>;
	clock-names = "cam_main_mraw_pdn",
		"cam_main_cam_cgpdn",
		"cam_main_mraw_cg_con",
		"cam_main_cam2mm0_gals_con",
		"cam_main_cam2mm1_gals_con",
		"camsys_mraw_larbx",
		"camsys_mraw_gals",
		"camsys_mraw_camtg",
		"camsys_main_mraw1";
};

&mraw3 {
	clocks =<&mm_pd_clk MT6991_PD_CAM_MRAW_MRAW3>,
		<&cam_main_r1a_clk CLK_CAM_MAIN_CAM>,
		<&cam_main_r1a_clk CLK_CAM_MAIN_CAM_MRAW>,
		<&cam_main_r1a_clk CLK_CAM_MAIN_CAM2MM0_GALS>,
		<&cam_main_r1a_clk CLK_CAM_MAIN_CAM2MM1_GALS>,
		<&camsys_mraw_clk CLK_CAM_MR_LARBX_PDAF>,
		<&camsys_mraw_clk CLK_CAM_MR_GALS_PDAF>,
		<&camsys_mraw_clk CLK_CAM_MR_CAMTG_PDAF>,
		<&camsys_mraw_clk CLK_CAM_MR_MRAW2_PDAF>;
	clock-names = "cam_main_mraw_pdn",
		"cam_main_cam_cgpdn",
		"cam_main_mraw_cg_con",
		"cam_main_cam2mm0_gals_con",
		"cam_main_cam2mm1_gals_con",
		"camsys_mraw_larbx",
		"camsys_mraw_gals",
		"camsys_mraw_camtg",
		"camsys_main_mraw2";
};

&mraw4 {
	clocks =<&mm_pd_clk MT6991_PD_CAM_MRAW_MRAW4>,
		<&cam_main_r1a_clk CLK_CAM_MAIN_CAM>,
		<&cam_main_r1a_clk CLK_CAM_MAIN_CAM_MRAW>,
		<&cam_main_r1a_clk CLK_CAM_MAIN_CAM2MM0_GALS>,
		<&cam_main_r1a_clk CLK_CAM_MAIN_CAM2MM1_GALS>,
		<&camsys_mraw_clk CLK_CAM_MR_LARBX_PDAF>,
		<&camsys_mraw_clk CLK_CAM_MR_GALS_PDAF>,
		<&camsys_mraw_clk CLK_CAM_MR_CAMTG_PDAF>,
		<&camsys_mraw_clk CLK_CAM_MR_MRAW3_PDAF>;
	clock-names = "cam_main_mraw_pdn",
		"cam_main_cam_cgpdn",
		"cam_main_mraw_cg_con",
		"cam_main_cam2mm0_gals_con",
		"cam_main_cam2mm1_gals_con",
		"camsys_mraw_larbx",
		"camsys_mraw_gals",
		"camsys_mraw_camtg",
		"camsys_main_mraw3";
};

&pda {
	ccf-apply;
	clocks = <&mm_pd_clk MT6991_PD_CAM_MRAW_PDA2>,
		<&mm_pd_clk MT6991_PD_CAM_MRAW_PDA>,
		<&cam_main_r1a_clk CLK_CAM_MAIN_CAM>,
		<&cam_main_r1a_clk CLK_CAM_MAIN_CAM2MM0_GALS>,
		<&cam_main_r1a_clk CLK_CAM_MAIN_CAM2MM1_GALS>,
		<&camsys_mraw_clk CLK_CAM_MR_LARBX_PDAF>,
		<&camsys_mraw_clk CLK_CAM_MR_PDA1_PDA>,
		<&camsys_mraw_clk CLK_CAM_MR_PDA0_PDA>;
	clock-names = "cam_mraw_pda2",
		"cam_mraw_pda",
		"cam_main_cam_cg_con",
		"cam_main_cam2mm0_gals_cg_con",
		"cam_main_cam2mm1_gals_cg_con",
		"mraw_larbx",
		"camsys_mraw_pda1",
		"camsys_mraw_pda0";
};

&pda2 {
	ccf-apply;
	clocks = <&mm_pd_clk MT6991_PD_CAM_MRAW_PDA2>,
		<&mm_pd_clk MT6991_PD_CAM_MRAW_PDA>,
		<&cam_main_r1a_clk CLK_CAM_MAIN_CAM>,
		<&cam_main_r1a_clk CLK_CAM_MAIN_CAM2MM0_GALS>,
		<&cam_main_r1a_clk CLK_CAM_MAIN_CAM2MM1_GALS>,
		<&camsys_mraw_clk CLK_CAM_MR_LARBX_PDAF>,
		<&camsys_mraw_clk CLK_CAM_MR_PDA1_PDA>,
		<&camsys_mraw_clk CLK_CAM_MR_PDA0_PDA>;
	clock-names = "cam_mraw_pda2",
		"cam_mraw_pda",
		"cam_main_cam_cg_con",
		"cam_main_cam2mm0_gals_cg_con",
		"cam_main_cam2mm1_gals_cg_con",
		"mraw_larbx",
		"camsys_mraw_pda1",
		"camsys_mraw_pda0";
};

&ccu_rproc {
	ccf-apply;
};

&dvs {
	ccf-apply;
};

&dvp {
	ccf-apply;
};

&dvgf {
	ccf-apply;
};

&imgsys_fw {
	compatible = "mediatek,imgsys-isp8-mt6991-swrgo";
	ccf-apply;
	clocks = <&mm_pd_clk MT6991_PD_ISP_MAIN_IMGSYS_FW>,
		<&img_vcore_d1a_clk CLK_IMG_VCORE_GALS_DISP_CAMERA_P2>,
		<&img_vcore_d1a_clk CLK_IMG_VCORE_MAIN_CAMERA_P2>,
		<&img_vcore_d1a_clk CLK_IMG_VCORE_SUB0_CAMERA_P2>,
		<&img_vcore_d1a_clk CLK_IMG_VCORE_SUB1_CAMERA_P2>,
		<&imgsys_main_clk CLK_IMG_LARB9_CAMERA_P2>,
		<&imgsys_main_clk CLK_IMG_TRAW0_CAMERA_P2>,
		<&imgsys_main_clk CLK_IMG_TRAW1_CAMERA_P2>,
		<&imgsys_main_clk CLK_IMG_DIP0_CAMERA_P2>,
		<&imgsys_main_clk CLK_IMG_WPE0_CAMERA_P2>,
		<&imgsys_main_clk CLK_IMG_IPE_CAMERA_P2>,
		<&imgsys_main_clk CLK_IMG_WPE1_CAMERA_P2>,
		<&imgsys_main_clk CLK_IMG_WPE2_CAMERA_P2>,
		<&imgsys_main_clk CLK_IMG_ADL_LARB_CAMERA_P2>,
		<&imgsys_main_clk CLK_IMG_ADLRD_CAMERA_P2>,
		<&imgsys_main_clk CLK_IMG_ADLWR0_CAMERA_P2>,
		<&imgsys_main_clk CLK_IMG_AVS_CAMERA_P2>,
		<&imgsys_main_clk CLK_IMG_IPS_CAMERA_P2>,
		<&imgsys_main_clk CLK_IMG_ADLWR1_CAMERA_P2>,
		<&imgsys_main_clk CLK_IMG_ROOTCQ_CAMERA_P2>,
		<&imgsys_main_clk CLK_IMG_BLS_CAMERA_P2>,
		<&imgsys_main_clk CLK_IMG_SUB_COMMON0_CAMERA_P2>,
		<&imgsys_main_clk CLK_IMG_SUB_COMMON1_CAMERA_P2>,
		<&imgsys_main_clk CLK_IMG_SUB_COMMON2_CAMERA_P2>,
		<&imgsys_main_clk CLK_IMG_SUB_COMMON3_CAMERA_P2>,
		<&imgsys_main_clk CLK_IMG_SUB_COMMON4_CAMERA_P2>,
		<&imgsys_main_clk CLK_IMG_GALS_RX_DIP0_CAMERA_P2>,
		<&imgsys_main_clk CLK_IMG_GALS_RX_DIP1_CAMERA_P2>,
		<&imgsys_main_clk CLK_IMG_GALS_RX_TRAW0_CAMERA_P2>,
		<&imgsys_main_clk CLK_IMG_GALS_RX_WPE0_CAMERA_P2>,
		<&imgsys_main_clk CLK_IMG_GALS_RX_WPE1_CAMERA_P2>,
		<&imgsys_main_clk CLK_IMG_GALS_RX_WPE2_CAMERA_P2>,
		<&imgsys_main_clk CLK_IMG_GALS_TRX_IPE0_CAMERA_P2>,
		<&imgsys_main_clk CLK_IMG_GALS_TRX_IPE1_CAMERA_P2>,
		<&imgsys_main_clk CLK_IMG26_CAMERA_P2>,
		<&imgsys_main_clk CLK_IMG_BWR_CAMERA_P2>,
		<&imgsys_main_clk CLK_IMG_GALS_CAMERA_P2>,
		<&imgsys_main_clk CLK_IMG_ME_CAMERA_P2>,
		<&imgsys_main_clk CLK_IMG_MMG_CAMERA_P2>,
		<&imgsys_main_clk CLK_IMG_FDVT_CAMERA_P2>,
		<&imgsys_main_clk CLK_IMG_LARB12_CAMERA_P2>,
		<&dip_top_dip1_clk CLK_DIP_TOP_DIP1_DIP_TOP_CAMERA_P2>,
		<&dip_top_dip1_clk CLK_DIP_TOP_DIP1_DIP_TOP_GALS0_CAMERA_P2>,
		<&dip_top_dip1_clk CLK_DIP_TOP_DIP1_DIP_TOP_GALS1_CAMERA_P2>,
		<&dip_top_dip1_clk CLK_DIP_TOP_DIP1_DIP_TOP_GALS2_CAMERA_P2>,
		<&dip_top_dip1_clk CLK_DIP_TOP_DIP1_DIP_TOP_GALS3_CAMERA_P2>,
		<&dip_top_dip1_clk CLK_DIP_TOP_DIP1_LARB10_CAMERA_P2>,
		<&dip_top_dip1_clk CLK_DIP_TOP_DIP1_LARB15_CAMERA_P2>,
		<&dip_top_dip1_clk CLK_DIP_TOP_DIP1_LARB38_CAMERA_P2>,
		<&dip_top_dip1_clk CLK_DIP_TOP_DIP1_LARB39_CAMERA_P2>,
		<&dip_nr1_dip1_clk CLK_DIP_NR1_DIP1_LARB_CAMERA_P2>,
		<&dip_nr1_dip1_clk CLK_DIP_NR1_DIP1_DIP_NR1_CAMERA_P2>,
		<&dip_nr2_dip1_clk CLK_DIP_NR2_DIP1_DIP_NR_CAMERA_P2>,
		<&dip_nr2_dip1_clk CLK_DIP_NR2_DIP1_LARB15_CAMERA_P2>,
		<&dip_nr2_dip1_clk CLK_DIP_NR2_DIP1_LARB39_CAMERA_P2>,
		<&wpe1_dip1_clk CLK_WPE1_DIP1_LARB11_CAMERA_P2>,
		<&wpe1_dip1_clk CLK_WPE1_DIP1_WPE_CAMERA_P2>,
		<&wpe1_dip1_clk CLK_WPE1_DIP1_GALS0_CAMERA_P2>,
		<&wpe2_dip1_clk CLK_WPE2_DIP1_LARB11_CAMERA_P2>,
		<&wpe2_dip1_clk CLK_WPE2_DIP1_WPE_CAMERA_P2>,
		<&wpe2_dip1_clk CLK_WPE2_DIP1_GALS0_CAMERA_P2>,
		<&wpe3_dip1_clk CLK_WPE3_DIP1_LARB11_CAMERA_P2>,
		<&wpe3_dip1_clk CLK_WPE3_DIP1_WPE_CAMERA_P2>,
		<&wpe3_dip1_clk CLK_WPE3_DIP1_GALS0_CAMERA_P2>,
		<&traw_dip1_clk CLK_TRAW_DIP1_LARB28_CAMERA_P2>,
		<&traw_dip1_clk CLK_TRAW_DIP1_LARB40_CAMERA_P2>,
		<&traw_dip1_clk CLK_TRAW_DIP1_TRAW_CAMERA_P2>,
		<&traw_dip1_clk CLK_TRAW_DIP1_GALS_CAMERA_P2>,
		<&traw_cap_dip1_clk CLK_TRAW_CAP_DIP1_TRAW_CAP_CAMERA_P2>,
		<&mmdvfs_mux MMDVFS_USER_IMG>;
	clock-names = "imgsys_pd_imgsys_fw",
		"VCORE_GALS",
		"VCORE_MAIN",
		"VCORE_SUB0",
		"VCORE_SUB1",
		"IMG_LARB9",
		"IMG_TRAW0",
		"IMG_TRAW1",
		"IMG_DIP0",
		"IMG_WPE0",
		"IMG_IPE",
		"IMG_WPE1",
		"IMG_WPE2",
		"IMG_ADL_LARB",
		"IMG_ADLRD",
		"IMG_ADLWR0",
		"IMG_AVS",
		"IMG_IPS",
		"IMG_ADLWR1",
		"IMG_ROOTCQ",
		"IMG_BLS",
		"IMG_SUB_COMMON0",
		"IMG_SUB_COMMON1",
		"IMG_SUB_COMMON2",
		"IMG_SUB_COMMON3",
		"IMG_SUB_COMMON4",
		"IMG_GALS_RX_DIP0",
		"IMG_GALS_RX_DIP1",
		"IMG_GALS_RX_TRAW0",
		"IMG_GALS_RX_WPE0",
		"IMG_GALS_RX_WPE1",
		"IMG_GALS_RX_WPE2",
		"IMG_GALS_TRX_IPE0",
		"IMG_GALS_TRX_IPE1",
		"IMG26",
		"IMG_BWR",
		"IMG_GALS",
		"IMG_ME",
		"IMG_MMG",
		"IMG_FDVT",
		"IMG_LARB12",
		"DIP_TOP_DIP1_DIP_TOP",
		"DIP_TOP_DIP1_DIP_TOP_GALS0",
		"DIP_TOP_DIP1_DIP_TOP_GALS1",
		"DIP_TOP_DIP1_DIP_TOP_GALS2",
		"DIP_TOP_DIP1_DIP_TOP_GALS3",
		"DIP_TOP_DIP1_LARB10",
		"DIP_TOP_DIP1_LARB15",
		"DIP_TOP_DIP1_LARB38",
		"DIP_TOP_DIP1_LARB39",
		"DIP_NR1_DIP1_LARB",
		"DIP_NR1_DIP1_DIP_NR1",
		"DIP_NR2_DIP1_DIP_NR",
		"DIP_NR2_DIP1_LARB15",
		"DIP_NR2_DIP1_LARB39",
		"WPE1_DIP1_LARB11",
		"WPE1_DIP1_WPE",
		"WPE1_DIP1_GALS0",
		"WPE2_DIP1_LARB11",
		"WPE2_DIP1_WPE",
		"WPE2_DIP1_GALS0",
		"WPE3_DIP1_LARB11",
		"WPE3_DIP1_WPE",
		"WPE3_DIP1_GALS0",
		"TRAW_DIP1_LARB28",
		"TRAW_DIP1_LARB40",
		"TRAW_DIP1_TRAW",
		"TRAW_DIP1_GALS",
		"TRAW_CAP_DIP1_TRAW_CAP",
		"mmdvfs_mux";
};

&disp_aal0 {
	mtk-dre30-support = <1>;
};

&ise_mbox {
	mediatek,real-drv = <1>;
};

&ise_lpm {
	ise-wakelock = <1>;
	ise-lpm-freerun = <1>;
	ise-lpm-deinit-bypass = <0>;
	power-domains = <&scpsys MT6991_POWER_DOMAIN_SSR>;
};

&ise_trusty {
	mediatek,real-drv = <1>;
};

&pio {
	mtkfb_pins_lcd_bias_enp1: lcd-bias-enp1-gpio {
		pins-cmd-dat {
			pinmux = <PINMUX_GPIO103__FUNC_GPIO103>;
			slew-rate = <1>;
			output-high;
		};
	};

	mtkfb_pins_lcd_bias_enp0: lcd-bias-enp0-gpio {
		pins-cmd-dat {
			pinmux = <PINMUX_GPIO103__FUNC_GPIO103>;
			slew-rate = <1>;
			output-low;
		};
	};

	mtkfb_pins_lcd_bias_enn1: lcd-bias-enn1-gpio {
		pins-cmd-dat {
			pinmux = <PINMUX_GPIO103__FUNC_GPIO103>;
			slew-rate = <1>;
			output-high;
		};
	};

	mtkfb_pins_lcd_bias_enn0: lcd-bias-enn0-gpio {
		pins-cmd-dat {
			pinmux = <PINMUX_GPIO103__FUNC_GPIO103>;
			slew-rate = <1>;
			output-low;
		};
	};

	mtkfb_pins_lcm_rst_out1_gpio: lcm-rst-out1-gpio {
		pins-cmd-dat {
			pinmux = <PINMUX_GPIO90__FUNC_GPIO90>;
			slew-rate = <1>;
			output-high;
		};
	};

	mtkfb_pins_lcm_rst_out0_gpio: lcm-rst-out0-gpio {
		pins-cmd-dat {
			pinmux = <PINMUX_GPIO90__FUNC_GPIO90>;
			slew-rate = <1>;
			output-low;
		};
	};
	mtkfb_pins_lcm_dsi_te: lcm-dsi-te {
		pins-cmd-dat {
			pinmux = <PINMUX_GPIO89__FUNC_DSI_TE>;
		};
	};

	mtkfb_pins_lcm_led_en1: lcm-led-en1-gpio {
		pins-cmd-dat {
			pinmux = <PINMUX_GPIO174__FUNC_GPIO174>;
			slew-rate = <1>;
			output-high;
		};
	};

	mtkfb_pins_lcm_led_en0: lcm-led-en0-gpio {
		pins-cmd-dat {
			pinmux = <PINMUX_GPIO174__FUNC_GPIO174>;
			slew-rate = <1>;
			output-low;
		};
	};

	mtkfb_pins_lcm_dsi1_te: lcm-dsi1-te {
		pins-cmd-dat {
			pinmux = <PINMUX_GPIO6__FUNC_DSI1_TE>;
		};
	};
};

&mtkfb {
	pinctrl-names = "lcd_bias_enp1_gpio", "lcd_bias_enp0_gpio",
		"lcd_bias_enn1_gpio", "lcd_bias_enn0_gpio",
		"lcm_rst_out1_gpio", "lcm_rst_out0_gpio",
		"mode_te_te", "lcm_led_en1_gpio", "lcm_led_en0_gpio",
		"mode_te_te1";
	pinctrl-0 = <&mtkfb_pins_lcd_bias_enp1>;
	pinctrl-1 = <&mtkfb_pins_lcd_bias_enp0>;
	pinctrl-2 = <&mtkfb_pins_lcd_bias_enn1>;
	pinctrl-3 = <&mtkfb_pins_lcd_bias_enn0>;
	pinctrl-4 = <&mtkfb_pins_lcm_rst_out1_gpio>;
	pinctrl-5 = <&mtkfb_pins_lcm_rst_out0_gpio>;
	pinctrl-6 = <&mtkfb_pins_lcm_dsi_te>;
	pinctrl-7 = <&mtkfb_pins_lcm_led_en1>;
	pinctrl-8 = <&mtkfb_pins_lcm_led_en0>;
	pinctrl-9 = <&mtkfb_pins_lcm_dsi1_te>;

	status = "okay";
};

&hfrpsys {
	compatible = "mediatek,mt6991-hfrpsys-hwv-swrgo", "syscon";
	clocks =
		/* CCU */
		<&cksys_gp2_clk CLK_CK2_CCUSYS_SEL>,
		<&mm_pd_clk MT6991_PD_CAM_VCORE_CCU>;
	clock-names = "ccusys", "cam_vcore_ccu";
};

&disp_ssc0_smi_2x1_sub_comm {
	power-domains;
	no-pm-runtime;
	mediatek,pd-id = <MT6991_SMI_PD_MMINFRA1>;
};

&disp_ssc1_smi_2x1_sub_comm {
	power-domains;
	no-pm-runtime;
	mediatek,pd-id = <MT6991_SMI_PD_MMINFRA1>;
};

&mdp_ssc4_smi_2x1_sub_comm {
	power-domains;
	no-pm-runtime;
	mediatek,pd-id = <MT6991_SMI_PD_MMINFRA1>;
};

&mdp_ssc5_smi_2x1_sub_comm {
	power-domains;
	no-pm-runtime;
	mediatek,pd-id = <MT6991_SMI_PD_MMINFRA1>;
};

&mmsram_smi_2x1_sub_comm3 {
	power-domains;
	no-pm-runtime;
	mediatek,pd-id = <MT6991_SMI_PD_MMINFRA1>;
};

&mmsram_smi_2x1_sub_comm4 {
	power-domains;
	no-pm-runtime;
	mediatek,pd-id = <MT6991_SMI_PD_MMINFRA1>;
};

&smi_disp_common {
	power-domains;
	no-pm-runtime;
	mediatek,pd-id = <MT6991_SMI_PD_MMINFRA1>;
};

&smi_mdp_common {
	power-domains;
	no-pm-runtime;
	mediatek,pd-id = <MT6991_SMI_PD_MMINFRA1>;
};

&smi_sysram_common {
	power-domains;
	no-pm-runtime;
	mediatek,pd-id = <MT6991_SMI_PD_MMINFRA1>;
};

&smi_disp_dram_sub_comm0 {
	power-domains;
	no-pm-runtime;
	clocks = <&mm_pd_clk MT6991_PD_DISP_VCORE_SMI>,
		<&disp_vdisp_ao_config_clk CLK_MM_V_SMI_SUB_SOMM0_SMI>;
	clock-names = "smi_pd", "apb";
	mediatek,pd-id = <MT6991_SMI_PD_DISP_VCORE>;
};

&smi_disp_dram_sub_comm1 {
	power-domains;
	no-pm-runtime;
	clocks = <&mm_pd_clk MT6991_PD_DISP_VCORE_SMI>,
		<&disp_vdisp_ao_config_clk CLK_MM_V_SMI_SUB_SOMM0_SMI>;
	clock-names = "smi_pd", "apb";
	mediatek,pd-id = <MT6991_SMI_PD_DISP_VCORE>;
};

&smi_mdp_dram_sub_comm2 {
	power-domains;
	no-pm-runtime;
	clocks = <&mm_pd_clk MT6991_PD_DISP_VCORE_SMI>,
		<&disp_vdisp_ao_config_clk CLK_MM_V_SMI_SUB_SOMM0_SMI>;
	clock-names = "smi_pd", "apb";
	mediatek,pd-id = <MT6991_SMI_PD_DISP_VCORE>;
};

&smi_mdp_dram_sub_comm3 {
	power-domains;
	no-pm-runtime;
	clocks = <&mm_pd_clk MT6991_PD_DISP_VCORE_SMI>,
		<&disp_vdisp_ao_config_clk CLK_MM_V_SMI_SUB_SOMM0_SMI>;
	clock-names = "smi_pd", "apb";
	mediatek,pd-id = <MT6991_SMI_PD_DISP_VCORE>;
};

&smi_sram_disp_sub_comm0 {
	power-domains;
	no-pm-runtime;
	clocks = <&mm_pd_clk MT6991_PD_DISP_VCORE_SMI>,
		<&disp_vdisp_ao_config_clk CLK_MM_V_SMI_SUB_SOMM0_SMI>;
	clock-names = "smi_pd", "apb";
	mediatek,pd-id = <MT6991_SMI_PD_DISP_VCORE>;
};

&smi_sram_disp_sub_comm1 {
	power-domains;
	no-pm-runtime;
	clocks = <&mm_pd_clk MT6991_PD_DISP_VCORE_SMI>,
		<&disp_vdisp_ao_config_clk CLK_MM_V_SMI_SUB_SOMM0_SMI>;
	clock-names = "smi_pd", "apb";
	mediatek,pd-id = <MT6991_SMI_PD_DISP_VCORE>;
};

&smi_larb0 {
	power-domains;
	no-pm-runtime;
	clocks = <&mm_pd_clk MT6991_PD_OVL0_SMI>,
		<&ovlsys_config_clk CLK_OVL_SMI_SMI>;
	clock-names = "smi_pd", "apb";
	mediatek,pd-id = <MT6991_SMI_PD_OVL0>;
};

&smi_larb1 {
	power-domains;
	no-pm-runtime;
	clocks = <&mm_pd_clk MT6991_PD_OVL0_SMI>,
		<&ovlsys_config_clk CLK_OVL_SMI_SMI>;
	clock-names = "smi_pd", "apb";
	mediatek,pd-id = <MT6991_SMI_PD_OVL0>;
};

&smi_larb20 {
	power-domains;
	no-pm-runtime;
	clocks = <&mm_pd_clk MT6991_PD_OVL0_SMI>,
		<&ovlsys_config_clk CLK_OVL_SMI_SMI>;
	clock-names = "smi_pd", "apb";
	mediatek,pd-id = <MT6991_SMI_PD_OVL0>;
};

&smi_larb21 {
	power-domains;
	no-pm-runtime;
	clocks = <&mm_pd_clk MT6991_PD_OVL0_SMI>,
		<&ovlsys_config_clk CLK_OVL_SMI_SMI>;
	clock-names = "smi_pd", "apb";
	mediatek,pd-id = <MT6991_SMI_PD_OVL0>;
};

&smi_larb32 {
	power-domains;
	no-pm-runtime;
	clocks = <&mm_pd_clk MT6991_PD_DIS0_SMI>,
		<&dispsys_config_clk CLK_MM_SMI_SUB_COMM0_SMI>;
	clock-names = "smi_pd", "apb";
	mediatek,pd-id = <MT6991_SMI_PD_DIS0>;
};

&smi_larb33 {
	power-domains;
	no-pm-runtime;
	clocks = <&mm_pd_clk MT6991_PD_DIS1_SMI>,
		<&dispsys1_config_clk CLK_MM1_SMI_LARB0_SMI>;
	clock-names = "smi_pd", "apb";
	mediatek,pd-id = <MT6991_SMI_PD_DIS1>;
};

&smi_larb34 {
	power-domains;
	no-pm-runtime;
	clocks = <&mm_pd_clk MT6991_PD_OVL1_SMI>,
		<&ovlsys1_config_clk CLK_OVL1_SMI_SMI>;
	clock-names = "smi_pd", "apb";
	mediatek,pd-id = <MT6991_SMI_PD_OVL1>;
};

&smi_larb35 {
	power-domains;
	no-pm-runtime;
	clocks = <&mm_pd_clk MT6991_PD_OVL1_SMI>,
		<&ovlsys1_config_clk CLK_OVL1_SMI_SMI>;
	clock-names = "smi_pd", "apb";
	mediatek,pd-id = <MT6991_SMI_PD_OVL1>;
};

&smi_larb36 {
	power-domains;
	no-pm-runtime;
	clocks = <&mm_pd_clk MT6991_PD_OVL1_SMI>,
		<&ovlsys1_config_clk CLK_OVL1_SMI_SMI>;
	clock-names = "smi_pd", "apb";
	mediatek,pd-id = <MT6991_SMI_PD_OVL1>;
};

&smi_larb37 {
	power-domains;
	no-pm-runtime;
	clocks = <&mm_pd_clk MT6991_PD_OVL1_SMI>,
		<&ovlsys1_config_clk CLK_OVL1_SMI_SMI>;
	clock-names = "smi_pd", "apb";
	mediatek,pd-id = <MT6991_SMI_PD_OVL1>;
};

&smi_larb2 {
	power-domains;
	no-pm-runtime;
	clocks = <&mm_pd_clk MT6991_PD_MML0_SMI>,
		<&mdpsys_config_clk CLK_MDP_SMI0_SMI>;
	clock-names = "smi_pd", "apb";
	mediatek,pd-id = <MT6991_SMI_PD_MML0>;
};

&smi_larb3 {
	power-domains;
	no-pm-runtime;
	clocks = <&mm_pd_clk MT6991_PD_MML1_SMI>,
		<&mdpsys1_config_clk CLK_MDP1_SMI0_SMI>;
	clock-names = "smi_pd", "apb";
	mediatek,pd-id = <MT6991_SMI_PD_MML1>;
};

&smi_larb4 {
	power-domains;
	no-pm-runtime;
	mediatek,pd-id = <MT6991_SMI_PD_VDE1>;
};

&smi_larb5 {
	power-domains;
	no-pm-runtime;
	mediatek,pd-id = <MT6991_SMI_PD_VDE0>;
};

&smi_larb6 {
	power-domains;
	no-pm-runtime;
	mediatek,pd-id = <MT6991_SMI_PD_VDE0>;
};

&smi_disp_venc_sub_comm0 {
	power-domains;
	no-pm-runtime;
	clocks = <&mm_pd_clk MT6991_PD_VEN0_SMI>,
		<&venc_gcon_clk CLK_VEN1_CKE0_LARB_SMI>,
		<&venc_gcon_clk CLK_VEN1_CKE1_VENC_SMI>;
	clock-names = "smi_pd", "apb", "smi";
	mediatek,pd-id = <MT6991_SMI_PD_VEN0>;
};

&smi_mdp_venc_sub_comm1 {
	power-domains;
	no-pm-runtime;
	clocks = <&mm_pd_clk MT6991_PD_VEN1_SMI>,
		<&venc_gcon_core1_clk CLK_VEN2_CKE0_LARB_SMI>,
		<&venc_gcon_core1_clk CLK_VEN2_CKE1_VENC_SMI>;
	clock-names = "smi_pd", "apb", "smi";
	mediatek,pd-id = <MT6991_SMI_PD_VEN1>;
};

&smi_sram_venc_sub_comm {
	power-domains;
	no-pm-runtime;
	clocks = <&mm_pd_clk MT6991_PD_VEN1_SMI>,
		<&venc_gcon_core1_clk CLK_VEN2_CKE0_LARB_SMI>,
		<&venc_gcon_core1_clk CLK_VEN2_CKE1_VENC_SMI>;
	clock-names = "smi_pd", "apb", "smi";
	mediatek,pd-id = <MT6991_SMI_PD_VEN1>;
};

&smi_mdp_venc_sub_comm2 {
	power-domains;
	no-pm-runtime;
	clocks = <&mm_pd_clk MT6991_PD_VEN2_SMI>,
		<&venc_gcon_core2_clk CLK_VEN_C2_CKE0_LARB_SMI>,
		<&venc_gcon_core2_clk CLK_VEN_C2_CKE1_VENC_SMI>;
	clock-names = "smi_pd", "apb", "smi";
	mediatek,pd-id = <MT6991_SMI_PD_VEN2>;
};

&smi_larb7 {
	power-domains;
	no-pm-runtime;
	clocks = <&mm_pd_clk MT6991_PD_VEN0_SMI>,
		<&venc_gcon_clk CLK_VEN1_CKE0_LARB_SMI>,
		<&venc_gcon_clk CLK_VEN1_CKE1_VENC_SMI>;
	clock-names = "smi_pd", "apb", "smi";
	mediatek,pd-id = <MT6991_SMI_PD_VEN0>;
};

&smi_larb8 {
	power-domains;
	no-pm-runtime;
	clocks = <&mm_pd_clk MT6991_PD_VEN1_SMI>,
		<&venc_gcon_core1_clk CLK_VEN2_CKE0_LARB_SMI>,
		<&venc_gcon_core1_clk CLK_VEN2_CKE1_VENC_SMI>;
	clock-names = "smi_pd", "apb", "smi";
	mediatek,pd-id = <MT6991_SMI_PD_VEN1>;
};

&smi_larb24 {
	power-domains;
	no-pm-runtime;
	clocks = <&mm_pd_clk MT6991_PD_VEN2_SMI>,
		<&venc_gcon_core2_clk CLK_VEN_C2_CKE0_LARB_SMI>,
		<&venc_gcon_core2_clk CLK_VEN_C2_CKE1_VENC_SMI>;
	clock-names = "smi_pd", "apb", "smi";
	mediatek,pd-id = <MT6991_SMI_PD_VEN2>;
};

&smi_larb41 {
	power-domains;
	no-pm-runtime;
	clocks = <&mm_pd_clk MT6991_PD_VEN0_SMI>,
		<&venc_gcon_clk CLK_VEN1_CKE0_LARB_SMI>,
		<&venc_gcon_clk CLK_VEN1_CKE1_VENC_SMI>;
	clock-names = "smi_pd", "apb", "smi";
	mediatek,pd-id = <MT6991_SMI_PD_VEN0>;
};

&smi_larb42 {
	power-domains;
	no-pm-runtime;
	clocks = <&mm_pd_clk MT6991_PD_VEN1_SMI>,
		<&venc_gcon_core1_clk CLK_VEN2_CKE0_LARB_SMI>,
		<&venc_gcon_core1_clk CLK_VEN2_CKE1_VENC_SMI>;
	clock-names = "smi_pd", "apb", "smi";
	mediatek,pd-id = <MT6991_SMI_PD_VEN1>;
};

&smi_larb47 {
	power-domains;
	no-pm-runtime;
	clocks = <&mm_pd_clk MT6991_PD_VEN2_SMI>,
		<&venc_gcon_core2_clk CLK_VEN_C2_CKE0_LARB_SMI>,
		<&venc_gcon_core2_clk CLK_VEN_C2_CKE1_VENC_SMI>;
	clock-names = "smi_pd", "apb", "smi";
	mediatek,pd-id = <MT6991_SMI_PD_VEN2>;
};

&smi_img_vcore_sub_comm0 {
	power-domains;
	no-pm-runtime;
	clocks = <&mm_pd_clk MT6991_PD_ISP_VCORE_SMI>,
		<&img_vcore_d1a_clk CLK_IMG_VCORE_SUB0_SMI>,
		<&img_vcore_d1a_clk CLK_IMG_VCORE_GALS_DISP_CAMERA_P2>;
	clock-names = "smi_pd", "apb", "smi";
	mediatek,pd-id = <MT6991_SMI_PD_ISP_VCORE>;
};

&smi_img_vcore_sub_comm1 {
	power-domains;
	no-pm-runtime;
	clocks = <&mm_pd_clk MT6991_PD_ISP_VCORE_SMI>,
		<&img_vcore_d1a_clk CLK_IMG_VCORE_SUB1_SMI>,
		<&img_vcore_d1a_clk CLK_IMG_VCORE_GALS_DISP_CAMERA_P2>;
	clock-names = "smi_pd", "apb", "smi";
	mediatek,pd-id = <MT6991_SMI_PD_ISP_VCORE>;
};

&smi_img_sub_comm0 {
	power-domains;
	no-pm-runtime;
	clocks = <&mm_pd_clk MT6991_PD_ISP_MAIN_SMI>,
		<&img_vcore_d1a_clk CLK_IMG_VCORE_MAIN_CAMERA_P2>,
		<&imgsys_main_clk CLK_IMG_SUB_COMMON0_SMI>,
		<&imgsys_main_clk CLK_IMG_GALS_CAMERA_P2>;
	clock-names = "smi_pd", "apb", "smi", "gals0";
	mediatek,pd-id = <MT6991_SMI_PD_ISP_MAIN>;
};

&smi_img_sub_comm3 {
	power-domains;
	no-pm-runtime;
	clocks = <&mm_pd_clk MT6991_PD_ISP_MAIN_SMI>,
		<&img_vcore_d1a_clk CLK_IMG_VCORE_MAIN_CAMERA_P2>,
		<&imgsys_main_clk CLK_IMG_SUB_COMMON3_SMI>,
		<&imgsys_main_clk CLK_IMG_GALS_CAMERA_P2>;
	clock-names = "smi_pd", "apb", "smi", "gals0";
	mediatek,pd-id = <MT6991_SMI_PD_ISP_MAIN>;
};

&smi_img_sub_comm2 {
	power-domains;
	no-pm-runtime;
	clocks = <&mm_pd_clk MT6991_PD_ISP_MAIN_SMI>,
		<&img_vcore_d1a_clk CLK_IMG_VCORE_MAIN_CAMERA_P2>,
		<&imgsys_main_clk CLK_IMG_SUB_COMMON2_SMI>,
		<&imgsys_main_clk CLK_IMG_GALS_CAMERA_P2>;
	clock-names = "smi_pd", "apb", "smi", "gals0";
	mediatek,pd-id = <MT6991_SMI_PD_ISP_MAIN>;
};

&smi_img_sub_comm1 {
	power-domains;
	no-pm-runtime;
	clocks = <&mm_pd_clk MT6991_PD_ISP_MAIN_SMI>,
		<&img_vcore_d1a_clk CLK_IMG_VCORE_MAIN_CAMERA_P2>,
		<&imgsys_main_clk CLK_IMG_SUB_COMMON1_SMI>,
		<&imgsys_main_clk CLK_IMG_GALS_CAMERA_P2>;
	clock-names = "smi_pd", "apb", "smi", "gals0";
	mediatek,pd-id = <MT6991_SMI_PD_ISP_MAIN>;
};

&smi_img_sub_comm4 {
	power-domains;
	no-pm-runtime;
	clocks = <&mm_pd_clk MT6991_PD_ISP_MAIN_SMI>,
		<&img_vcore_d1a_clk CLK_IMG_VCORE_MAIN_CAMERA_P2>,
		<&imgsys_main_clk CLK_IMG_SUB_COMMON4_SMI>,
		<&imgsys_main_clk CLK_IMG_GALS_CAMERA_P2>;
	clock-names = "smi_pd", "apb", "smi", "gals0";
	mediatek,pd-id = <MT6991_SMI_PD_ISP_MAIN>;
};

&smi_larb9 {
	power-domains;
	no-pm-runtime;
	clocks = <&mm_pd_clk MT6991_PD_ISP_MAIN_SMI>,
		<&imgsys_main_clk CLK_IMG_TRAW1_CAMERA_P2>,
		<&imgsys_main_clk CLK_IMG_LARB9_SMI>;
	clock-names = "smi_pd", "apb", "smi";
	mediatek,pd-id = <MT6991_SMI_PD_ISP_MAIN>;
};

&smi_larb10 {
	power-domains;
	no-pm-runtime;
	clocks = <&mm_pd_clk MT6991_PD_ISP_DIP_SMI>,
		<&imgsys_main_clk CLK_IMG_DIP0_CAMERA_P2>,
		<&dip_top_dip1_clk CLK_DIP_TOP_DIP1_DIP_TOP_CAMERA_P2>,
		<&dip_top_dip1_clk CLK_DIP_TOP_DIP1_DIP_TOP_GALS0_CAMERA_P2>,
		<&dip_top_dip1_clk CLK_DIP_TOP_DIP1_LARB10_SMI>;
	clock-names = "smi_pd", "apb", "smi", "gals0", "gals1";
	mediatek,pd-id = <MT6991_SMI_PD_ISP_DIP>;
};

&smi_larb11 {
	power-domains;
	no-pm-runtime;
	clocks = <&mm_pd_clk MT6991_PD_ISP_WPE_EIS_SMI>,
		<&imgsys_main_clk CLK_IMG_WPE0_CAMERA_P2>,
		<&wpe1_dip1_clk CLK_WPE1_DIP1_WPE_CAMERA_P2>,
		<&wpe1_dip1_clk CLK_WPE1_DIP1_GALS0_CAMERA_P2>,
		<&wpe1_dip1_clk CLK_WPE1_DIP1_LARB11_SMI>;
	clock-names = "smi_pd", "apb", "smi", "gals0", "gals1";
	mediatek,pd-id = <MT6991_SMI_PD_ISP_WPE_EIS>;
};

&smi_larb22 {
	power-domains;
	no-pm-runtime;
	clocks = <&mm_pd_clk MT6991_PD_ISP_WPE_TNR_SMI>,
		<&imgsys_main_clk CLK_IMG_WPE1_CAMERA_P2>,
		<&wpe2_dip1_clk CLK_WPE2_DIP1_WPE_CAMERA_P2>,
		<&wpe2_dip1_clk CLK_WPE2_DIP1_GALS0_CAMERA_P2>,
		<&wpe2_dip1_clk CLK_WPE2_DIP1_LARB11_SMI>;
	clock-names = "smi_pd", "apb", "smi", "gals0", "gals1";
	mediatek,pd-id = <MT6991_SMI_PD_ISP_WPE_TNR>;
};

&smi_larb23 {
	power-domains;
	no-pm-runtime;
	clocks = <&mm_pd_clk MT6991_PD_ISP_WPE_LITE_SMI>,
		<&imgsys_main_clk CLK_IMG_WPE2_CAMERA_P2>,
		<&wpe3_dip1_clk CLK_WPE3_DIP1_WPE_CAMERA_P2>,
		<&wpe3_dip1_clk CLK_WPE3_DIP1_GALS0_CAMERA_P2>,
		<&wpe3_dip1_clk CLK_WPE3_DIP1_LARB11_SMI>;
	clock-names = "smi_pd", "apb", "smi", "gals0", "gals1";
	mediatek,pd-id = <MT6991_SMI_PD_ISP_WPE_LITE>;
};

&smi_larb12 {
	power-domains;
	no-pm-runtime;
	clocks = <&mm_pd_clk MT6991_PD_ISP_MAIN_SMI>,
		<&imgsys_main_clk CLK_IMG_IPE_CAMERA_P2>,
		<&imgsys_main_clk CLK_IMG_FDVT_CAMERA_P2>,
		<&imgsys_main_clk CLK_IMG_LARB12_SMI>;
	clock-names = "smi_pd", "apb", "smi", "gals0";
	mediatek,pd-id = <MT6991_SMI_PD_ISP_MAIN>;
};

&smi_larb15 {
	power-domains;
	no-pm-runtime;
	clocks = <&mm_pd_clk MT6991_PD_ISP_DIP_SMI>,
		<&imgsys_main_clk CLK_IMG_DIP0_CAMERA_P2>,
		<&dip_top_dip1_clk CLK_DIP_TOP_DIP1_DIP_TOP_CAMERA_P2>,
		<&dip_top_dip1_clk CLK_DIP_TOP_DIP1_DIP_TOP_GALS1_CAMERA_P2>,
		<&dip_top_dip1_clk CLK_DIP_TOP_DIP1_LARB15_SMI>,
		<&dip_nr2_dip1_clk CLK_DIP_NR2_DIP1_DIP_NR_CAMERA_P2>,
		<&dip_nr2_dip1_clk CLK_DIP_NR2_DIP1_LARB15_CAMERA_P2>;
	clock-names = "smi_pd", "apb", "smi", "gals0", "gals1", "gals2", "gals3";
	mediatek,pd-id = <MT6991_SMI_PD_ISP_DIP>;
};

&smi_larb18 {
	power-domains;
	no-pm-runtime;
	clocks = <&mm_pd_clk MT6991_PD_ISP_MAIN_SMI>,
		<&imgsys_main_clk CLK_IMG_TRAW1_CAMERA_P2>,
		<&imgsys_main_clk CLK_IMG_ADL_LARB_SMI>;
	clock-names = "smi_pd", "apb", "smi";
	mediatek,pd-id = <MT6991_SMI_PD_ISP_MAIN>;
};

&smi_larb28 {
	power-domains;
	no-pm-runtime;
	clocks = <&mm_pd_clk MT6991_PD_ISP_TRAW_SMI>,
		<&imgsys_main_clk CLK_IMG_TRAW0_CAMERA_P2>,
		<&traw_dip1_clk CLK_TRAW_DIP1_TRAW_CAMERA_P2>,
		<&traw_dip1_clk CLK_TRAW_DIP1_GALS_CAMERA_P2>,
		<&traw_dip1_clk CLK_TRAW_DIP1_LARB28_SMI>;
	clock-names = "smi_pd", "apb", "smi", "gals0", "gals1";
	mediatek,pd-id = <MT6991_SMI_PD_ISP_TRAW>;
};

&smi_larb38 {
	power-domains;
	no-pm-runtime;
	clocks = <&mm_pd_clk MT6991_PD_ISP_DIP_SMI>,
		<&imgsys_main_clk CLK_IMG_DIP0_CAMERA_P2>,
		<&dip_top_dip1_clk CLK_DIP_TOP_DIP1_DIP_TOP_CAMERA_P2>,
		<&dip_top_dip1_clk CLK_DIP_TOP_DIP1_DIP_TOP_GALS2_CAMERA_P2>,
		<&dip_top_dip1_clk CLK_DIP_TOP_DIP1_LARB38_SMI>;
	clock-names = "smi_pd", "apb", "smi", "gals0", "gals1";
	mediatek,pd-id = <MT6991_SMI_PD_ISP_DIP>;
};

&smi_larb39 {
	power-domains;
	no-pm-runtime;
	clocks = <&mm_pd_clk MT6991_PD_ISP_DIP_SMI>,
		<&imgsys_main_clk CLK_IMG_DIP0_CAMERA_P2>,
		<&dip_top_dip1_clk CLK_DIP_TOP_DIP1_DIP_TOP_CAMERA_P2>,
		<&dip_top_dip1_clk CLK_DIP_TOP_DIP1_DIP_TOP_GALS3_CAMERA_P2>,
		<&dip_top_dip1_clk CLK_DIP_TOP_DIP1_LARB39_SMI>,
		<&dip_nr2_dip1_clk CLK_DIP_NR2_DIP1_DIP_NR_CAMERA_P2>,
		<&dip_nr2_dip1_clk CLK_DIP_NR2_DIP1_LARB39_CAMERA_P2>;
	clock-names = "smi_pd", "apb", "smi", "gals0", "gals1", "gals2", "gals3";
	mediatek,pd-id = <MT6991_SMI_PD_ISP_DIP>;
};

&smi_larb40 {
	power-domains;
	no-pm-runtime;
	clocks = <&mm_pd_clk MT6991_PD_ISP_TRAW_SMI>,
		<&imgsys_main_clk CLK_IMG_TRAW0_CAMERA_P2>,
		<&traw_dip1_clk CLK_TRAW_DIP1_TRAW_CAMERA_P2>,
		<&traw_dip1_clk CLK_TRAW_DIP1_GALS_CAMERA_P2>,
		<&traw_dip1_clk CLK_TRAW_DIP1_LARB28_SMI>,
		<&traw_dip1_clk CLK_TRAW_DIP1_LARB40_SMI>;
	clock-names = "smi_pd", "apb", "smi", "gals0", "gals1", "gals0";
	mediatek,pd-id = <MT6991_SMI_PD_ISP_TRAW>;
};

&smi_cam_vcore_sub_comm {
	power-domains;
	no-pm-runtime;
	clocks = <&mm_pd_clk MT6991_PD_CAM_VCORE_SMI>,
		<&cam_vcore_r1a_clk CLK_VCORE_CAMRAW>,
		<&cam_vcore_r1a_clk CLK_2MM0_SUBCOMMON_DCM_DIS_CAMRAW>,
		<&cam_vcore_r1a_clk CLK_CAM_V_MM0_SUBCOMM_CAMRAW>;
	clock-names = "smi_pd", "apb", "smi", "gals0";
	mediatek,pd-id = <MT6991_SMI_PD_CAM_VCORE>;
};

&smi_cam_sub_comm0 {
	power-domains;
	no-pm-runtime;
	clocks = <&mm_pd_clk MT6991_PD_CAM_MAIN_SMI>,
		<&cam_main_r1a_clk CLK_CAM_MAIN_CAM2MM0_GALS_CAMRAWA>,
		<&cam_main_r1a_clk CLK_CAM_MAIN_CAM_MRAW>,
		<&cam_main_r1a_clk CLK_CAM_MAIN_CAM_DPE>,
		<&cam_main_r1a_clk CLK_CAM_MAIN_LARB29_SMI>;
	clock-names = "smi_pd", "apb", "smi", "gals0", "gals1";
	mediatek,pd-id = <MT6991_SMI_PD_CAM_MAIN>;
};

&smi_cam_sub_comm2 {
	power-domains;
	no-pm-runtime;
	clocks = <&mm_pd_clk MT6991_PD_CAM_MAIN_SMI>,
		<&cam_main_r1a_clk CLK_CAM_MAIN_CAM2MM1_GALS_CAMRAWA>,
		<&cam_main_r1a_clk CLK_CAM_MAIN_CAM_MRAW>,
		<&cam_main_r1a_clk CLK_CAM_MAIN_LARB13_SMI>;
	clock-names = "smi_pd", "apb", "smi", "gals0";
	mediatek,pd-id = <MT6991_SMI_PD_CAM_MAIN>;
};

&smi_ccu_sub_comm1 {
	power-domains;
	no-pm-runtime;
	skip-tcms-check;
	mediatek,pd-id = <MT6991_SMI_PD_CAM_CCU>;
};

&smi_ccu_sub_comm0 {
	power-domains;
	no-pm-runtime;
	skip-tcms-check;
	mediatek,pd-id = <MT6991_SMI_PD_CAM_CCU>;
};

&smi_larb13 {
	power-domains;
	no-pm-runtime;
	clocks = <&mm_pd_clk MT6991_PD_CAM_MAIN_SMI>,
		<&cam_main_r1a_clk CLK_CAM_MAIN_LARB13_SMI>;
	clock-names = "smi_pd", "apb";
	mediatek,pd-id = <MT6991_SMI_PD_CAM_MAIN>;
};

&smi_larb14 {
	power-domains;
	no-pm-runtime;
	clocks = <&mm_pd_clk MT6991_PD_CAM_MAIN_SMI>,
		<&cam_main_r1a_clk CLK_CAM_MAIN_LARB14_SMI>;
	clock-names = "smi_pd", "apb";
	mediatek,pd-id = <MT6991_SMI_PD_CAM_MAIN>;
};

&smi_larb16 {
	power-domains;
	no-pm-runtime;
	clocks = <&mm_pd_clk MT6991_PD_CAM_RAWA_SMI>,
		<&cam_main_r1a_clk CLK_CAM_MAIN_CAM_SUBA>,
		<&camsys_rawa_clk CLK_CAM_RA_LARBX_SMI>,
		<&camsys_rawa_clk CLK_CAM_RA_CAM_CAMRAWA>;
	clock-names = "smi_pd", "apb", "smi", "gals0";
	mediatek,pd-id = <MT6991_SMI_PD_CAM_RAWA>;
};

&smi_larb43 {
	power-domains;
	no-pm-runtime;
	clocks = <&mm_pd_clk MT6991_PD_CAM_RAWB_SMI>,
		<&cam_main_r1a_clk CLK_CAM_MAIN_CAM_SUBB>,
		<&camsys_rawb_clk CLK_CAM_RB_LARBX_SMI>,
		<&camsys_rawb_clk CLK_CAM_RB_CAM_CAMRAWB>;
	clock-names = "smi_pd", "apb", "smi", "gals0";
	mediatek,pd-id = <MT6991_SMI_PD_CAM_RAWB>;
};

&smi_larb44 {
	power-domains;
	no-pm-runtime;
	clocks = <&mm_pd_clk MT6991_PD_CAM_RAWC_SMI>,
		<&cam_main_r1a_clk CLK_CAM_MAIN_CAM_SUBC>,
		<&camsys_rawc_clk CLK_CAM_RC_LARBX_SMI>,
		<&camsys_rawc_clk CLK_CAM_RC_CAM_CAMRAWC>;
	clock-names = "smi_pd", "apb", "smi", "gals0";
	mediatek,pd-id = <MT6991_SMI_PD_CAM_RAWC>;
};

&smi_larb17 {
	power-domains;
	no-pm-runtime;
	clocks = <&mm_pd_clk MT6991_PD_CAM_RAWA_SMI>,
		<&cam_main_r1a_clk CLK_CAM_MAIN_CAM_SUBA>,
		<&camsys_yuva_clk CLK_CAM_YA_LARBX_SMI>,
		<&camsys_rawa_clk CLK_CAM_RA_CAM_CAMRAWA>;
	clock-names = "smi_pd", "apb", "smi", "gals0";
	mediatek,pd-id = <MT6991_SMI_PD_CAM_RAWA>;
};

&smi_larb45 {
	power-domains;
	no-pm-runtime;
	clocks = <&mm_pd_clk MT6991_PD_CAM_RAWB_SMI>,
		<&cam_main_r1a_clk CLK_CAM_MAIN_CAM_SUBB>,
		<&camsys_yuvb_clk CLK_CAM_YB_LARBX_SMI>,
		<&camsys_rawb_clk CLK_CAM_RB_CAM_CAMRAWB>;
	clock-names = "smi_pd", "apb", "smi", "gals0";
	mediatek,pd-id = <MT6991_SMI_PD_CAM_RAWB>;
};

&smi_larb46 {
	power-domains;
	no-pm-runtime;
	clocks = <&mm_pd_clk MT6991_PD_CAM_RAWC_SMI>,
		<&cam_main_r1a_clk CLK_CAM_MAIN_CAM_SUBC>,
		<&camsys_yuvc_clk CLK_CAM_YC_LARBX_SMI>,
		<&camsys_rawc_clk CLK_CAM_RC_CAM_CAMRAWC>;
	clock-names = "smi_pd", "apb", "smi", "gals0";
	mediatek,pd-id = <MT6991_SMI_PD_CAM_RAWC>;
};

&smi_larb19 {
	power-domains;
	no-pm-runtime;
	clocks = <&mm_pd_clk MT6991_PD_CAM_MRAW_SMI>,
		<&camsys_ipe_clk CLK_CAMSYS_IPE_LARB19_SMI>;
	clock-names = "smi_pd", "apb";
	mediatek,pd-id = <MT6991_SMI_PD_CAM_MRAW>;
};

&smi_larb25 {
	power-domains;
	no-pm-runtime;
	clocks = <&mm_pd_clk MT6991_PD_CAM_MRAW_SMI>,
		<&camsys_mraw_clk CLK_CAM_MR_LARBX_SMI>;
	clock-names = "smi_pd", "apb";
	mediatek,pd-id = <MT6991_SMI_PD_CAM_MRAW>;
};

&smi_larb26 {
	power-domains;
	no-pm-runtime;
	clocks = <&mm_pd_clk MT6991_PD_CAM_MRAW_SMI>,
		<&camsys_mraw_clk CLK_CAM_MR_LARBX_SMI>;
	clock-names = "smi_pd", "apb";
	mediatek,pd-id = <MT6991_SMI_PD_CAM_MRAW>;
};

&smi_larb27 {
	power-domains;
	no-pm-runtime;
	clocks = <&mm_pd_clk MT6991_PD_CAM_MAIN_SMI>,
		<&cam_main_r1a_clk CLK_CAM_MAIN_LARB27_SMI>;
	clock-names = "smi_pd", "apb";
	mediatek,pd-id = <MT6991_SMI_PD_CAM_MAIN>;
};

&smi_larb29 {
	power-domains;
	no-pm-runtime;
	clocks = <&mm_pd_clk MT6991_PD_CAM_MAIN_SMI>,
		<&cam_main_r1a_clk CLK_CAM_MAIN_LARB29_SMI>;
	clock-names = "smi_pd", "apb";
	mediatek,pd-id = <MT6991_SMI_PD_CAM_MAIN>;
};

&smi_larb30 {
	power-domains;
	no-pm-runtime;
	skip-tcms-check;
	mediatek,pd-id = <MT6991_SMI_PD_CAM_CCU>;
};

&smi_pd_cam_mraw {
	power-domains;
	no-pm-runtime;
	compatible = "mediatek,smi-skip-probe";
};

&smi_hwccf {
	compatible = "mediatek,smi-hwccf";
};

&mminfra_util {
	compatible = "mediatek,mminfra-util";
	mminfra-mtcmos-num = <MMINFRA_MT6991_PWR_NR>; /* mm0/mm1/mm_ao */
	mminfra-type-num = <MMINFRA_MT6991_TYPE_NR>;
	mminfra-type0-pwr = <MMINFRA_MT6991_PWR_MM1>; /* cg_link to mm1*/
	mminfra-mtcmos-voter = <56 56 56>;
	mminfra-mtcmos-data = <26 27 25>;
	mminfra-vlp-base = <0x1c000000>;
	mminfra-vlp-ao-rsvd6-ofs = <0x918>;
	mminfra-mm1-irq-rdy-bit = <1>;
	mediatek,vcp-supply = <&vcp>;
	mm-mtcmos-base = <0x31b50084 0x31b50088 0x31b5008c>; /* mm0/mm1/mm_ao */
	mm-mtcmos-mask = <0xc0000000 0xc0000000 0xc0000000>; /* mm0/mm1/mm_ao */
};

&mminfra_debug {
	power-domains;
	mediatek,mminfra-supply = <&mminfra_util>;
	mminfra-api-pwr-ctrl;
	mminfra-api-pwr-idx = <MMINFRA_MT6991_PWR_MM1>;
};

&dispsys_config {
	pinctrl-names = "mode_te_te", "mode_te_te1";
	pinctrl-0 = <&mtkfb_pins_lcm_dsi_te>;
	pinctrl-1 = <&mtkfb_pins_lcm_dsi1_te>;
	status = "okay";
	pwr-handle = <&disp_pwr_dev>;
//	enable-discrete-path = <1>;
};

&mipi_tx_config1 {
//	status = "okay";
};

&dsi1 {
//	status = "okay";
	#address-cells = <1>;
	#size-cells = <0>;
	init-panel-off;
	panel1@0 {
		compatible = "truly,td4330,cmd";
		reg = <0>;
		pm-enable-gpios = <&pio 215 0>;
		reset-gpios = <&pio 5 0>;
		swap-from-dts;
		lane-swap-setting = <1 2 0 3 4 2>;
		pn-swap-setting = <1 1 1 1 1 1>;
		gate-ic = <4831>;
		pinctrl-names = "default";
		port {
			panel1_in: endpoint {
				remote-endpoint = <&dsi1_out>;
			};
		};
	};
	panel2@1 {
		compatible = "jdi,nt36672e,vdo,120hz";
		reg = <1>;
		pm-enable-gpios = <&pio 215 0>;
		reset-gpios = <&pio 5 0>;
		gate-ic = <4831>;
		pinctrl-names = "default";
		port {
			panel2_in: endpoint {
				remote-endpoint = <&dsi1_out2>;
			};
		};
	};
	panel3@2 {
		compatible = "jdi,nt36672e,cphy,vdo";
		reg = <2>;
		pm-enable-gpios = <&pio 215 0>;
		reset-gpios = <&pio 5 0>;
		gate-ic = <4831>;
		pinctrl-names = "default";
		port {
			panel3_in: endpoint {
				remote-endpoint = <&dsi1_out3>;
			};
		};
	};
	panel4@3 {
		compatible = "jdi,nt36672e,vdo,60hz";
		reg = <3>;
		pm-enable-gpios = <&pio 215 0>;
		reset-gpios = <&pio 5 0>;
		gate-ic = <4831>;
		pinctrl-names = "default";
		port {
			panel4_in: endpoint {
				remote-endpoint = <&dsi1_out4>;
			};
		};
	};
	ports {
		port {
			dsi1_out: endpoint@0 {
				remote-endpoint = <&panel1_in>;
			};

			dsi1_out2: endpoint@1 {
				remote-endpoint = <&panel2_in>;
			};

			dsi1_out3: endpoint@2 {
				remote-endpoint = <&panel3_in>;
			};

			dsi1_out4: endpoint@3 {
				remote-endpoint = <&panel4_in>;
			};
		};
	};
};

&dsi1_te {
	interrupt-parent = <&pio>;
	interrupts = <6 1 6 1>;
	status = "okay";
};

&dsi0 {
	status = "okay";
	#address-cells = <1>;
	#size-cells = <0>;
	panel1@0 {
		compatible = "jdi,nt36672e,vdo,120hz,frameratev5";
		reg = <0>;
		pm-enable-gpios = <&pio 174 0>;
		reset-gpios = <&pio 90 0>;
		res-switch = <2>;
		gate-ic = <4831>;
		pinctrl-names = "default";
		port {
			panel_in1: endpoint {
			remote-endpoint = <&dsi_out1>;
			};
		};
	};
	panel2@1 {
		compatible = "truly,td4330,cmd";
		reg = <1>;
		pm-enable-gpios = <&pio 174 0>;
		reset-gpios = <&pio 90 0>;
		gate-ic = <4831>;
		pinctrl-names = "default";
		port {
			panel_in2: endpoint {
			remote-endpoint = <&dsi_out2>;
			};
		};
	};
	panel3@2 {
		compatible = "nt37801,cmd,fhd";
		reg = <2>;
		pm-enable-gpios = <&pio 174 0>;
		reset-gpios = <&pio 90 0>;
		res-switch = <2>;
		gate-ic = <4831>;
		pinctrl-names = "default";
		port {
			panel_in3: endpoint {
			remote-endpoint = <&dsi_out3>;
			};
		};
	};
	panel4@3 {
		compatible = "nt37801,cmd,fhd,plus";
		reg = <3>;
		pm-enable-gpios = <&pio 174 0>;
		reset-gpios = <&pio 90 0>;
		res-switch = <2>;
		gate-ic = <4831>;
		pinctrl-names = "default";
		port {
			panel_in4: endpoint {
			remote-endpoint = <&dsi_out4>;
			};
		};
	};
	panel5@4 {
		compatible = "jdi,nt36672e,cphy,vdo";
		reg = <4>;
		pm-enable-gpios = <&pio 174 0>;
		reset-gpios = <&pio 90 0>;
		res-switch = <2>;
		gate-ic = <4831>;
		pinctrl-names = "default";
		port {
			panel_in5: endpoint {
			remote-endpoint = <&dsi_out5>;
			};
		};
	};

	ports {
		port {
			dsi_out1: endpoint@0 {
				remote-endpoint = <&panel_in1>;
			};

			dsi_out2: endpoint@1 {
				remote-endpoint = <&panel_in2>;
			};

			dsi_out3: endpoint@2 {
				remote-endpoint = <&panel_in3>;
			};

			dsi_out4: endpoint@3 {
				remote-endpoint = <&panel_in4>;
			};

			dsi_out5: endpoint@4 {
				remote-endpoint = <&panel_in5>;
			};
		};
	};
};

&jpgenc0 {
	ccf-one-step;
};

&jpgenc1 {
	ccf-one-step;
};

&jpgdec0 {
	ccf-one-step;
};

&vdisp_ao {
	power-domains;
};

&disp1_mutex0 {
	power-domains;
};

&dispsys_config {
	power-domains;
};

&disp_ovl0_exdma3 {
	power-domains;
};

&disp_ovl1_exdma3 {
	power-domains;
};

&edp_tx {
	power-domains;
};

&dp_tx {
	power-domains= <&scpsys MT6991_POWER_DOMAIN_SSUSB_DP_PHY_P0>;
	power-domain-names= "phy";
};

&mipi_tx_config0 {
	power-domains;
};

&disp_vcore_ctrl {
	power-domains;
	pwr-handle = <&disp_pwr_dev>;
};

&vdisp_ctrl_1 {
	power-domains;
};

&vdisp_ctrl_2 {
	power-domains;
};

&vdisp_ctrl_3 {
	power-domains;
};

&vdisp_ctrl_4 {
	power-domains;
};

&vdisp_ctrl_5 {
	power-domains;
};

&vdisp_ctrl_6 {
	power-domains;
};

&vdisp_ctrl_7 {
	power-domains;
};

&vdisp_ctrl_8 {
	power-domains;
};

&pio {
	rptr_enable: rptr-enable {
		pins-cmd-dat {
			pinmux = <PINMUX_GPIO72__FUNC_GPIO72>;
			output-high;
		};
	};

	rptr_disable: rptr-disable {
		pins-cmd-dat {
			pinmux = <PINMUX_GPIO72__FUNC_GPIO72>;
			output-low;
		};
	};
};

&ssusb {
	mediatek,force-vbus;
	mediatek,clk-mgr;
	mediatek,usb3-drd;
	mediatek,uds = <&usb_dp_selector 19>;
	mediatek,eusb2-cm-l1 = <0x474>;
	usb-role-switch;
	status = "okay";
};

&usb_host {
	mediatek,usb-offload = <&usb_offload>;
	status = "okay";
};

&mt6379_eusb2_repeater {
	status = "okay";
};

&nxp_eusb2_repeater {
	pinctrl-names = "enable", "disable";
	pinctrl-0 = <&rptr_enable>;
	pinctrl-1 = <&rptr_disable>;
	status = "okay";
};

&pcie0 {
	pinctrl-names = "init", "default", "sleep", "pd";
	pinctrl-0 = <&pcie0_pins_init>;
	pinctrl-1 = <&pcie0_pins_default>;
	pinctrl-2 = <&pcie0_pins_sleep>;
	pinctrl-3 = <&pcie0_pins_pd>;
	max-link-speed = <4>;
	status = "okay";
};

&pcie1 {
	pinctrl-names = "default";
	pinctrl-0 = <&pcie1_pins_default>;
	max-link-speed = <4>;
	status = "disabled";
};

&pciephy0 {
	mediatek,short-reach;
	status = "okay";
};

&pciephy1 {
	status = "disabled";
};

/* PCIe pinmux start */
/* skyhawk use waken to control DFD_EN, PCIe0 don't need to control it */
&pio {
	pcie0_pins_init: pcie0-init {
		pins-cmd-dat {
			pinmux = <PINMUX_GPIO241__FUNC_GPIO241>;
			output-low;
		};

		pins-cmd-dat1 {
			pinmux = <PINMUX_GPIO243__FUNC_GPIO243>;
			bias-pull-up;
			input-enable;
		};
	};

	pcie0_pins_default: pcie0-default {
		pins-cmd-dat {
			pinmux = <PINMUX_GPIO241__FUNC_PCIE_PERSTN>,
				 <PINMUX_GPIO243__FUNC_PCIE_CLKREQN>;
			bias-pull-up;
		};
	};

	pcie0_pins_sleep: pcie0-sleep {
		pins-cmd-dat {
			pinmux = <PINMUX_GPIO241__FUNC_GPIO241>;
			output-low;
		};

		pins-cmd-dat1 {
			pinmux = <PINMUX_GPIO243__FUNC_GPIO243>;
			bias-pull-up;
			input-enable;
		};
	};

	pcie0_pins_pd: pcie0-pd {
		pins-cmd-dat {
			pinmux = <PINMUX_GPIO241__FUNC_GPIO241>;
			output-low;
		};

		pins-cmd-dat1 {
			pinmux = <PINMUX_GPIO243__FUNC_GPIO243>;
			bias-pull-down;
			input-enable;
		};
	};

	pcie1_pins_default: pcie1-default {
		pins-cmd-dat {
			pinmux = <PINMUX_GPIO145__FUNC_PCIE_WAKEN_1P>,
				 <PINMUX_GPIO146__FUNC_PCIE_PERSTN_1P>,
				 <PINMUX_GPIO147__FUNC_PCIE_CLKREQN_1P>;
			bias-pull-up = <MTK_PUPD_SET_R1R0_01>;
		};
	};
};
/* PCIe pinmux end */

#if 0
/* no need set here, 6686 will control elna automatically */
/* GPS GPIO standardization start */
&pio {
	gps_pins_default: gps_default {
	};
	gps_l1_lna_pins_ol: gps-l1-lna0 {
		pins-cmd-dat {
			pinmux = <PINMUX_GPIO12__FUNC_GPIO12>;
			output-low;
		};
	};
	gps_l1_lna_pins_dsp_ctrl: gps-l1-lna1 {
		pins-cmd-dat {
			pinmux = <PINMUX_GPIO12__FUNC_GPS_L1_ELNA_EN>;
		};
	};
	gps_l1_lna_pins_oh: gps-l1-lna2 {
		pins-cmd-dat {
			pinmux = <PINMUX_GPIO12__FUNC_GPIO12>;
			output-high;
		};
	};
	gps_l5_lna_pins_ol: gps-l5-lna0 {
		pins-cmd-dat {
			pinmux = <PINMUX_GPIO13__FUNC_GPIO13>;
			output-low;
		};
	};
	gps_l5_lna_pins_dsp_ctrl: gps-l5-lna1 {
		pins-cmd-dat {
			pinmux = <PINMUX_GPIO13__FUNC_GPS_L5_ELNA_EN>;
		};
	};
	gps_l5_lna_pins_oh: gps-l5-lna2 {
		pins-cmd-dat {
			pinmux = <PINMUX_GPIO13__FUNC_GPIO13>;
			output-high;
		};
	};
};
&gps {
	pinctrl-names = "default",
		"gps_l1_lna_disable",
		"gps_l1_lna_dsp_ctrl",
		"gps_l1_lna_enable",
		"gps_l5_lna_disable",
		"gps_l5_lna_dsp_ctrl",
		"gps_l5_lna_enable";
	pinctrl-0 = <&gps_pins_default>;
	pinctrl-1 = <&gps_l1_lna_pins_ol>;
	pinctrl-2 = <&gps_l1_lna_pins_dsp_ctrl>;
	pinctrl-3 = <&gps_l1_lna_pins_oh>;
	pinctrl-4 = <&gps_l5_lna_pins_ol>;
	pinctrl-5 = <&gps_l5_lna_pins_dsp_ctrl>;
	pinctrl-6 = <&gps_l5_lna_pins_oh>;
	status = "okay";
};
/* GPS GPIO standardization end */
#endif

/* usb typec mux start */
&pio {

	ps_enable: ps_enable {
		pins-cmd-dat {
			pinmux = <PINMUX_GPIO207__FUNC_GPIO207>;
			output-high;
		};
	};

	ps_disable: ps_disable {
		pins-cmd-dat {
			pinmux = <PINMUX_GPIO207__FUNC_GPIO207>;
			output-low;
		};
	};

};

&mt6379_typec {
	port {
		tcpc_typec_usb: endpoint {
			remote-endpoint = <&ssusb_mux>;
		};
	};
};

&typec_mux_switch {
	orientation-switch;
	mode-switch;
	accessory;
	port {
		ssusb_mux: endpoint {
			remote-endpoint = <&tcpc_typec_usb>;
		};
	};
};

&ps5170 {
	pinctrl-names = "enable", "disable";
	pinctrl-0 = <&ps_enable>;
	pinctrl-1 = <&ps_disable>;
	status = "okay";
};

&usb_dp_selector {
	status = "okay";
};
/* usb typec mux end */

&qos {
	reg = <0 0x0011bb00 0 0x100>,
		<0 0x0011b8dc 0 0x224>,
		<0 0x0011b920 0 0x0>,
		<0 0x0011b864 0 0x2c>;
	reg-names = "sram", "share_sram", "share_sram_ext", "share_sram_dbg";
};

&i2c6 {
	spk1: speaker_amp@5c {
		compatible = "richtek,rt5512";
		#sound-dai-cells = <0>;
		reg = <0x5c>;
		status = "okay";
		sound-name-prefix = "Left";
	};

	spk2: speaker_amp@5d {
		compatible = "richtek,rt5512";
		#sound-dai-cells = <0>;
		reg = <0x5d>;
		status = "okay";
		sound-name-prefix = "Right";
	};
};

&sound {
	mediatek,spk-i2s = <25 24>;
	mediatek,speaker-codec {
		sound-dai = <&spk1>, <&spk2>;
	};
};

#if 0
&pdc {
	pd_vbus_upper_bound = <12000000>;
};
#endif

&mmlsys0_config {
	mediatek,mminfra-supply = <&mminfra_util>;
	mminfra-pwr-idx = <MMINFRA_MT6991_PWR_MM1>;
	mminfra-pwr-type = <MMINFRA_MT6991_TYPE_MML>;
	power-domains;
};

&mmlsys1_config {
	mediatek,mminfra-supply = <&mminfra_util>;
	mminfra-pwr-idx = <MMINFRA_MT6991_PWR_MM1>;
	mminfra-pwr-type = <MMINFRA_MT6991_TYPE_MML>;
	power-domains;
};


&gce {
	mediatek,mminfra-supply = <&mminfra_util>;
	mminfra-all-on-pwr-idx = <MMINFRA_MT6991_PWR_MM1>;
};

&gce_sec {
	mminfra-all-on-pwr-idx = <MMINFRA_MT6991_PWR_MM1>;
};

&gce_m {
	mediatek,mminfra-supply = <&mminfra_util>;
	mminfra-all-on-pwr-idx = <MMINFRA_MT6991_PWR_MM1>;
};

&gce_m_sec {
	mminfra-all-on-pwr-idx = <MMINFRA_MT6991_PWR_MM1>;
};

&connfem {
	sku {
		hw-names =
			"qm42655_qm45655_2g2a";	/* [0] QM42655/QM45655, 2G+2A */

		/***************************************************************
		 * [HW][0] QM42655/QM45655, 2G+2A
		 **************************************************************/
		hw-0 {
			using-fems =
				<&qm42655>,
				<&qm45655>;

			layout-flag = <0x00000000>;
			layout =
				<&g_wf0_bt0_qm42655>,
				<&g_wf1_bt1_qm42655>,
				<&a_wf0_qm45655>,
				<&a_wf1_qm45655>;

			common {
				flags {
					fe-ant-cnt = [85];
					fe-conn-dpdt-sp3t = [80];
					fe-conn-spdt = [80];
					fe-bt-wf-usage = [80];
					fe-conn-spdt-2 = [80];
				};
			};

			wifi {
				using-states =
					<&qm42655_rxl>,
					<&qm45655_rxl>;
			};

			bt {
				flags {
					efem-mode = [03]; /* 3:epa_elna, 2:epa, 1:elna, 0:bypass */
					rx-mode = [24]; /* 0x24: G-band RxL */
				};
			};
		};
	};
};

&wifi {
	flavor-bin = "dx5_2g2a";
};

&bt {
	flavor-bin = "dx5_2g2a";
};

&mddriver {
	mediatek,mdsrc-settle-time = <20>;
};

&gpu_dvfs_mode {
	dvfs-loading-mode = <6>;
};

&gpu_dvfs_mips {
	reduce-mips-support = <2>;
	soc-timer-unit = <13>;
};

&gpu_dcs {
	virtual-opp-support = <0x8a8>;
};

#include <k6991v1_64_for_dx5/cust.dtsi>
#include "mediatek/cust_k6991_for_dx5_connfem.dtsi"

#include "mediatek/cust_mt6991_touch_1080x2400_mult.dtsi"
#include "mediatek/cust_mt6991_camera_v4l2.dtsi"
/*End of this file, DO NOT ADD ANYTHING HERE*/

