/*
 * Copyright (C) 2024 Novatek, Inc.
 *
 * $Revision$
 * $Date$
 *
 * This program is free software; you can redistribute it and/or modify
 * it under the terms of the GNU General Public License as published by
 * the Free Software Foundation; either version 2 of the License, or
 * (at your option) any later version.
 *
 * This program is distributed in the hope that it will be useful, but WITHOUT
 * ANY WARRANTY; without even the implied warranty of MERCHANTABILITY or
 * FITNESS FOR A PARTICULAR PURPOSE.  See the GNU General Public License for
 * more details.
 *
 */


&spi2 {
	status = "ok";

	/* Novatek device tree node */
	touch@0 {
		compatible = "novatek,NVT-ts-spi", "chipone-tddi";
		reg = <0>; //Same as CS ID
		status = "ok";

		spi-max-frequency = <9600000>;	//4800000,9600000,15000000,19200000
		novatek,reset-gpio = <&pio 22 0x00>;
		novatek,irq-gpio = <&pio 2 0x2001>;

		chipone,rst-gpio = <&pio 22 0x00>;
		chipone,irq-gpio = <&pio 2 0x00>;
		chipone,x-res = <800>;
		chipone,y-res = <1340>;

		/* Charger detect */
		chipone,touch-charger-detect-enable;
		chipone,touch-charger-detect-type = "poll"; /* notify, poll */
		chipone,touch-charger-detect-psy-name = "usb";
		chipone,touch-charger-detect-psp = "POWER_SUPPLY_PROP_ONLINE";
		chipone,touch-charger-detect-psp-poll-interval = <1000>;

		/* For tp selftest */
		chipone,test-reset-pin;
		//chipone,test-int-pin;
		chipone,test-rawdata;
		chipone,test-rawdata-frames      = <1>;
		chipone,rawdata-min              = <1300>;
		chipone,rawdata-max              = <3800>;
		chipone,test-noise;
		chipone,test-noise-frames        = <16>;
		chipone,noise-max                = <190>;
		chipone,test-open;
		chipone,open-min                 = <1600>;
		chipone,test-short;
		chipone,short-min                = <700>;
		chipone,test-compensate-cap;
		chipone,compensate-cap-min       = <1>;
		chipone,compensate-cap-max       = <127>;
		//novatek,pen-support;
		//novatek,spi-rd-fast-addr = <0x03F310>;

		/* MP */
		novatek,mp-support-dt;

		/* for Xiaomi N85 NT36523D BOE8.68" panel module */
		novatek-mp-criteria-5989@0 {
			#address-cells = <1>;
			#size-cells = <0>;
			compatible = "novatek-mp-criteria-5989";

			/* MP Config */
			IC_X_CFG_SIZE = <22>;
			IC_Y_CFG_SIZE = <36>;
			IC_KEY_CFG_SIZE = <4>;
			X_Channel = <22>;
			Y_Channel = <36>;
			AIN_X = <0 1 2 3 4 5 6 7 8 9 10 11 12 13 14 15 16 17 18 19 20 21>;
			AIN_Y = <0 1 2 3 4 5 6 7 8 9 10 11 12 13 14 15 16 17 18 19 20 21 22 23 24 25 26 27 28 29 30 31 32 33 34 35>;
			AIN_KEY = <0 1 2 0xFF>;

			/* MP Criteria */
			PS_Config_Lmt_Short_Rawdata_P = <
				14008	14008	14008	14008	14008	14008	14008	14008	14008	14008	14008	14008	14008	14008	14008	14008	14008	14008	14008	14008	14008	14008
				14008	14008	14008	14008	14008	14008	14008	14008	14008	14008	14008	14008	14008	14008	14008	14008	14008	14008	14008	14008	14008	14008
				14008	14008	14008	14008	14008	14008	14008	14008	14008	14008	14008	14008	14008	14008	14008	14008	14008	14008	14008	14008	14008	14008
				14008	14008	14008	14008	14008	14008	14008	14008	14008	14008	14008	14008	14008	14008	14008	14008	14008	14008	14008	14008	14008	14008
				14008	14008	14008	14008	14008	14008	14008	14008	14008	14008	14008	14008	14008	14008	14008	14008	14008	14008	14008	14008	14008	14008
				14008	14008	14008	14008	14008	14008	14008	14008	14008	14008	14008	14008	14008	14008	14008	14008	14008	14008	14008	14008	14008	14008
				14008	14008	14008	14008	14008	14008	14008	14008	14008	14008	14008	14008	14008	14008	14008	14008	14008	14008	14008	14008	14008	14008
				14008	14008	14008	14008	14008	14008	14008	14008	14008	14008	14008	14008	14008	14008	14008	14008	14008	14008	14008	14008	14008	14008
				14008	14008	14008	14008	14008	14008	14008	14008	14008	14008	14008	14008	14008	14008	14008	14008	14008	14008	14008	14008	14008	14008
				14008	14008	14008	14008	14008	14008	14008	14008	14008	14008	14008	14008	14008	14008	14008	14008	14008	14008	14008	14008	14008	14008
				14008	14008	14008	14008	14008	14008	14008	14008	14008	14008	14008	14008	14008	14008	14008	14008	14008	14008	14008	14008	14008	14008
				14008	14008	14008	14008	14008	14008	14008	14008	14008	14008	14008	14008	14008	14008	14008	14008	14008	14008	14008	14008	14008	14008
				14008	14008	14008	14008	14008	14008	14008	14008	14008	14008	14008	14008	14008	14008	14008	14008	14008	14008	14008	14008	14008	14008
				14008	14008	14008	14008	14008	14008	14008	14008	14008	14008	14008	14008	14008	14008	14008	14008	14008	14008	14008	14008	14008	14008
				14008	14008	14008	14008	14008	14008	14008	14008	14008	14008	14008	14008	14008	14008	14008	14008	14008	14008	14008	14008	14008	14008
				14008	14008	14008	14008	14008	14008	14008	14008	14008	14008	14008	14008	14008	14008	14008	14008	14008	14008	14008	14008	14008	14008
				14008	14008	14008	14008	14008	14008	14008	14008	14008	14008	14008	14008	14008	14008	14008	14008	14008	14008	14008	14008	14008	14008
				14008	14008	14008	14008	14008	14008	14008	14008	14008	14008	14008	14008	14008	14008	14008	14008	14008	14008	14008	14008	14008	14008
				14008	14008	14008	14008	14008	14008	14008	14008	14008	14008	14008	14008	14008	14008	14008	14008	14008	14008	14008	14008	14008	14008
				14008	14008	14008	14008	14008	14008	14008	14008	14008	14008	14008	14008	14008	14008	14008	14008	14008	14008	14008	14008	14008	14008
				14008	14008	14008	14008	14008	14008	14008	14008	14008	14008	14008	14008	14008	14008	14008	14008	14008	14008	14008	14008	14008	14008
				14008	14008	14008	14008	14008	14008	14008	14008	14008	14008	14008	14008	14008	14008	14008	14008	14008	14008	14008	14008	14008	14008
				14008	14008	14008	14008	14008	14008	14008	14008	14008	14008	14008	14008	14008	14008	14008	14008	14008	14008	14008	14008	14008	14008
				14008	14008	14008	14008	14008	14008	14008	14008	14008	14008	14008	14008	14008	14008	14008	14008	14008	14008	14008	14008	14008	14008
				14008	14008	14008	14008	14008	14008	14008	14008	14008	14008	14008	14008	14008	14008	14008	14008	14008	14008	14008	14008	14008	14008
				14008	14008	14008	14008	14008	14008	14008	14008	14008	14008	14008	14008	14008	14008	14008	14008	14008	14008	14008	14008	14008	14008
				14008	14008	14008	14008	14008	14008	14008	14008	14008	14008	14008	14008	14008	14008	14008	14008	14008	14008	14008	14008	14008	14008
				14008	14008	14008	14008	14008	14008	14008	14008	14008	14008	14008	14008	14008	14008	14008	14008	14008	14008	14008	14008	14008	14008
				14008	14008	14008	14008	14008	14008	14008	14008	14008	14008	14008	14008	14008	14008	14008	14008	14008	14008	14008	14008	14008	14008
				14008	14008	14008	14008	14008	14008	14008	14008	14008	14008	14008	14008	14008	14008	14008	14008	14008	14008	14008	14008	14008	14008
				14008	14008	14008	14008	14008	14008	14008	14008	14008	14008	14008	14008	14008	14008	14008	14008	14008	14008	14008	14008	14008	14008
				14008	14008	14008	14008	14008	14008	14008	14008	14008	14008	14008	14008	14008	14008	14008	14008	14008	14008	14008	14008	14008	14008
				14008	14008	14008	14008	14008	14008	14008	14008	14008	14008	14008	14008	14008	14008	14008	14008	14008	14008	14008	14008	14008	14008
				14008	14008	14008	14008	14008	14008	14008	14008	14008	14008	14008	14008	14008	14008	14008	14008	14008	14008	14008	14008	14008	14008
				14008	14008	14008	14008	14008	14008	14008	14008	14008	14008	14008	14008	14008	14008	14008	14008	14008	14008	14008	14008	14008	14008
				14008	14008	14008	14008	14008	14008	14008	14008	14008	14008	14008	14008	14008	14008	14008	14008	14008	14008	14008	14008	14008	14008
				14008 14008 14008>;

			PS_Config_Lmt_Short_Rawdata_N = <
				10100	10100	10100	10100	10100	10100	10100	10100	10100	10100	10100	10100	10100	10100	10100	10100	10100	10100	10100	10100	10100	10100
				10100	10100	10100	10100	10100	10100	10100	10100	10100	10100	10100	10100	10100	10100	10100	10100	10100	10100	10100	10100	10100	10100
				10100	10100	10100	10100	10100	10100	10100	10100	10100	10100	10100	10100	10100	10100	10100	10100	10100	10100	10100	10100	10100	10100
				10100	10100	10100	10100	10100	10100	10100	10100	10100	10100	10100	10100	10100	10100	10100	10100	10100	10100	10100	10100	10100	10100
				10100	10100	10100	10100	10100	10100	10100	10100	10100	10100	10100	10100	10100	10100	10100	10100	10100	10100	10100	10100	10100	10100
				10100	10100	10100	10100	10100	10100	10100	10100	10100	10100	10100	10100	10100	10100	10100	10100	10100	10100	10100	10100	10100	10100
				10100	10100	10100	10100	10100	10100	10100	10100	10100	10100	10100	10100	10100	10100	10100	10100	10100	10100	10100	10100	10100	10100
				10100	10100	10100	10100	10100	10100	10100	10100	10100	10100	10100	10100	10100	10100	10100	10100	10100	10100	10100	10100	10100	10100
				10100	10100	10100	10100	10100	10100	10100	10100	10100	10100	10100	10100	10100	10100	10100	10100	10100	10100	10100	10100	10100	10100
				10100	10100	10100	10100	10100	10100	10100	10100	10100	10100	10100	10100	10100	10100	10100	10100	10100	10100	10100	10100	10100	10100
				10100	10100	10100	10100	10100	10100	10100	10100	10100	10100	10100	10100	10100	10100	10100	10100	10100	10100	10100	10100	10100	10100
				10100	10100	10100	10100	10100	10100	10100	10100	10100	10100	10100	10100	10100	10100	10100	10100	10100	10100	10100	10100	10100	10100
				10100	10100	10100	10100	10100	10100	10100	10100	10100	10100	10100	10100	10100	10100	10100	10100	10100	10100	10100	10100	10100	10100
				10100	10100	10100	10100	10100	10100	10100	10100	10100	10100	10100	10100	10100	10100	10100	10100	10100	10100	10100	10100	10100	10100
				10100	10100	10100	10100	10100	10100	10100	10100	10100	10100	10100	10100	10100	10100	10100	10100	10100	10100	10100	10100	10100	10100
				10100	10100	10100	10100	10100	10100	10100	10100	10100	10100	10100	10100	10100	10100	10100	10100	10100	10100	10100	10100	10100	10100
				10100	10100	10100	10100	10100	10100	10100	10100	10100	10100	10100	10100	10100	10100	10100	10100	10100	10100	10100	10100	10100	10100
				10100	10100	10100	10100	10100	10100	10100	10100	10100	10100	10100	10100	10100	10100	10100	10100	10100	10100	10100	10100	10100	10100
				10100	10100	10100	10100	10100	10100	10100	10100	10100	10100	10100	10100	10100	10100	10100	10100	10100	10100	10100	10100	10100	10100
				10100	10100	10100	10100	10100	10100	10100	10100	10100	10100	10100	10100	10100	10100	10100	10100	10100	10100	10100	10100	10100	10100
				10100	10100	10100	10100	10100	10100	10100	10100	10100	10100	10100	10100	10100	10100	10100	10100	10100	10100	10100	10100	10100	10100
				10100	10100	10100	10100	10100	10100	10100	10100	10100	10100	10100	10100	10100	10100	10100	10100	10100	10100	10100	10100	10100	10100
				10100	10100	10100	10100	10100	10100	10100	10100	10100	10100	10100	10100	10100	10100	10100	10100	10100	10100	10100	10100	10100	10100
				10100	10100	10100	10100	10100	10100	10100	10100	10100	10100	10100	10100	10100	10100	10100	10100	10100	10100	10100	10100	10100	10100
				10100	10100	10100	10100	10100	10100	10100	10100	10100	10100	10100	10100	10100	10100	10100	10100	10100	10100	10100	10100	10100	10100
				10100	10100	10100	10100	10100	10100	10100	10100	10100	10100	10100	10100	10100	10100	10100	10100	10100	10100	10100	10100	10100	10100
				10100	10100	10100	10100	10100	10100	10100	10100	10100	10100	10100	10100	10100	10100	10100	10100	10100	10100	10100	10100	10100	10100
				10100	10100	10100	10100	10100	10100	10100	10100	10100	10100	10100	10100	10100	10100	10100	10100	10100	10100	10100	10100	10100	10100
				10100	10100	10100	10100	10100	10100	10100	10100	10100	10100	10100	10100	10100	10100	10100	10100	10100	10100	10100	10100	10100	10100
				10100	10100	10100	10100	10100	10100	10100	10100	10100	10100	10100	10100	10100	10100	10100	10100	10100	10100	10100	10100	10100	10100
				10100	10100	10100	10100	10100	10100	10100	10100	10100	10100	10100	10100	10100	10100	10100	10100	10100	10100	10100	10100	10100	10100
				10100	10100	10100	10100	10100	10100	10100	10100	10100	10100	10100	10100	10100	10100	10100	10100	10100	10100	10100	10100	10100	10100
				10100	10100	10100	10100	10100	10100	10100	10100	10100	10100	10100	10100	10100	10100	10100	10100	10100	10100	10100	10100	10100	10100
				10100	10100	10100	10100	10100	10100	10100	10100	10100	10100	10100	10100	10100	10100	10100	10100	10100	10100	10100	10100	10100	10100
				10100	10100	10100	10100	10100	10100	10100	10100	10100	10100	10100	10100	10100	10100	10100	10100	10100	10100	10100	10100	10100	10100
				10100	10100	10100	10100	10100	10100	10100	10100	10100	10100	10100	10100	10100	10100	10100	10100	10100	10100	10100	10100	10100	10100
				10000 10000 10000>;

			PS_Config_Lmt_Open_Rawdata_P = <
				3479	3536	3594	3618	3625	3534	3431	3394	3322	3279	3380	3228	3370	3360	3350	3382	3416	3352	3389	3392	3373	3445
				3552	3594	3616	3707	3641	3576	3496	3417	3394	3377	3448	3254	3392	3410	3408	3422	3436	3441	3422	3472	3468	3490
				3571	3577	3682	3723	3704	3620	3581	3472	3455	3399	3445	3307	3489	3486	3459	3462	3501	3427	3487	3464	3513	3566
				3625	3604	3707	3773	3717	3629	3595	3493	3451	3445	3521	3349	3472	3486	3528	3531	3506	3503	3529	3535	3557	3524
				3623	3634	3737	3748	3762	3689	3613	3541	3493	3450	3511	3366	3318	3553	3527	3517	3538	3560	3528	3524	3594	3580
				3625	3644	3602	3814	3836	3690	3648	3590	3508	3503	3609	3417	3332	3549	3563	3563	3563	3567	3613	3587	3581	3590
				3714	3730	3632	3837	3850	3759	3692	3675	3563	3562	3608	3434	3389	3654	3646	3613	3609	3640	3599	3630	3653	3651
				3720	3766	3692	3893	3900	3776	3704	3674	3576	3562	3664	3497	3427	3634	3639	3679	3671	3646	3674	3660	3664	3695
				3818	3780	3704	3661	3907	3863	3809	3737	3664	3627	3676	3542	3475	3447	3742	3716	3688	3704	3766	3744	3717	3675
				3808	3875	3790	3696	3969	3940	3804	3772	3713	3647	3746	3584	3531	3461	3746	3752	3744	3735	3767	3727	3760	3732
				3851	3889	3826	3756	4001	3952	3878	3828	3795	3709	3815	3660	3546	3515	3851	3835	3786	3770	3844	3811	3767	3735
				3861	3990	3843	3765	4049	4008	3889	3832	3797	3716	3787	3662	3615	3555	3826	3830	3851	3836	3865	3877	3851	3769
				3919	4003	3930	3856	3716	4045	3963	3928	3860	3798	3878	3707	3655	3611	3592	3931	3888	3861	3921	3885	3815	3823
				3966	4046	3949	3893	3755	4101	4049	3924	3889	3843	3861	3718	3697	3664	3604	3940	3924	3917	3949	3955	3906	3818
				3963	4075	4053	3909	3814	4155	4066	3993	3942	3933	3935	3786	3769	3671	3658	4039	4001	3948	4000	3973	3905	3912
				4007	4137	4070	3994	3814	4194	4120	4008	3945	3937	3940	3826	3772	3744	3702	4015	4007	4026	4057	4008	3913	3851
				4024	4185	4105	4019	3907	3814	4154	4087	4038	4000	4024	3870	3825	3780	3756	3745	4108	4049	4077	4042	3984	3954
				4085	4183	4131	4122	3940	3847	4210	4154	4040	4032	4045	3931	3835	3830	3812	3749	4117	4091	4143	4074	4001	3956
				4109	4227	4200	4136	3947	3910	4259	4176	4108	4071	4157	3905	3905	3898	3814	3808	4211	4172	4165	4126	4038	3937
				4131	4241	4263	4175	4033	3905	4301	4231	4123	4084	4130	3991	3945	3896	3888	3853	4190	4175	4256	4124	4064	4028
				4168	4306	4263	4193	4061	3993	3902	4259	4203	4175	4211	4081	3976	3947	3923	3895	3898	4273	4262	4187	4101	4026
				4264	4323	4337	4267	4158	4031	3938	4319	4269	4176	4208	4094	4042	3966	3980	3959	3903	4287	4305	4187	4148	4059
				4260	4339	4348	4330	4173	4031	4004	4372	4280	4252	4287	4168	4024	4026	4040	3954	3955	4376	4372	4278	4151	4075
				4320	4378	4421	4323	4207	4120	3994	4409	4340	4253	4257	4171	4113	4068	4036	4024	3998	4347	4378	4264	4217	4110
				4339	4476	4444	4400	4227	4138	4075	3968	4361	4332	4376	4221	4196	4105	4089	4070	4049	4053	4453	4316	4214	4158
				4374	4470	4518	4407	4290	4242	4119	4005	4430	4404	4348	4257	4199	4171	4106	4124	4110	4063	4455	4375	4301	4165
				4382	4526	4558	4486	4361	4259	4116	4074	4483	4413	4431	4292	4271	4144	4162	4180	4109	4119	4536	4383	4291	4229
				4449	4540	4654	4507	4346	4290	4206	4067	4521	4469	4413	4348	4284	4242	4203	4175	4173	4155	4504	4460	4343	4211
				4462	4570	4654	4588	4423	4315	4228	4136	4038	4487	4494	4375	4336	4315	4243	4232	4206	4203	4278	4465	4393	4305
				4509	4578	4704	4633	4425	4369	4327	4185	4070	4558	4589	4406	4369	4312	4311	4238	4263	4263	4288	4546	4406	4271
				4528	4659	4718	4735	4495	4434	4340	4187	4136	4602	4568	4442	4403	4390	4284	4302	4329	4257	4346	4511	4486	4323
				4556	4662	4746	4732	4508	4421	4372	4266	4123	4638	4641	4512	4455	4404	4379	4343	4308	4318	4383	4414	4484	4381
				4726	4784	4831	4883	4676	4585	4479	4365	4264	4222	4710	4623	4568	4537	4537	4451	4453	4439	4500	4490	4637	4434
				4724	4803	4910	4897	4712	4584	4532	4465	4313	4239	4788	4666	4603	4578	4529	4530	4459	4500	4565	4549	4607	4516
				4792	4827	4917	4941	4810	4659	4603	4483	4327	4322	4819	4733	4638	4609	4619	4501	4528	4571	4575	4593	4627	4473
				4740	4915	4935	4928	4789	4654	4586	4537	4444	4353	4788	4696	4703	4661	4637	4610	4586	4556	4645	4635	4620	4556
				5120 5120 5120>;

			PS_Config_Lmt_Open_Rawdata_N = <
				1491	1516	1540	1550	1553	1514	1471	1454	1424	1405	1448	1384	1444	1440	1436	1450	1464	1436	1453	1454	1445	1477
				1522	1540	1550	1589	1561	1532	1498	1465	1454	1447	1478	1394	1454	1462	1460	1466	1472	1475	1466	1488	1486	1496
				1531	1533	1578	1595	1588	1552	1535	1488	1481	1457	1477	1417	1495	1494	1483	1484	1501	1469	1495	1484	1505	1528
				1553	1544	1589	1617	1593	1555	1541	1497	1479	1477	1509	1435	1488	1494	1512	1513	1502	1501	1513	1515	1525	1510
				1553	1558	1601	1606	1612	1581	1549	1517	1497	1478	1505	1442	1422	1523	1511	1507	1516	1526	1512	1510	1540	1534
				1553	1562	1544	1634	1644	1582	1564	1538	1504	1501	1547	1465	1428	1521	1527	1527	1527	1529	1549	1537	1535	1538
				1592	1598	1556	1645	1650	1611	1582	1575	1527	1526	1546	1472	1453	1566	1562	1549	1547	1560	1543	1556	1565	1565
				1594	1614	1582	1669	1672	1618	1588	1574	1532	1526	1570	1499	1469	1558	1559	1577	1573	1562	1574	1568	1570	1583
				1636	1620	1588	1569	1675	1655	1633	1601	1570	1555	1576	1518	1489	1477	1604	1592	1580	1588	1614	1604	1593	1575
				1632	1661	1624	1584	1701	1688	1630	1616	1591	1563	1606	1536	1513	1483	1606	1608	1604	1601	1615	1597	1612	1600
				1651	1667	1640	1610	1715	1694	1662	1640	1627	1589	1635	1568	1520	1507	1651	1643	1622	1616	1648	1633	1615	1601
				1655	1710	1647	1613	1735	1718	1667	1642	1627	1592	1623	1570	1549	1523	1640	1642	1651	1644	1657	1661	1651	1615
				1679	1715	1684	1652	1592	1733	1699	1684	1654	1628	1662	1589	1567	1547	1540	1685	1666	1655	1681	1665	1635	1639
				1700	1734	1693	1669	1609	1757	1735	1682	1667	1647	1655	1594	1585	1570	1544	1688	1682	1679	1693	1695	1674	1636
				1699	1747	1737	1675	1634	1781	1742	1711	1690	1685	1687	1622	1615	1573	1568	1731	1715	1692	1714	1703	1673	1676
				1717	1773	1744	1712	1634	1798	1766	1718	1691	1687	1688	1640	1616	1604	1586	1721	1717	1726	1739	1718	1677	1651
				1724	1793	1759	1723	1675	1634	1780	1751	1730	1714	1724	1658	1639	1620	1610	1605	1760	1735	1747	1732	1708	1694
				1751	1793	1771	1766	1688	1649	1804	1780	1732	1728	1733	1685	1643	1642	1634	1607	1765	1753	1775	1746	1715	1696
				1761	1811	1800	1772	1691	1676	1825	1790	1760	1745	1781	1673	1673	1670	1634	1632	1805	1788	1785	1768	1730	1687
				1771	1817	1827	1789	1729	1673	1843	1813	1767	1750	1770	1711	1691	1670	1666	1651	1796	1789	1824	1768	1742	1726
				1786	1846	1827	1797	1741	1711	1672	1825	1801	1789	1805	1749	1704	1691	1681	1669	1670	1831	1826	1795	1757	1726
				1828	1853	1859	1829	1782	1727	1688	1851	1829	1790	1804	1754	1732	1700	1706	1697	1673	1837	1845	1795	1778	1739
				1826	1859	1864	1856	1789	1727	1716	1874	1834	1822	1837	1786	1724	1726	1732	1694	1695	1876	1874	1834	1779	1747
				1852	1876	1895	1853	1803	1766	1712	1889	1860	1823	1825	1787	1763	1744	1730	1724	1714	1863	1876	1828	1807	1762
				1859	1918	1904	1886	1811	1774	1747	1700	1869	1856	1876	1809	1798	1759	1753	1744	1735	1737	1909	1850	1806	1782
				1874	1916	1936	1889	1838	1818	1765	1717	1898	1888	1864	1825	1799	1787	1760	1768	1762	1741	1909	1875	1843	1785
				1878	1940	1954	1922	1869	1825	1764	1746	1921	1891	1899	1840	1831	1776	1784	1792	1761	1765	1944	1879	1839	1813
				1907	1946	1994	1931	1862	1838	1802	1743	1937	1915	1891	1864	1836	1818	1801	1789	1789	1781	1930	1912	1861	1805
				1912	1958	1994	1966	1895	1849	1812	1772	1730	1923	1926	1875	1858	1849	1819	1814	1802	1801	1834	1913	1883	1845
				1933	1962	2016	1985	1897	1873	1855	1793	1744	1954	1967	1888	1873	1848	1847	1816	1827	1827	1838	1948	1888	1831
				1940	1997	2022	2029	1927	1900	1860	1795	1772	1972	1958	1904	1887	1882	1836	1844	1855	1825	1862	1933	1922	1853
				1952	1998	2034	2028	1932	1895	1874	1828	1767	1988	1989	1934	1909	1888	1877	1861	1846	1850	1879	1892	1922	1877
				2026	2050	2071	2093	2004	1965	1919	1871	1828	1810	2018	1981	1958	1945	1945	1907	1909	1903	1928	1924	1987	1900
				2024	2059	2104	2099	2020	1964	1942	1913	1849	1817	2052	2000	1973	1962	1941	1942	1911	1928	1957	1949	1975	1936
				2054	2069	2107	2117	2062	1997	1973	1921	1855	1852	2065	2029	1988	1975	1979	1929	1940	1959	1961	1969	1983	1917
				2032	2107	2115	2112	2053	1994	1966	1945	1904	1865	2052	2012	2015	1997	1987	1976	1966	1952	1991	1987	1980	1952
				(-511) (-511) (-511)>;

			PS_Config_Lmt_FW_Rawdata_P = <
				1137	1103	1117	1117	1103	1121	1117	1121	1124	1114	1119	1114	1113	1121	1133	1119	1123	1121	1130	1119	1127	1124
				1116	1120	1114	1138	1119	1120	1113	1128	1126	1109	1113	1124	1117	1121	1114	1120	1130	1138	1116	1116	1120	1131
				1112	1123	1133	1128	1119	1119	1119	1123	1113	1116	1103	1117	1127	1120	1113	1109	1120	1119	1119	1117	1123	1113
				1114	1120	1117	1121	1113	1124	1121	1120	1110	1117	1126	1124	1123	1126	1124	1119	1121	1123	1117	1121	1119	1110
				1119	1110	1123	1112	1107	1123	1133	1126	1128	1116	1131	1120	1114	1112	1127	1126	1116	1119	1121	1124	1114	1130
				1119	1119	1119	1128	1121	1134	1130	1120	1112	1126	1107	1124	1121	1123	1128	1114	1128	1126	1120	1128	1121	1112
				1114	1120	1114	1124	1133	1114	1119	1116	1127	1110	1106	1114	1100	1123	1116	1121	1128	1120	1120	1128	1116	1119
				1127	1124	1110	1117	1121	1107	1114	1123	1121	1127	1124	1121	1130	1135	1137	1121	1119	1124	1117	1114	1135	1126
				1130	1137	1112	1131	1137	1113	1113	1117	1109	1123	1127	1127	1124	1110	1128	1124	1117	1130	1120	1107	1110	1110
				1117	1126	1116	1117	1120	1121	1120	1131	1126	1116	1116	1112	1126	1117	1121	1126	1119	1133	1123	1120	1117	1117
				1119	1126	1121	1127	1116	1127	1119	1134	1123	1112	1117	1116	1103	1110	1131	1126	1123	1120	1117	1130	1127	1113
				1119	1119	1126	1123	1119	1117	1123	1124	1126	1124	1135	1124	1114	1109	1117	1119	1123	1116	1113	1112	1127	1116
				1126	1130	1107	1112	1127	1112	1127	1113	1126	1121	1124	1124	1116	1110	1137	1121	1120	1109	1121	1124	1105	1117
				1127	1126	1117	1131	1126	1120	1123	1119	1140	1119	1121	1131	1120	1114	1116	1124	1123	1128	1120	1126	1121	1133
				1123	1112	1131	1117	1128	1114	1126	1116	1123	1117	1128	1126	1110	1107	1121	1117	1119	1106	1130	1128	1120	1130
				1120	1121	1121	1114	1117	1124	1124	1105	1110	1121	1120	1109	1126	1126	1103	1126	1120	1127	1130	1117	1133	1117
				1131	1121	1133	1120	1131	1126	1117	1120	1126	1128	1119	1116	1123	1110	1112	1133	1116	1130	1116	1110	1127	1121
				1110	1120	1126	1123	1119	1120	1128	1123	1110	1127	1106	1113	1120	1134	1123	1116	1127	1126	1126	1124	1117	1107
				1109	1119	1121	1126	1117	1107	1124	1121	1123	1123	1124	1117	1116	1120	1126	1121	1124	1116	1140	1103	1127	1109
				1121	1123	1109	1123	1110	1126	1133	1127	1123	1119	1119	1128	1116	1127	1123	1120	1131	1120	1110	1112	1126	1134
				1123	1120	1113	1120	1112	1126	1116	1114	1121	1112	1126	1119	1119	1127	1126	1127	1113	1117	1124	1128	1121	1127
				1127	1128	1124	1128	1123	1117	1113	1120	1127	1116	1123	1126	1127	1114	1110	1131	1117	1124	1117	1131	1134	1131
				1123	1117	1114	1105	1128	1116	1110	1126	1126	1121	1120	1112	1113	1126	1113	1123	1113	1117	1117	1112	1126	1112
				1134	1126	1116	1119	1114	1120	1127	1112	1121	1109	1112	1107	1126	1110	1124	1121	1119	1116	1124	1123	1133	1113
				1120	1103	1110	1110	1121	1116	1126	1123	1112	1119	1131	1119	1112	1126	1126	1119	1117	1117	1134	1123	1126	1109
				1114	1121	1120	1119	1128	1124	1123	1123	1114	1119	1117	1110	1128	1121	1127	1140	1100	1116	1117	1119	1114	1116
				1119	1109	1124	1124	1119	1110	1130	1121	1130	1119	1135	1110	1119	1127	1105	1121	1121	1114	1124	1113	1127	1120
				1114	1119	1124	1121	1112	1117	1114	1127	1134	1119	1138	1119	1113	1131	1119	1112	1113	1121	1107	1135	1112	1134
				1120	1121	1112	1112	1119	1127	1116	1117	1120	1133	1123	1126	1116	1117	1123	1131	1123	1117	1114	1121	1117	1121
				1105	1119	1128	1130	1119	1127	1119	1119	1112	1102	1114	1117	1120	1124	1117	1119	1121	1109	1116	1130	1117	1120
				1114	1127	1121	1119	1116	1124	1116	1120	1114	1126	1114	1119	1124	1112	1124	1128	1117	1120	1121	1113	1120	1120
				1127	1130	1123	1121	1119	1113	1126	1123	1126	1133	1130	1116	1128	1130	1124	1124	1123	1128	1126	1124	1121	1123
				1114	1109	1116	1123	1105	1120	1123	1126	1123	1119	1114	1112	1126	1114	1119	1107	1119	1113	1109	1116	1117	1110
				1120	1110	1120	1116	1116	1116	1116	1130	1117	1120	1117	1114	1120	1120	1130	1130	1126	1124	1110	1117	1120	1124
				1133	1124	1128	1112	1124	1119	1126	1126	1119	1110	1112	1138	1120	1121	1105	1107	1121	1119	1102	1112	1113	1098
				1109	1127	1121	1134	1116	1116	1119	1107	1110	1114	1105	1119	1133	1110	1120	1116	1114	1119	1117	1117	1121	1128
				3840 3840 3840>;

			PS_Config_Lmt_FW_Rawdata_N = <
				487	473	479	479	473	481	479	481	482	478	479	478	477	481	485	479	481	481	484	479	483	482
				478	480	478	488	479	480	477	484	482	475	477	482	479	481	478	480	484	488	478	478	480	485
				476	481	485	484	479	479	479	481	477	478	473	479	483	480	477	475	480	479	479	479	481	477
				478	480	479	481	477	482	481	480	476	479	482	482	481	482	482	479	481	481	479	481	479	476
				479	476	481	476	475	481	485	482	484	478	485	480	478	476	483	482	478	479	481	482	478	484
				479	479	479	484	481	486	484	480	476	482	475	482	481	481	484	478	484	482	480	484	481	476
				478	480	478	482	485	478	479	478	483	476	474	478	472	481	478	481	484	480	480	484	478	479
				483	482	476	479	481	475	478	481	481	483	482	481	484	487	487	481	479	482	479	478	487	482
				484	487	476	485	487	477	477	479	475	481	483	483	482	476	484	482	479	484	480	475	476	476
				479	482	478	479	480	481	480	485	482	478	478	476	482	479	481	482	479	485	481	480	479	479
				479	482	481	483	478	483	479	486	481	476	479	478	473	476	485	482	481	480	479	484	483	477
				479	479	482	481	479	479	481	482	482	482	487	482	478	475	479	479	481	478	477	476	483	478
				482	484	475	476	483	476	483	477	482	481	482	482	478	476	487	481	480	475	481	482	473	479
				483	482	479	485	482	480	481	479	488	479	481	485	480	478	478	482	481	484	480	482	481	485
				481	476	485	479	484	478	482	478	481	479	484	482	476	475	481	479	479	474	484	484	480	484
				480	481	481	478	479	482	482	473	476	481	480	475	482	482	473	482	480	483	484	479	485	479
				485	481	485	480	485	482	479	480	482	484	479	478	481	476	476	485	478	484	478	476	483	481
				476	480	482	481	479	480	484	481	476	483	474	477	480	486	481	478	483	482	482	482	479	475
				475	479	481	482	479	475	482	481	481	481	482	479	478	480	482	481	482	478	488	473	483	475
				481	481	475	481	476	482	485	483	481	479	479	484	478	483	481	480	485	480	476	476	482	486
				481	480	477	480	476	482	478	478	481	476	482	479	479	483	482	483	477	479	482	484	481	483
				483	484	482	484	481	479	477	480	483	478	481	482	483	478	476	485	479	482	479	485	486	485
				481	479	478	473	484	478	476	482	482	481	480	476	477	482	477	481	477	479	479	476	482	476
				486	482	478	479	478	480	483	476	481	475	476	475	482	476	482	481	479	478	482	481	485	477
				480	473	476	476	481	478	482	481	476	479	485	479	476	482	482	479	479	479	486	481	482	475
				478	481	480	479	484	482	481	481	478	479	479	476	484	481	483	488	472	478	479	479	478	478
				479	475	482	482	479	476	484	481	484	479	487	476	479	483	473	481	481	478	482	477	483	480
				478	479	482	481	476	479	478	483	486	479	488	479	477	485	479	476	477	481	475	487	476	486
				480	481	476	476	479	483	478	479	480	485	481	482	478	479	481	485	481	479	478	481	479	481
				473	479	484	484	479	483	479	479	476	472	478	479	480	482	479	479	481	475	478	484	479	480
				478	483	481	479	478	482	478	480	478	482	478	479	482	476	482	484	479	480	481	477	480	480
				483	484	481	481	479	477	482	481	482	485	484	478	484	484	482	482	481	484	482	482	481	481
				478	475	478	481	473	480	481	482	481	479	478	476	482	478	479	475	479	477	475	478	479	476
				480	476	480	478	478	478	478	484	479	480	479	478	480	480	484	484	482	482	476	479	480	482
				485	482	484	476	482	479	482	482	479	476	476	488	480	481	473	475	481	479	472	476	477	470
				475	483	481	486	478	478	479	475	476	478	473	479	485	476	480	478	478	479	479	479	481	484
				240 240 240>;

			PS_Config_Lmt_FW_CC_P = <
				148	201	203	201	203	201	201	200	199	199	160	142	204	203	201	200	201	200	200	203	161	146
				145	200	199	201	200	200	201	199	201	200	160	142	200	201	199	199	200	199	200	197	184	160
				145	142	201	199	200	200	201	197	199	197	159	141	203	200	199	199	199	197	197	200	199	164
				161	144	200	203	203	201	200	200	200	203	182	142	203	201	203	201	200	200	200	199	201	163
				164	144	203	201	203	201	201	201	200	199	199	160	141	204	203	200	200	201	200	201	200	186
				163	144	144	204	207	203	203	204	200	204	203	164	145	204	204	203	201	203	201	199	201	203
				186	161	145	204	201	203	203	204	200	200	199	163	142	206	203	200	201	201	200	203	201	204
				201	163	145	206	207	206	204	203	201	203	204	186	144	206	203	206	204	203	203	201	203	203
				206	161	145	145	204	204	204	203	203	201	200	201	161	142	206	204	203	201	203	203	200	204
				203	185	161	146	207	208	204	204	206	203	206	204	166	146	206	206	204	203	204	201	203	203
				207	201	164	145	207	204	204	204	206	201	203	203	163	145	207	204	203	203	203	204	201	206
				203	206	163	145	208	208	206	206	204	203	204	204	186	145	208	206	207	206	204	204	203	201
				208	201	186	163	146	207	206	206	204	204	203	204	203	163	144	207	206	204	203	204	201	206
				204	207	203	166	148	210	210	207	206	207	204	206	206	167	148	207	207	206	204	203	204	203
				207	203	206	164	146	208	206	206	206	207	203	203	204	164	146	210	206	204	204	204	203	206
				206	208	203	188	146	211	210	208	207	206	206	206	206	188	146	210	207	208	206	203	204	203
				206	204	208	203	164	148	208	207	207	206	206	204	204	204	164	145	210	207	206	206	203	206
				206	207	203	207	167	149	211	211	207	207	208	206	207	207	168	149	208	208	206	204	204	206
				207	206	210	204	166	149	210	207	206	207	208	204	204	206	166	148	211	207	204	207	203	207
				206	206	206	210	189	149	213	211	208	208	207	207	207	207	190	148	211	208	210	206	204	206
				208	206	207	204	206	166	149	210	208	208	208	207	206	206	206	166	146	210	208	207	204	207
				208	207	207	210	208	168	150	213	213	208	208	208	207	208	210	170	150	210	210	204	207	206
				207	207	207	207	206	167	150	211	208	208	210	207	206	206	208	167	149	213	208	210	204	207
				208	208	207	208	211	190	150	214	213	211	211	210	208	208	208	192	149	213	210	208	206	206
				208	208	208	208	207	207	168	150	211	210	210	208	208	207	208	208	167	149	211	210	204	208
				208	208	208	208	213	211	170	152	214	214	211	210	210	210	210	210	172	152	211	208	210	207
				210	208	211	208	208	207	168	152	213	210	210	210	208	208	207	208	168	150	213	210	208	208
				210	208	211	210	211	213	193	152	215	214	213	211	211	210	210	210	193	152	214	211	208	206
				210	208	210	211	210	208	208	170	152	211	213	210	210	210	208	210	210	170	150	211	208	211
				208	210	211	213	210	214	213	171	153	215	217	211	210	211	211	211	211	174	153	213	208	210
				211	210	211	213	210	210	208	170	153	214	213	210	210	210	210	208	210	171	152	213	210	211
				210	210	211	211	211	213	214	195	153	217	215	214	213	211	211	211	211	195	152	150	210	210
				214	208	211	211	211	211	210	210	171	153	214	213	211	210	211	210	210	210	171	153	211	210
				208	211	211	211	213	211	214	213	172	155	217	214	211	211	211	211	211	211	174	152	211	211
				213	208	211	211	213	210	210	208	171	153	215	211	208	210	210	208	208	210	171	152	152	211
				211	213	208	211	211	211	211	215	195	155	217	211	213	211	211	211	211	211	195	170	155	214
				314 314 314>;

			PS_Config_Lmt_FW_CC_N = <
				66	91	91	91	91	91	91	90	89	89	72	64	92	91	91	90	91	90	90	91	73	66
				65	90	89	91	90	90	91	89	91	90	72	64	90	91	89	89	90	89	90	89	82	72
				65	64	91	89	90	90	91	89	89	89	71	63	91	90	89	89	89	89	89	90	89	74
				73	64	90	91	91	91	90	90	90	91	82	64	91	91	91	91	90	90	90	89	91	73
				74	64	91	91	91	91	91	91	90	89	89	72	63	92	91	90	90	91	90	91	90	84
				73	64	64	92	93	91	91	92	90	92	91	74	65	92	92	91	91	91	91	89	91	91
				84	73	65	92	91	91	91	92	90	90	89	73	64	92	91	90	91	91	90	91	91	92
				91	73	65	92	93	92	92	91	91	91	92	84	64	92	91	92	92	91	91	91	91	91
				92	73	65	65	92	92	92	91	91	91	90	91	73	64	92	92	91	91	91	91	90	92
				91	83	73	66	93	94	92	92	92	91	92	92	74	66	92	92	92	91	92	91	91	91
				93	91	74	65	93	92	92	92	92	91	91	91	73	65	93	92	91	91	91	92	91	92
				91	92	73	65	94	94	92	92	92	91	92	92	84	65	94	92	93	92	92	92	91	91
				94	91	84	73	66	93	92	92	92	92	91	92	91	73	64	93	92	92	91	92	91	92
				92	93	91	74	66	94	94	93	92	93	92	92	92	75	66	93	93	92	92	91	92	91
				93	91	92	74	66	94	92	92	92	93	91	91	92	74	66	94	92	92	92	92	91	92
				92	94	91	84	66	95	94	94	93	92	92	92	92	84	66	94	93	94	92	91	92	91
				92	92	94	91	74	66	94	93	93	92	92	92	92	92	74	65	94	93	92	92	91	92
				92	93	91	93	75	67	95	95	93	93	94	92	93	93	76	67	94	94	92	92	92	92
				93	92	94	92	74	67	94	93	92	93	94	92	92	92	74	66	95	93	92	93	91	93
				92	92	92	94	85	67	95	95	94	94	93	93	93	93	86	66	95	94	94	92	92	92
				94	92	93	92	92	74	67	94	94	94	94	93	92	92	92	74	66	94	94	93	92	93
				94	93	93	94	94	76	68	95	95	94	94	94	93	94	94	76	68	94	94	92	93	92
				93	93	93	93	92	75	68	95	94	94	94	93	92	92	94	75	67	95	94	94	92	93
				94	94	93	94	95	86	68	96	95	95	95	94	94	94	94	86	67	95	94	94	92	92
				94	94	94	94	93	93	76	68	95	94	94	94	94	93	94	94	75	67	95	94	92	94
				94	94	94	94	95	95	76	68	96	96	95	94	94	94	94	94	78	68	95	94	94	93
				94	94	95	94	94	93	76	68	95	94	94	94	94	94	93	94	76	68	95	94	94	94
				94	94	95	94	95	95	87	68	97	96	95	95	95	94	94	94	87	68	96	95	94	92
				94	94	94	95	94	94	94	76	68	95	95	94	94	94	94	94	94	76	68	95	94	95
				94	94	95	95	94	96	95	77	69	97	97	95	94	95	95	95	95	78	69	95	94	94
				95	94	95	95	94	94	94	76	69	96	95	94	94	94	94	94	94	77	68	95	94	95
				94	94	95	95	95	95	96	87	69	97	97	96	95	95	95	95	95	87	68	68	94	94
				96	94	95	95	95	95	94	94	77	69	96	95	95	94	95	94	94	94	77	69	95	94
				94	95	95	95	95	95	96	95	78	69	97	96	95	95	95	95	95	95	78	68	95	95
				95	94	95	95	95	94	94	94	77	69	97	95	94	94	94	94	94	94	77	68	68	95
				95	95	94	95	95	95	95	97	87	69	97	95	95	95	95	95	95	95	87	76	69	96
				0 0 0>;

			PS_Config_Lmt_FW_Diff_P = <
				50	50	50	50	50	50	50	50	50	50	50	50	50	50	50	50	50	50	50	50	50	50
				50	50	50	50	50	50	50	50	50	50	50	50	50	50	50	50	50	50	50	50	50	50
				50	50	50	50	50	50	50	50	50	50	50	50	50	50	50	50	50	50	50	50	50	50
				50	50	50	50	50	50	50	50	50	50	50	50	50	50	50	50	50	50	50	50	50	50
				50	50	50	50	50	50	50	50	50	50	50	50	50	50	50	50	50	50	50	50	50	50
				50	50	50	50	50	50	50	50	50	50	50	50	50	50	50	50	50	50	50	50	50	50
				50	50	50	50	50	50	50	50	50	50	50	50	50	50	50	50	50	50	50	50	50	50
				50	50	50	50	50	50	50	50	50	50	50	50	50	50	50	50	50	50	50	50	50	50
				50	50	50	50	50	50	50	50	50	50	50	50	50	50	50	50	50	50	50	50	50	50
				50	50	50	50	50	50	50	50	50	50	50	50	50	50	50	50	50	50	50	50	50	50
				50	50	50	50	50	50	50	50	50	50	50	50	50	50	50	50	50	50	50	50	50	50
				50	50	50	50	50	50	50	50	50	50	50	50	50	50	50	50	50	50	50	50	50	50
				50	50	50	50	50	50	50	50	50	50	50	50	50	50	50	50	50	50	50	50	50	50
				50	50	50	50	50	50	50	50	50	50	50	50	50	50	50	50	50	50	50	50	50	50
				50	50	50	50	50	50	50	50	50	50	50	50	50	50	50	50	50	50	50	50	50	50
				50	50	50	50	50	50	50	50	50	50	50	50	50	50	50	50	50	50	50	50	50	50
				50	50	50	50	50	50	50	50	50	50	50	50	50	50	50	50	50	50	50	50	50	50
				50	50	50	50	50	50	50	50	50	50	50	50	50	50	50	50	50	50	50	50	50	50
				50	50	50	50	50	50	50	50	50	50	50	50	50	50	50	50	50	50	50	50	50	50
				50	50	50	50	50	50	50	50	50	50	50	50	50	50	50	50	50	50	50	50	50	50
				50	50	50	50	50	50	50	50	50	50	50	50	50	50	50	50	50	50	50	50	50	50
				50	50	50	50	50	50	50	50	50	50	50	50	50	50	50	50	50	50	50	50	50	50
				50	50	50	50	50	50	50	50	50	50	50	50	50	50	50	50	50	50	50	50	50	50
				50	50	50	50	50	50	50	50	50	50	50	50	50	50	50	50	50	50	50	50	50	50
				50	50	50	50	50	50	50	50	50	50	50	50	50	50	50	50	50	50	50	50	50	50
				50	50	50	50	50	50	50	50	50	50	50	50	50	50	50	50	50	50	50	50	50	50
				50	50	50	50	50	50	50	50	50	50	50	50	50	50	50	50	50	50	50	50	50	50
				50	50	50	50	50	50	50	50	50	50	50	50	50	50	50	50	50	50	50	50	50	50
				50	50	50	50	50	50	50	50	50	50	50	50	50	50	50	50	50	50	50	50	50	50
				50	50	50	50	50	50	50	50	50	50	50	50	50	50	50	50	50	50	50	50	50	50
				50	50	50	50	50	50	50	50	50	50	50	50	50	50	50	50	50	50	50	50	50	50
				50	50	50	50	50	50	50	50	50	50	50	50	50	50	50	50	50	50	50	50	50	50
				50	50	50	50	50	50	50	50	50	50	50	50	50	50	50	50	50	50	50	50	50	50
				50	50	50	50	50	50	50	50	50	50	50	50	50	50	50	50	50	50	50	50	50	50
				50	50	50	50	50	50	50	50	50	50	50	50	50	50	50	50	50	50	50	50	50	50
				50	50	50	50	50	50	50	50	50	50	50	50	50	50	50	50	50	50	50	50	50	50
				75 75 75>;

			PS_Config_Lmt_FW_Diff_N = <
				(-50)	(-50)	(-50)	(-50)	(-50)	(-50)	(-50)	(-50)	(-50)	(-50)	(-50)	(-50)	(-50)	(-50)	(-50)	(-50)	(-50)	(-50)	(-50)	(-50)	(-50)	(-50)
				(-50)	(-50)	(-50)	(-50)	(-50)	(-50)	(-50)	(-50)	(-50)	(-50)	(-50)	(-50)	(-50)	(-50)	(-50)	(-50)	(-50)	(-50)	(-50)	(-50)	(-50)	(-50)
				(-50)	(-50)	(-50)	(-50)	(-50)	(-50)	(-50)	(-50)	(-50)	(-50)	(-50)	(-50)	(-50)	(-50)	(-50)	(-50)	(-50)	(-50)	(-50)	(-50)	(-50)	(-50)
				(-50)	(-50)	(-50)	(-50)	(-50)	(-50)	(-50)	(-50)	(-50)	(-50)	(-50)	(-50)	(-50)	(-50)	(-50)	(-50)	(-50)	(-50)	(-50)	(-50)	(-50)	(-50)
				(-50)	(-50)	(-50)	(-50)	(-50)	(-50)	(-50)	(-50)	(-50)	(-50)	(-50)	(-50)	(-50)	(-50)	(-50)	(-50)	(-50)	(-50)	(-50)	(-50)	(-50)	(-50)
				(-50)	(-50)	(-50)	(-50)	(-50)	(-50)	(-50)	(-50)	(-50)	(-50)	(-50)	(-50)	(-50)	(-50)	(-50)	(-50)	(-50)	(-50)	(-50)	(-50)	(-50)	(-50)
				(-50)	(-50)	(-50)	(-50)	(-50)	(-50)	(-50)	(-50)	(-50)	(-50)	(-50)	(-50)	(-50)	(-50)	(-50)	(-50)	(-50)	(-50)	(-50)	(-50)	(-50)	(-50)
				(-50)	(-50)	(-50)	(-50)	(-50)	(-50)	(-50)	(-50)	(-50)	(-50)	(-50)	(-50)	(-50)	(-50)	(-50)	(-50)	(-50)	(-50)	(-50)	(-50)	(-50)	(-50)
				(-50)	(-50)	(-50)	(-50)	(-50)	(-50)	(-50)	(-50)	(-50)	(-50)	(-50)	(-50)	(-50)	(-50)	(-50)	(-50)	(-50)	(-50)	(-50)	(-50)	(-50)	(-50)
				(-50)	(-50)	(-50)	(-50)	(-50)	(-50)	(-50)	(-50)	(-50)	(-50)	(-50)	(-50)	(-50)	(-50)	(-50)	(-50)	(-50)	(-50)	(-50)	(-50)	(-50)	(-50)
				(-50)	(-50)	(-50)	(-50)	(-50)	(-50)	(-50)	(-50)	(-50)	(-50)	(-50)	(-50)	(-50)	(-50)	(-50)	(-50)	(-50)	(-50)	(-50)	(-50)	(-50)	(-50)
				(-50)	(-50)	(-50)	(-50)	(-50)	(-50)	(-50)	(-50)	(-50)	(-50)	(-50)	(-50)	(-50)	(-50)	(-50)	(-50)	(-50)	(-50)	(-50)	(-50)	(-50)	(-50)
				(-50)	(-50)	(-50)	(-50)	(-50)	(-50)	(-50)	(-50)	(-50)	(-50)	(-50)	(-50)	(-50)	(-50)	(-50)	(-50)	(-50)	(-50)	(-50)	(-50)	(-50)	(-50)
				(-50)	(-50)	(-50)	(-50)	(-50)	(-50)	(-50)	(-50)	(-50)	(-50)	(-50)	(-50)	(-50)	(-50)	(-50)	(-50)	(-50)	(-50)	(-50)	(-50)	(-50)	(-50)
				(-50)	(-50)	(-50)	(-50)	(-50)	(-50)	(-50)	(-50)	(-50)	(-50)	(-50)	(-50)	(-50)	(-50)	(-50)	(-50)	(-50)	(-50)	(-50)	(-50)	(-50)	(-50)
				(-50)	(-50)	(-50)	(-50)	(-50)	(-50)	(-50)	(-50)	(-50)	(-50)	(-50)	(-50)	(-50)	(-50)	(-50)	(-50)	(-50)	(-50)	(-50)	(-50)	(-50)	(-50)
				(-50)	(-50)	(-50)	(-50)	(-50)	(-50)	(-50)	(-50)	(-50)	(-50)	(-50)	(-50)	(-50)	(-50)	(-50)	(-50)	(-50)	(-50)	(-50)	(-50)	(-50)	(-50)
				(-50)	(-50)	(-50)	(-50)	(-50)	(-50)	(-50)	(-50)	(-50)	(-50)	(-50)	(-50)	(-50)	(-50)	(-50)	(-50)	(-50)	(-50)	(-50)	(-50)	(-50)	(-50)
				(-50)	(-50)	(-50)	(-50)	(-50)	(-50)	(-50)	(-50)	(-50)	(-50)	(-50)	(-50)	(-50)	(-50)	(-50)	(-50)	(-50)	(-50)	(-50)	(-50)	(-50)	(-50)
				(-50)	(-50)	(-50)	(-50)	(-50)	(-50)	(-50)	(-50)	(-50)	(-50)	(-50)	(-50)	(-50)	(-50)	(-50)	(-50)	(-50)	(-50)	(-50)	(-50)	(-50)	(-50)
				(-50)	(-50)	(-50)	(-50)	(-50)	(-50)	(-50)	(-50)	(-50)	(-50)	(-50)	(-50)	(-50)	(-50)	(-50)	(-50)	(-50)	(-50)	(-50)	(-50)	(-50)	(-50)
				(-50)	(-50)	(-50)	(-50)	(-50)	(-50)	(-50)	(-50)	(-50)	(-50)	(-50)	(-50)	(-50)	(-50)	(-50)	(-50)	(-50)	(-50)	(-50)	(-50)	(-50)	(-50)
				(-50)	(-50)	(-50)	(-50)	(-50)	(-50)	(-50)	(-50)	(-50)	(-50)	(-50)	(-50)	(-50)	(-50)	(-50)	(-50)	(-50)	(-50)	(-50)	(-50)	(-50)	(-50)
				(-50)	(-50)	(-50)	(-50)	(-50)	(-50)	(-50)	(-50)	(-50)	(-50)	(-50)	(-50)	(-50)	(-50)	(-50)	(-50)	(-50)	(-50)	(-50)	(-50)	(-50)	(-50)
				(-50)	(-50)	(-50)	(-50)	(-50)	(-50)	(-50)	(-50)	(-50)	(-50)	(-50)	(-50)	(-50)	(-50)	(-50)	(-50)	(-50)	(-50)	(-50)	(-50)	(-50)	(-50)
				(-50)	(-50)	(-50)	(-50)	(-50)	(-50)	(-50)	(-50)	(-50)	(-50)	(-50)	(-50)	(-50)	(-50)	(-50)	(-50)	(-50)	(-50)	(-50)	(-50)	(-50)	(-50)
				(-50)	(-50)	(-50)	(-50)	(-50)	(-50)	(-50)	(-50)	(-50)	(-50)	(-50)	(-50)	(-50)	(-50)	(-50)	(-50)	(-50)	(-50)	(-50)	(-50)	(-50)	(-50)
				(-50)	(-50)	(-50)	(-50)	(-50)	(-50)	(-50)	(-50)	(-50)	(-50)	(-50)	(-50)	(-50)	(-50)	(-50)	(-50)	(-50)	(-50)	(-50)	(-50)	(-50)	(-50)
				(-50)	(-50)	(-50)	(-50)	(-50)	(-50)	(-50)	(-50)	(-50)	(-50)	(-50)	(-50)	(-50)	(-50)	(-50)	(-50)	(-50)	(-50)	(-50)	(-50)	(-50)	(-50)
				(-50)	(-50)	(-50)	(-50)	(-50)	(-50)	(-50)	(-50)	(-50)	(-50)	(-50)	(-50)	(-50)	(-50)	(-50)	(-50)	(-50)	(-50)	(-50)	(-50)	(-50)	(-50)
				(-50)	(-50)	(-50)	(-50)	(-50)	(-50)	(-50)	(-50)	(-50)	(-50)	(-50)	(-50)	(-50)	(-50)	(-50)	(-50)	(-50)	(-50)	(-50)	(-50)	(-50)	(-50)
				(-50)	(-50)	(-50)	(-50)	(-50)	(-50)	(-50)	(-50)	(-50)	(-50)	(-50)	(-50)	(-50)	(-50)	(-50)	(-50)	(-50)	(-50)	(-50)	(-50)	(-50)	(-50)
				(-50)	(-50)	(-50)	(-50)	(-50)	(-50)	(-50)	(-50)	(-50)	(-50)	(-50)	(-50)	(-50)	(-50)	(-50)	(-50)	(-50)	(-50)	(-50)	(-50)	(-50)	(-50)
				(-50)	(-50)	(-50)	(-50)	(-50)	(-50)	(-50)	(-50)	(-50)	(-50)	(-50)	(-50)	(-50)	(-50)	(-50)	(-50)	(-50)	(-50)	(-50)	(-50)	(-50)	(-50)
				(-50)	(-50)	(-50)	(-50)	(-50)	(-50)	(-50)	(-50)	(-50)	(-50)	(-50)	(-50)	(-50)	(-50)	(-50)	(-50)	(-50)	(-50)	(-50)	(-50)	(-50)	(-50)
				(-50)	(-50)	(-50)	(-50)	(-50)	(-50)	(-50)	(-50)	(-50)	(-50)	(-50)	(-50)	(-50)	(-50)	(-50)	(-50)	(-50)	(-50)	(-50)	(-50)	(-50)	(-50)
				(-75) (-75) (-75)>;

			PS_Config_Diff_Test_Frame = <50>;
		};
		/* for Xiaomi N85 NT36523D CSOT8.68" panel module */
		novatek-mp-criteria-598A@0 {
			#address-cells = <1>;
			#size-cells = <0>;
			compatible = "novatek-mp-criteria-598A";

			/* MP Config */
			IC_X_CFG_SIZE = <22>;
			IC_Y_CFG_SIZE = <36>;
			IC_KEY_CFG_SIZE = <4>;
			X_Channel = <22>;
			Y_Channel = <36>;
			AIN_X = <0 1 2 3 4 5 6 7 8 9 10 11 12 13 14 15 16 17 18 19 20 21>;
			AIN_Y = <0 1 2 3 4 5 6 7 8 9 10 11 12 13 14 15 16 17 18 19 20 21 22 23 24 25 26 27 28 29 30 31 32 33 34 35>;
			AIN_KEY = <0 1 2 0xFF>;

			/* MP Criteria */
			PS_Config_Lmt_Short_Rawdata_P = <
				14008	14008	14008	14008	14008	14008	14008	14008	14008	14008	14008	14008	14008	14008	14008	14008	14008	14008	14008	14008	14008	14008
				14008	14008	14008	14008	14008	14008	14008	14008	14008	14008	14008	14008	14008	14008	14008	14008	14008	14008	14008	14008	14008	14008
				14008	14008	14008	14008	14008	14008	14008	14008	14008	14008	14008	14008	14008	14008	14008	14008	14008	14008	14008	14008	14008	14008
				14008	14008	14008	14008	14008	14008	14008	14008	14008	14008	14008	14008	14008	14008	14008	14008	14008	14008	14008	14008	14008	14008
				14008	14008	14008	14008	14008	14008	14008	14008	14008	14008	14008	14008	14008	14008	14008	14008	14008	14008	14008	14008	14008	14008
				14008	14008	14008	14008	14008	14008	14008	14008	14008	14008	14008	14008	14008	14008	14008	14008	14008	14008	14008	14008	14008	14008
				14008	14008	14008	14008	14008	14008	14008	14008	14008	14008	14008	14008	14008	14008	14008	14008	14008	14008	14008	14008	14008	14008
				14008	14008	14008	14008	14008	14008	14008	14008	14008	14008	14008	14008	14008	14008	14008	14008	14008	14008	14008	14008	14008	14008
				14008	14008	14008	14008	14008	14008	14008	14008	14008	14008	14008	14008	14008	14008	14008	14008	14008	14008	14008	14008	14008	14008
				14008	14008	14008	14008	14008	14008	14008	14008	14008	14008	14008	14008	14008	14008	14008	14008	14008	14008	14008	14008	14008	14008
				14008	14008	14008	14008	14008	14008	14008	14008	14008	14008	14008	14008	14008	14008	14008	14008	14008	14008	14008	14008	14008	14008
				14008	14008	14008	14008	14008	14008	14008	14008	14008	14008	14008	14008	14008	14008	14008	14008	14008	14008	14008	14008	14008	14008
				14008	14008	14008	14008	14008	14008	14008	14008	14008	14008	14008	14008	14008	14008	14008	14008	14008	14008	14008	14008	14008	14008
				14008	14008	14008	14008	14008	14008	14008	14008	14008	14008	14008	14008	14008	14008	14008	14008	14008	14008	14008	14008	14008	14008
				14008	14008	14008	14008	14008	14008	14008	14008	14008	14008	14008	14008	14008	14008	14008	14008	14008	14008	14008	14008	14008	14008
				14008	14008	14008	14008	14008	14008	14008	14008	14008	14008	14008	14008	14008	14008	14008	14008	14008	14008	14008	14008	14008	14008
				14008	14008	14008	14008	14008	14008	14008	14008	14008	14008	14008	14008	14008	14008	14008	14008	14008	14008	14008	14008	14008	14008
				14008	14008	14008	14008	14008	14008	14008	14008	14008	14008	14008	14008	14008	14008	14008	14008	14008	14008	14008	14008	14008	14008
				14008	14008	14008	14008	14008	14008	14008	14008	14008	14008	14008	14008	14008	14008	14008	14008	14008	14008	14008	14008	14008	14008
				14008	14008	14008	14008	14008	14008	14008	14008	14008	14008	14008	14008	14008	14008	14008	14008	14008	14008	14008	14008	14008	14008
				14008	14008	14008	14008	14008	14008	14008	14008	14008	14008	14008	14008	14008	14008	14008	14008	14008	14008	14008	14008	14008	14008
				14008	14008	14008	14008	14008	14008	14008	14008	14008	14008	14008	14008	14008	14008	14008	14008	14008	14008	14008	14008	14008	14008
				14008	14008	14008	14008	14008	14008	14008	14008	14008	14008	14008	14008	14008	14008	14008	14008	14008	14008	14008	14008	14008	14008
				14008	14008	14008	14008	14008	14008	14008	14008	14008	14008	14008	14008	14008	14008	14008	14008	14008	14008	14008	14008	14008	14008
				14008	14008	14008	14008	14008	14008	14008	14008	14008	14008	14008	14008	14008	14008	14008	14008	14008	14008	14008	14008	14008	14008
				14008	14008	14008	14008	14008	14008	14008	14008	14008	14008	14008	14008	14008	14008	14008	14008	14008	14008	14008	14008	14008	14008
				14008	14008	14008	14008	14008	14008	14008	14008	14008	14008	14008	14008	14008	14008	14008	14008	14008	14008	14008	14008	14008	14008
				14008	14008	14008	14008	14008	14008	14008	14008	14008	14008	14008	14008	14008	14008	14008	14008	14008	14008	14008	14008	14008	14008
				14008	14008	14008	14008	14008	14008	14008	14008	14008	14008	14008	14008	14008	14008	14008	14008	14008	14008	14008	14008	14008	14008
				14008	14008	14008	14008	14008	14008	14008	14008	14008	14008	14008	14008	14008	14008	14008	14008	14008	14008	14008	14008	14008	14008
				14008	14008	14008	14008	14008	14008	14008	14008	14008	14008	14008	14008	14008	14008	14008	14008	14008	14008	14008	14008	14008	14008
				14008	14008	14008	14008	14008	14008	14008	14008	14008	14008	14008	14008	14008	14008	14008	14008	14008	14008	14008	14008	14008	14008
				14008	14008	14008	14008	14008	14008	14008	14008	14008	14008	14008	14008	14008	14008	14008	14008	14008	14008	14008	14008	14008	14008
				14008	14008	14008	14008	14008	14008	14008	14008	14008	14008	14008	14008	14008	14008	14008	14008	14008	14008	14008	14008	14008	14008
				14008	14008	14008	14008	14008	14008	14008	14008	14008	14008	14008	14008	14008	14008	14008	14008	14008	14008	14008	14008	14008	14008
				14008	14008	14008	14008	14008	14008	14008	14008	14008	14008	14008	14008	14008	14008	14008	14008	14008	14008	14008	14008	14008	14008
				14008 14008 14008>;

			PS_Config_Lmt_Short_Rawdata_N = <
				10100	10100	10100	10100	10100	10100	10100	10100	10100	10100	10100	10100	10100	10100	10100	10100	10100	10100	10100	10100	10100	10100
				10100	10100	10100	10100	10100	10100	10100	10100	10100	10100	10100	10100	10100	10100	10100	10100	10100	10100	10100	10100	10100	10100
				10100	10100	10100	10100	10100	10100	10100	10100	10100	10100	10100	10100	10100	10100	10100	10100	10100	10100	10100	10100	10100	10100
				10100	10100	10100	10100	10100	10100	10100	10100	10100	10100	10100	10100	10100	10100	10100	10100	10100	10100	10100	10100	10100	10100
				10100	10100	10100	10100	10100	10100	10100	10100	10100	10100	10100	10100	10100	10100	10100	10100	10100	10100	10100	10100	10100	10100
				10100	10100	10100	10100	10100	10100	10100	10100	10100	10100	10100	10100	10100	10100	10100	10100	10100	10100	10100	10100	10100	10100
				10100	10100	10100	10100	10100	10100	10100	10100	10100	10100	10100	10100	10100	10100	10100	10100	10100	10100	10100	10100	10100	10100
				10100	10100	10100	10100	10100	10100	10100	10100	10100	10100	10100	10100	10100	10100	10100	10100	10100	10100	10100	10100	10100	10100
				10100	10100	10100	10100	10100	10100	10100	10100	10100	10100	10100	10100	10100	10100	10100	10100	10100	10100	10100	10100	10100	10100
				10100	10100	10100	10100	10100	10100	10100	10100	10100	10100	10100	10100	10100	10100	10100	10100	10100	10100	10100	10100	10100	10100
				10100	10100	10100	10100	10100	10100	10100	10100	10100	10100	10100	10100	10100	10100	10100	10100	10100	10100	10100	10100	10100	10100
				10100	10100	10100	10100	10100	10100	10100	10100	10100	10100	10100	10100	10100	10100	10100	10100	10100	10100	10100	10100	10100	10100
				10100	10100	10100	10100	10100	10100	10100	10100	10100	10100	10100	10100	10100	10100	10100	10100	10100	10100	10100	10100	10100	10100
				10100	10100	10100	10100	10100	10100	10100	10100	10100	10100	10100	10100	10100	10100	10100	10100	10100	10100	10100	10100	10100	10100
				10100	10100	10100	10100	10100	10100	10100	10100	10100	10100	10100	10100	10100	10100	10100	10100	10100	10100	10100	10100	10100	10100
				10100	10100	10100	10100	10100	10100	10100	10100	10100	10100	10100	10100	10100	10100	10100	10100	10100	10100	10100	10100	10100	10100
				10100	10100	10100	10100	10100	10100	10100	10100	10100	10100	10100	10100	10100	10100	10100	10100	10100	10100	10100	10100	10100	10100
				10100	10100	10100	10100	10100	10100	10100	10100	10100	10100	10100	10100	10100	10100	10100	10100	10100	10100	10100	10100	10100	10100
				10100	10100	10100	10100	10100	10100	10100	10100	10100	10100	10100	10100	10100	10100	10100	10100	10100	10100	10100	10100	10100	10100
				10100	10100	10100	10100	10100	10100	10100	10100	10100	10100	10100	10100	10100	10100	10100	10100	10100	10100	10100	10100	10100	10100
				10100	10100	10100	10100	10100	10100	10100	10100	10100	10100	10100	10100	10100	10100	10100	10100	10100	10100	10100	10100	10100	10100
				10100	10100	10100	10100	10100	10100	10100	10100	10100	10100	10100	10100	10100	10100	10100	10100	10100	10100	10100	10100	10100	10100
				10100	10100	10100	10100	10100	10100	10100	10100	10100	10100	10100	10100	10100	10100	10100	10100	10100	10100	10100	10100	10100	10100
				10100	10100	10100	10100	10100	10100	10100	10100	10100	10100	10100	10100	10100	10100	10100	10100	10100	10100	10100	10100	10100	10100
				10100	10100	10100	10100	10100	10100	10100	10100	10100	10100	10100	10100	10100	10100	10100	10100	10100	10100	10100	10100	10100	10100
				10100	10100	10100	10100	10100	10100	10100	10100	10100	10100	10100	10100	10100	10100	10100	10100	10100	10100	10100	10100	10100	10100
				10100	10100	10100	10100	10100	10100	10100	10100	10100	10100	10100	10100	10100	10100	10100	10100	10100	10100	10100	10100	10100	10100
				10100	10100	10100	10100	10100	10100	10100	10100	10100	10100	10100	10100	10100	10100	10100	10100	10100	10100	10100	10100	10100	10100
				10100	10100	10100	10100	10100	10100	10100	10100	10100	10100	10100	10100	10100	10100	10100	10100	10100	10100	10100	10100	10100	10100
				10100	10100	10100	10100	10100	10100	10100	10100	10100	10100	10100	10100	10100	10100	10100	10100	10100	10100	10100	10100	10100	10100
				10100	10100	10100	10100	10100	10100	10100	10100	10100	10100	10100	10100	10100	10100	10100	10100	10100	10100	10100	10100	10100	10100
				10100	10100	10100	10100	10100	10100	10100	10100	10100	10100	10100	10100	10100	10100	10100	10100	10100	10100	10100	10100	10100	10100
				10100	10100	10100	10100	10100	10100	10100	10100	10100	10100	10100	10100	10100	10100	10100	10100	10100	10100	10100	10100	10100	10100
				10100	10100	10100	10100	10100	10100	10100	10100	10100	10100	10100	10100	10100	10100	10100	10100	10100	10100	10100	10100	10100	10100
				10100	10100	10100	10100	10100	10100	10100	10100	10100	10100	10100	10100	10100	10100	10100	10100	10100	10100	10100	10100	10100	10100
				10100	10100	10100	10100	10100	10100	10100	10100	10100	10100	10100	10100	10100	10100	10100	10100	10100	10100	10100	10100	10100	10100
				10000 10000 10000>;

			PS_Config_Lmt_Open_Rawdata_P = <
				3900	3746	3801	3811	3870	3772	3644	3569	3504	3482	3557	3458	3534	3564	3580	3627	3671	3648	3664	3681	3686	3875
				3951	3758	3858	3899	3871	3765	3686	3578	3560	3557	3622	3471	3553	3609	3647	3665	3672	3697	3676	3727	3741	3864
				3947	3821	3885	3920	3938	3853	3755	3644	3606	3557	3595	3520	3620	3662	3667	3695	3765	3704	3735	3752	3755	3924
				4036	3786	3903	3975	3949	3830	3753	3667	3616	3616	3713	3538	3602	3668	3711	3759	3751	3759	3766	3787	3816	3938
				4029	3867	3791	3966	3972	3913	3836	3738	3669	3636	3696	3580	3548	3759	3763	3769	3804	3836	3804	3829	3860	3951
				4103	3900	3795	4015	4052	3914	3818	3765	3674	3681	3780	3622	3553	3766	3800	3830	3830	3828	3846	3833	3893	4021
				4085	3923	3858	4038	4070	3980	3905	3830	3737	3723	3759	3633	3606	3835	3858	3846	3860	3926	3853	3892	3923	3994
				4143	4010	3825	4054	4124	3991	3889	3825	3758	3732	3825	3699	3618	3814	3858	3891	3924	3906	3906	3926	3951	4063
				4138	4005	3900	3832	4112	4021	3976	3910	3829	3783	3823	3732	3655	3641	3945	3935	3924	3952	3990	3963	3993	4057
				4185	4081	3937	3839	4165	4098	3973	3892	3857	3787	3871	3770	3699	3643	3951	3976	3991	3982	3977	4005	3991	4106
				4217	4078	3958	3903	4185	4122	4043	3984	3924	3853	3930	3800	3714	3696	4024	4035	4007	4007	4071	4010	4035	4137
				4215	4130	4045	3868	4204	4178	4047	3963	3916	3868	3920	3826	3779	3707	4000	4033	4050	4073	4053	4063	4068	4150
				4257	4148	4042	3944	3878	4194	4070	4047	4000	3933	3989	3863	3811	3748	3752	4119	4096	4081	4098	4134	4084	4204
				4262	4192	4119	3982	3888	4245	4150	4050	3980	3962	3962	3861	3849	3788	3752	4126	4136	4144	4124	4122	4124	4175
				4309	4220	4117	4003	3949	4291	4176	4110	4071	4032	4054	3923	3874	3804	3804	4197	4190	4159	4154	4203	4110	4229
				4332	4222	4168	4089	3912	4302	4227	4115	4050	4026	4038	3956	3902	3867	3815	4175	4192	4204	4220	4178	4165	4263
				4329	4262	4187	4091	3989	3919	4246	4141	4130	4110	4103	3990	3945	3899	3860	3875	4277	4245	4221	4210	4166	4280
				4358	4257	4229	4166	4025	3924	4298	4221	4133	4089	4124	4022	3937	3938	3899	3872	4285	4283	4288	4231	4155	4343
				4420	4305	4273	4161	4042	3983	4337	4241	4197	4175	4213	4032	4003	3969	3912	3927	4357	4343	4301	4248	4234	4304
				4417	4322	4277	4213	4133	3947	4353	4292	4199	4157	4178	4089	4036	3986	3975	3937	4333	4341	4347	4308	4211	4389
				4493	4315	4339	4227	4136	4021	3944	4311	4224	4238	4284	4171	4060	4032	4004	3972	4004	4421	4371	4284	4243	4382
				4474	4339	4333	4271	4211	4057	3948	4362	4302	4236	4238	4147	4099	4025	4046	4015	3998	4427	4404	4348	4260	4343
				4553	4393	4396	4313	4199	4074	4004	4404	4319	4306	4348	4246	4112	4081	4078	4026	4047	4498	4445	4341	4277	4456
				4532	4386	4413	4316	4250	4168	3972	4413	4372	4302	4302	4222	4169	4119	4089	4088	4060	4469	4442	4383	4336	4413
				4588	4455	4473	4376	4263	4159	4043	3952	4392	4322	4399	4263	4250	4154	4136	4127	4103	4136	4504	4395	4308	4470
				4588	4430	4498	4372	4309	4239	4078	3958	4438	4403	4369	4290	4224	4192	4130	4161	4137	4130	4502	4427	4376	4474
				4635	4495	4550	4434	4351	4225	4088	4011	4481	4416	4439	4312	4320	4197	4180	4186	4155	4180	4551	4465	4371	4494
				4640	4467	4536	4446	4351	4276	4180	3977	4488	4466	4434	4376	4294	4250	4215	4201	4210	4186	4521	4460	4407	4567
				4704	4613	4693	4593	4486	4368	4256	4119	4021	4574	4521	4467	4420	4414	4330	4322	4313	4304	4353	4600	4493	4582
				4796	4603	4669	4621	4486	4413	4332	4154	4026	4619	4621	4525	4441	4385	4367	4315	4351	4343	4343	4603	4526	4682
				4805	4651	4736	4689	4540	4452	4320	4166	4080	4661	4610	4529	4467	4486	4375	4375	4382	4347	4396	4648	4564	4656
				4868	4654	4701	4673	4556	4456	4374	4257	4042	4669	4670	4577	4532	4452	4427	4410	4393	4404	4396	4620	4557	4724
				4857	4627	4761	4761	4627	4509	4375	4259	4109	4053	4676	4617	4530	4494	4509	4439	4441	4441	4437	4498	4620	4705
				4911	4715	4757	4736	4648	4504	4423	4332	4141	4032	4710	4640	4586	4512	4477	4472	4435	4473	4476	4483	4620	4746
				4941	4721	4798	4816	4714	4564	4459	4313	4148	4119	4753	4691	4592	4532	4572	4470	4488	4501	4477	4532	4663	4810
				4899	4739	4760	4739	4652	4529	4435	4362	4259	4110	4647	4595	4575	4554	4508	4501	4507	4494	4518	4521	4613	4764
				5120 5120 5120>;

			PS_Config_Lmt_Open_Rawdata_N = <
				1672	1606	1629	1633	1658	1616	1562	1529	1502	1492	1525	1482	1514	1528	1534	1555	1573	1564	1570	1577	1580	1661
				1693	1610	1654	1671	1659	1613	1580	1534	1526	1525	1552	1487	1523	1547	1563	1571	1574	1585	1576	1597	1603	1656
				1691	1637	1665	1680	1688	1651	1609	1562	1546	1525	1541	1508	1552	1570	1571	1583	1613	1588	1601	1608	1609	1682
				1730	1622	1673	1703	1693	1642	1609	1571	1550	1550	1591	1516	1544	1572	1591	1611	1607	1611	1614	1623	1636	1688
				1727	1657	1625	1700	1702	1677	1644	1602	1573	1558	1584	1534	1520	1611	1613	1615	1630	1644	1630	1641	1654	1693
				1759	1672	1627	1721	1736	1678	1636	1613	1574	1577	1620	1552	1523	1614	1628	1642	1642	1640	1648	1643	1669	1723
				1751	1681	1654	1730	1744	1706	1673	1642	1601	1595	1611	1557	1546	1643	1654	1648	1654	1682	1651	1668	1681	1712
				1775	1718	1639	1738	1768	1711	1667	1639	1610	1600	1639	1585	1550	1634	1654	1667	1682	1674	1674	1682	1693	1741
				1774	1717	1672	1642	1762	1723	1704	1676	1641	1621	1639	1600	1567	1561	1691	1687	1682	1694	1710	1699	1711	1739
				1793	1749	1687	1645	1785	1756	1703	1668	1653	1623	1659	1616	1585	1561	1693	1704	1711	1706	1705	1717	1711	1760
				1807	1748	1696	1673	1793	1766	1733	1708	1682	1651	1684	1628	1592	1584	1724	1729	1717	1717	1745	1718	1729	1773
				1807	1770	1733	1658	1802	1790	1735	1699	1678	1658	1680	1640	1619	1589	1714	1729	1736	1745	1737	1741	1744	1778
				1825	1778	1732	1690	1662	1798	1744	1735	1714	1685	1709	1655	1633	1606	1608	1765	1756	1749	1756	1772	1750	1802
				1826	1796	1765	1706	1666	1819	1778	1736	1706	1698	1698	1655	1649	1624	1608	1768	1772	1776	1768	1766	1768	1789
				1847	1808	1765	1715	1693	1839	1790	1762	1745	1728	1738	1681	1660	1630	1630	1799	1796	1783	1780	1801	1762	1813
				1856	1810	1786	1753	1676	1844	1811	1763	1736	1726	1730	1696	1672	1657	1635	1789	1796	1802	1808	1790	1785	1827
				1855	1826	1795	1753	1709	1679	1820	1775	1770	1762	1759	1710	1691	1671	1654	1661	1833	1819	1809	1804	1786	1834
				1868	1825	1813	1786	1725	1682	1842	1809	1771	1753	1768	1724	1687	1688	1671	1660	1837	1835	1838	1813	1781	1861
				1894	1845	1831	1783	1732	1707	1859	1817	1799	1789	1805	1728	1715	1701	1676	1683	1867	1861	1843	1820	1814	1844
				1893	1852	1833	1805	1771	1691	1865	1840	1799	1781	1790	1753	1730	1708	1703	1687	1857	1861	1863	1846	1805	1881
				1925	1849	1859	1811	1772	1723	1690	1847	1810	1816	1836	1787	1740	1728	1716	1702	1716	1895	1873	1836	1819	1878
				1918	1859	1857	1831	1805	1739	1692	1870	1844	1816	1816	1777	1757	1725	1734	1721	1714	1897	1888	1864	1826	1861
				1951	1883	1884	1849	1799	1746	1716	1888	1851	1846	1864	1820	1762	1749	1748	1726	1735	1928	1905	1861	1833	1910
				1942	1880	1891	1850	1822	1786	1702	1891	1874	1844	1844	1810	1787	1765	1753	1752	1740	1915	1904	1879	1858	1891
				1966	1909	1917	1876	1827	1783	1733	1694	1882	1852	1885	1827	1822	1780	1772	1769	1759	1772	1930	1883	1846	1916
				1966	1898	1928	1874	1847	1817	1748	1696	1902	1887	1873	1838	1810	1796	1770	1783	1773	1770	1930	1897	1876	1918
				1987	1927	1950	1900	1865	1811	1752	1719	1921	1892	1903	1848	1852	1799	1792	1794	1781	1792	1951	1913	1873	1926
				1988	1915	1944	1906	1865	1832	1792	1705	1924	1914	1900	1876	1840	1822	1807	1801	1804	1794	1937	1912	1889	1957
				2016	1977	2011	1969	1922	1872	1824	1765	1723	1960	1937	1915	1894	1892	1856	1852	1849	1844	1865	1972	1925	1964
				2056	1973	2001	1981	1922	1891	1856	1780	1726	1979	1981	1939	1903	1879	1871	1849	1865	1861	1861	1973	1940	2006
				2059	1993	2030	2009	1946	1908	1852	1786	1748	1997	1976	1941	1915	1922	1875	1875	1878	1863	1884	1992	1956	1996
				2086	1994	2015	2003	1952	1910	1874	1825	1732	2001	2002	1961	1942	1908	1897	1890	1883	1888	1884	1980	1953	2024
				2081	1983	2041	2041	1983	1933	1875	1825	1761	1737	2004	1979	1942	1926	1933	1903	1903	1903	1901	1928	1980	2017
				2105	2021	2039	2030	1992	1930	1895	1856	1775	1728	2018	1988	1966	1934	1919	1916	1901	1917	1918	1921	1980	2034
				2117	2023	2056	2064	2020	1956	1911	1849	1778	1765	2037	2011	1968	1942	1960	1916	1924	1929	1919	1942	1999	2062
				2099	2031	2040	2031	1994	1941	1901	1870	1825	1762	1991	1969	1961	1952	1932	1929	1931	1926	1936	1937	1977	2042
				(-511) (-511) (-511)>;

			PS_Config_Lmt_FW_Rawdata_P = <
				1121	1128	1119	1131	1128	1116	1114	1117	1113	1126	1117	1134	1123	1130	1121	1131	1126	1123	1110	1117	1119	1123
				1120	1127	1117	1116	1130	1114	1120	1119	1120	1128	1119	1123	1123	1128	1130	1117	1128	1128	1124	1126	1112	1117
				1116	1120	1120	1121	1120	1117	1126	1124	1113	1127	1121	1116	1126	1120	1119	1124	1116	1120	1116	1128	1119	1117
				1114	1112	1126	1117	1117	1121	1113	1116	1121	1114	1119	1117	1120	1127	1127	1117	1121	1120	1119	1117	1113	1119
				1123	1123	1116	1123	1130	1113	1119	1130	1126	1128	1119	1116	1130	1116	1128	1128	1124	1116	1121	1119	1120	1126
				1117	1116	1120	1131	1124	1121	1121	1119	1121	1126	1112	1131	1117	1107	1109	1123	1121	1124	1120	1116	1117	1110
				1117	1114	1120	1114	1116	1123	1124	1112	1113	1130	1117	1114	1123	1120	1123	1120	1123	1120	1120	1127	1114	1113
				1103	1110	1126	1117	1112	1114	1112	1127	1121	1116	1117	1121	1119	1119	1123	1117	1126	1120	1117	1117	1128	1120
				1128	1121	1128	1123	1126	1119	1124	1123	1119	1120	1124	1124	1123	1120	1130	1105	1112	1109	1119	1119	1126	1120
				1128	1120	1121	1119	1120	1121	1126	1119	1128	1116	1126	1110	1131	1121	1131	1130	1114	1114	1119	1128	1127	1119
				1110	1130	1113	1126	1126	1121	1120	1117	1119	1131	1137	1120	1120	1126	1119	1124	1116	1123	1113	1123	1123	1127
				1103	1121	1109	1124	1120	1124	1116	1123	1126	1127	1121	1123	1130	1113	1124	1114	1124	1123	1126	1124	1119	1121
				1123	1121	1123	1127	1128	1128	1114	1110	1123	1117	1123	1124	1112	1126	1126	1113	1120	1116	1114	1123	1127	1112
				1123	1123	1123	1119	1117	1120	1128	1116	1112	1121	1112	1126	1113	1124	1127	1130	1120	1109	1121	1119	1126	1117
				1121	1116	1128	1117	1120	1124	1121	1116	1117	1117	1121	1113	1120	1128	1120	1120	1116	1112	1121	1120	1120	1124
				1112	1116	1112	1113	1123	1123	1127	1110	1127	1131	1119	1126	1121	1116	1117	1120	1128	1127	1120	1119	1121	1119
				1128	1127	1120	1124	1135	1131	1119	1117	1117	1116	1117	1117	1123	1123	1113	1117	1120	1121	1113	1109	1123	1123
				1124	1117	1131	1121	1120	1120	1119	1128	1120	1121	1116	1113	1119	1123	1124	1131	1124	1117	1106	1123	1123	1121
				1123	1124	1120	1114	1127	1123	1123	1127	1121	1126	1119	1127	1112	1124	1120	1117	1124	1114	1119	1120	1117	1124
				1123	1126	1123	1124	1126	1130	1131	1126	1113	1126	1128	1121	1131	1126	1127	1121	1121	1133	1128	1124	1119	1124
				1116	1117	1113	1121	1121	1113	1123	1114	1114	1117	1130	1131	1119	1126	1117	1124	1113	1119	1124	1112	1116	1121
				1126	1114	1128	1110	1121	1128	1124	1124	1127	1120	1121	1123	1120	1114	1123	1120	1124	1110	1117	1110	1119	1127
				1124	1124	1110	1124	1117	1120	1123	1123	1120	1123	1114	1124	1112	1117	1120	1119	1114	1113	1121	1123	1120	1123
				1126	1117	1120	1120	1123	1117	1109	1117	1110	1134	1117	1113	1121	1113	1123	1123	1110	1121	1116	1127	1120	1124
				1123	1114	1121	1123	1117	1117	1121	1126	1126	1119	1130	1126	1121	1128	1123	1128	1112	1130	1128	1128	1116	1121
				1127	1120	1120	1114	1131	1121	1121	1128	1117	1112	1120	1116	1120	1120	1124	1126	1123	1120	1119	1119	1123	1127
				1119	1117	1121	1133	1119	1119	1126	1114	1124	1123	1120	1128	1124	1123	1130	1123	1112	1124	1126	1119	1126	1119
				1114	1121	1114	1124	1112	1123	1123	1135	1120	1130	1124	1130	1124	1110	1131	1110	1117	1138	1121	1117	1127	1124
				1124	1130	1113	1127	1113	1126	1124	1120	1117	1123	1112	1133	1124	1121	1123	1130	1119	1123	1119	1112	1123	1117
				1126	1123	1121	1123	1131	1120	1127	1117	1114	1121	1116	1117	1121	1124	1127	1117	1119	1123	1116	1121	1114	1126
				1116	1124	1119	1114	1119	1121	1120	1116	1121	1116	1124	1119	1112	1123	1128	1113	1120	1127	1126	1127	1116	1116
				1110	1109	1112	1128	1114	1117	1123	1119	1109	1119	1124	1109	1117	1120	1124	1124	1126	1126	1106	1130	1119	1128
				1124	1113	1121	1112	1116	1112	1126	1117	1116	1121	1112	1126	1124	1126	1123	1130	1124	1120	1124	1127	1120	1123
				1119	1114	1124	1126	1130	1134	1117	1127	1114	1120	1124	1123	1119	1123	1127	1120	1131	1119	1120	1119	1112	1121
				1126	1113	1120	1121	1128	1120	1116	1124	1135	1110	1119	1130	1127	1127	1128	1120	1124	1113	1110	1128	1114	1123
				1121	1121	1123	1124	1114	1120	1124	1123	1119	1126	1117	1112	1120	1116	1127	1119	1128	1112	1117	1121	1119	1121
				3840 3840 3840>;

			PS_Config_Lmt_FW_Rawdata_N = <
				481	484	479	485	484	478	478	479	477	482	479	486	481	484	481	485	482	481	476	479	479	481
				480	483	479	478	484	478	480	479	480	484	479	481	481	484	484	479	484	484	482	482	476	479
				478	480	480	481	480	479	482	482	477	483	481	478	482	480	479	482	478	480	478	484	479	479
				478	476	482	479	479	481	477	478	481	478	479	479	480	483	483	479	481	480	479	479	477	479
				481	481	478	481	484	477	479	484	482	484	479	478	484	478	484	484	482	478	481	479	480	482
				479	478	480	485	482	481	481	479	481	482	476	485	479	475	475	481	481	482	480	478	479	476
				479	478	480	478	478	481	482	476	477	484	479	478	481	480	481	480	481	480	480	483	478	477
				473	476	482	479	476	478	476	483	481	478	479	481	479	479	481	479	482	480	479	479	484	480
				484	481	484	481	482	479	482	481	479	480	482	482	481	480	484	473	476	475	479	479	482	480
				484	480	481	479	480	481	482	479	484	478	482	476	485	481	485	484	478	478	479	484	483	479
				476	484	477	482	482	481	480	479	479	485	487	480	480	482	479	482	478	481	477	481	481	483
				473	481	475	482	480	482	478	481	482	483	481	481	484	477	482	478	482	481	482	482	479	481
				481	481	481	483	484	484	478	476	481	479	481	482	476	482	482	477	480	478	478	481	483	476
				481	481	481	479	479	480	484	478	476	481	476	482	477	482	483	484	480	475	481	479	482	479
				481	478	484	479	480	482	481	478	479	479	481	477	480	484	480	480	478	476	481	480	480	482
				476	478	476	477	481	481	483	476	483	485	479	482	481	478	479	480	484	483	480	479	481	479
				484	483	480	482	487	485	479	479	479	478	479	479	481	481	477	479	480	481	477	475	481	481
				482	479	485	481	480	480	479	484	480	481	478	477	479	481	482	485	482	479	474	481	481	481
				481	482	480	478	483	481	481	483	481	482	479	483	476	482	480	479	482	478	479	480	479	482
				481	482	481	482	482	484	485	482	477	482	484	481	485	482	483	481	481	485	484	482	479	482
				478	479	477	481	481	477	481	478	478	479	484	485	479	482	479	482	477	479	482	476	478	481
				482	478	484	476	481	484	482	482	483	480	481	481	480	478	481	480	482	476	479	476	479	483
				482	482	476	482	479	480	481	481	480	481	478	482	476	479	480	479	478	477	481	481	480	481
				482	479	480	480	481	479	475	479	476	486	479	477	481	477	481	481	476	481	478	483	480	482
				481	478	481	481	479	479	481	482	482	479	484	482	481	484	481	484	476	484	484	484	478	481
				483	480	480	478	485	481	481	484	479	476	480	478	480	480	482	482	481	480	479	479	481	483
				479	479	481	485	479	479	482	478	482	481	480	484	482	481	484	481	476	482	482	479	482	479
				478	481	478	482	476	481	481	487	480	484	482	484	482	476	485	476	479	488	481	479	483	482
				482	484	477	483	477	482	482	480	479	481	476	485	482	481	481	484	479	481	479	476	481	479
				482	481	481	481	485	480	483	479	478	481	478	479	481	482	483	479	479	481	478	481	478	482
				478	482	479	478	479	481	480	478	481	478	482	479	476	481	484	477	480	483	482	483	478	478
				476	475	476	484	478	479	481	479	475	479	482	475	479	480	482	482	482	482	474	484	479	484
				482	477	481	476	478	476	482	479	478	481	476	482	482	482	481	484	482	480	482	483	480	481
				479	478	482	482	484	486	479	483	478	480	482	481	479	481	483	480	485	479	480	479	476	481
				482	477	480	481	484	480	478	482	487	476	479	484	483	483	484	480	482	477	476	484	478	481
				481	481	481	482	478	480	482	481	479	482	479	476	480	478	483	479	484	476	479	481	479	481
				240 240 240>;

			PS_Config_Lmt_FW_CC_P = <
				90	80	112	112	113	113	112	113	112	110	90	80	113	112	112	112	113	112	112	112	90	80
				92	81	113	115	112	112	113	112	113	113	92	81	113	113	113	113	112	113	112	112	92	80
				91	81	112	112	113	113	113	113	112	110	91	81	115	112	112	112	113	112	112	112	91	80
				104	81	113	115	115	113	113	113	112	115	105	81	115	113	115	115	113	115	113	113	105	80
				110	91	81	113	113	113	115	113	113	112	112	91	81	115	113	113	113	115	112	113	113	90
				113	94	83	115	116	113	113	115	113	115	115	94	81	115	115	115	113	113	115	113	113	92
				112	92	83	113	113	115	115	115	113	113	112	92	81	116	113	112	113	115	112	113	113	91
				115	105	81	115	116	116	113	113	115	113	115	105	81	115	115	116	116	115	115	115	113	104
				112	112	92	81	113	113	115	115	113	115	112	113	91	81	115	115	113	113	115	113	113	112
				113	115	94	83	116	116	113	113	115	113	115	113	94	83	115	115	115	115	115	115	113	113
				113	112	92	83	115	113	115	115	115	113	113	113	92	81	116	113	113	113	115	112	113	112
				113	116	106	81	115	116	115	115	113	115	113	115	105	83	116	115	116	116	115	115	115	113
				113	113	112	92	81	115	113	115	115	115	115	115	113	91	81	116	115	113	115	115	113	113
				113	115	116	94	83	116	116	115	113	115	113	113	113	94	83	115	115	116	115	115	115	113
				113	113	112	92	83	116	115	115	115	115	115	113	113	92	81	116	115	113	113	115	112	112
				115	113	116	106	81	116	116	116	115	113	115	115	115	105	83	116	115	116	116	115	115	115
				113	115	113	113	92	81	115	113	115	115	115	113	115	113	91	81	116	115	115	113	115	112
				113	113	116	116	95	83	116	117	115	113	115	115	115	113	94	83	116	115	116	115	113	115
				115	115	115	113	92	83	116	115	115	115	115	113	113	113	92	83	117	115	113	113	115	112
				113	115	113	116	106	81	116	116	116	115	113	116	116	115	105	83	116	115	116	116	115	115
				115	115	116	113	113	92	83	115	113	115	115	116	113	115	113	92	83	116	115	113	113	115
				113	115	115	116	116	95	83	116	117	115	115	115	116	115	115	95	83	116	115	116	115	113
				115	116	116	115	113	94	84	116	115	116	116	116	113	115	115	92	83	117	115	113	113	115
				113	115	116	115	116	106	83	117	117	116	115	115	116	116	115	106	84	117	116	116	116	113
				115	116	116	116	115	113	94	83	115	115	116	115	116	115	115	115	92	83	116	115	113	113
				115	115	116	116	116	117	95	84	117	117	116	116	116	116	116	116	95	84	116	116	116	115
				115	116	116	116	116	115	94	84	117	116	117	115	116	115	115	115	94	84	117	115	113	113
				116	115	116	116	116	117	108	83	117	117	117	117	116	117	117	116	108	84	117	116	117	116
				113	116	117	116	117	115	115	94	84	116	116	116	116	117	116	116	116	94	84	116	115	115
				117	116	116	117	116	117	117	97	84	117	119	117	117	116	117	116	116	97	84	116	116	116
				115	116	117	117	117	116	115	95	86	117	117	116	116	117	115	116	116	95	84	117	115	113
				117	117	116	116	117	116	117	108	84	119	119	119	117	116	117	117	116	108	84	117	116	117
				115	115	116	117	116	117	116	115	94	84	117	117	116	116	117	116	116	116	94	84	116	115
				116	117	116	116	117	116	117	117	97	84	119	117	117	116	116	117	116	116	97	84	116	115
				116	115	116	116	117	116	116	115	94	84	117	116	115	116	117	115	115	115	94	84	117	115
				116	116	116	116	115	116	116	117	108	84	117	116	117	117	116	117	117	116	108	84	116	115
				314 314 314>;

			PS_Config_Lmt_FW_CC_N = <
				40	36	50	50	51	51	50	51	50	50	40	36	51	50	50	50	51	50	50	50	40	36
				42	37	51	51	50	50	51	50	51	51	42	37	51	51	51	51	50	51	50	50	42	36
				41	37	50	50	51	51	51	51	50	50	41	37	51	50	50	50	51	50	50	50	41	36
				46	37	51	51	51	51	51	51	50	51	47	37	51	51	51	51	51	51	51	51	47	36
				50	41	37	51	51	51	51	51	51	50	50	41	37	51	51	51	51	51	50	51	51	40
				51	42	37	51	52	51	51	51	51	51	51	42	37	51	51	51	51	51	51	51	51	42
				50	42	37	51	51	51	51	51	51	51	50	42	37	52	51	50	51	51	50	51	51	41
				51	47	37	51	52	52	51	51	51	51	51	47	37	51	51	52	52	51	51	51	51	46
				50	50	42	37	51	51	51	51	51	51	50	51	41	37	51	51	51	51	51	51	51	50
				51	51	42	37	52	52	51	51	51	51	51	51	42	37	51	51	51	51	51	51	51	51
				51	50	42	37	51	51	51	51	51	51	51	51	42	37	52	51	51	51	51	50	51	50
				51	52	48	37	51	52	51	51	51	51	51	51	47	37	52	51	52	52	51	51	51	51
				51	51	50	42	37	51	51	51	51	51	51	51	51	41	37	52	51	51	51	51	51	51
				51	51	52	42	37	52	52	51	51	51	51	51	51	42	37	51	51	52	51	51	51	51
				51	51	50	42	37	52	51	51	51	51	51	51	51	42	37	52	51	51	51	51	50	50
				51	51	52	48	37	52	52	52	51	51	51	51	51	47	37	52	51	52	52	51	51	51
				51	51	51	51	42	37	51	51	51	51	51	51	51	51	41	37	52	51	51	51	51	50
				51	51	52	52	43	37	52	53	51	51	51	51	51	51	42	37	52	51	52	51	51	51
				51	51	51	51	42	37	52	51	51	51	51	51	51	51	42	37	53	51	51	51	51	50
				51	51	51	52	48	37	52	52	52	51	51	52	52	51	47	37	52	51	52	52	51	51
				51	51	52	51	51	42	37	51	51	51	51	52	51	51	51	42	37	52	51	51	51	51
				51	51	51	52	52	43	37	52	53	51	51	51	52	51	51	43	37	52	51	52	51	51
				51	52	52	51	51	42	38	52	51	52	52	52	51	51	51	42	37	53	51	51	51	51
				51	51	52	51	52	48	37	53	53	52	51	51	52	52	51	48	38	53	52	52	52	51
				51	52	52	52	51	51	42	37	51	51	52	51	52	51	51	51	42	37	52	51	51	51
				51	51	52	52	52	53	43	38	53	53	52	52	52	52	52	52	43	38	52	52	52	51
				51	52	52	52	52	51	42	38	53	52	53	51	52	51	51	51	42	38	53	51	51	51
				52	51	52	52	52	53	48	37	53	53	53	53	52	53	53	52	48	38	53	52	53	52
				51	52	53	52	53	51	51	42	38	52	52	52	52	53	52	52	52	42	38	52	51	51
				53	52	52	53	52	53	53	43	38	53	53	53	53	52	53	52	52	43	38	52	52	52
				51	52	53	53	53	52	51	43	38	53	53	52	52	53	51	52	52	43	38	53	51	51
				53	53	52	52	53	52	53	48	38	53	53	53	53	52	53	53	52	48	38	53	52	53
				51	51	52	53	52	53	52	51	42	38	53	53	52	52	53	52	52	52	42	38	52	51
				52	53	52	52	53	52	53	53	43	38	53	53	53	52	52	53	52	52	43	38	52	51
				52	51	52	52	53	52	52	51	42	38	53	52	51	52	53	51	51	51	42	38	53	51
				52	52	52	52	51	52	52	53	48	38	53	52	53	53	52	53	53	52	48	38	52	51
				0 0 0>;

			PS_Config_Lmt_FW_Diff_P = <
				50	50	50	50	50	50	50	50	50	50	50	50	50	50	50	50	50	50	50	50	50	50
				50	50	50	50	50	50	50	50	50	50	50	50	50	50	50	50	50	50	50	50	50	50
				50	50	50	50	50	50	50	50	50	50	50	50	50	50	50	50	50	50	50	50	50	50
				50	50	50	50	50	50	50	50	50	50	50	50	50	50	50	50	50	50	50	50	50	50
				50	50	50	50	50	50	50	50	50	50	50	50	50	50	50	50	50	50	50	50	50	50
				50	50	50	50	50	50	50	50	50	50	50	50	50	50	50	50	50	50	50	50	50	50
				50	50	50	50	50	50	50	50	50	50	50	50	50	50	50	50	50	50	50	50	50	50
				50	50	50	50	50	50	50	50	50	50	50	50	50	50	50	50	50	50	50	50	50	50
				50	50	50	50	50	50	50	50	50	50	50	50	50	50	50	50	50	50	50	50	50	50
				50	50	50	50	50	50	50	50	50	50	50	50	50	50	50	50	50	50	50	50	50	50
				50	50	50	50	50	50	50	50	50	50	50	50	50	50	50	50	50	50	50	50	50	50
				50	50	50	50	50	50	50	50	50	50	50	50	50	50	50	50	50	50	50	50	50	50
				50	50	50	50	50	50	50	50	50	50	50	50	50	50	50	50	50	50	50	50	50	50
				50	50	50	50	50	50	50	50	50	50	50	50	50	50	50	50	50	50	50	50	50	50
				50	50	50	50	50	50	50	50	50	50	50	50	50	50	50	50	50	50	50	50	50	50
				50	50	50	50	50	50	50	50	50	50	50	50	50	50	50	50	50	50	50	50	50	50
				50	50	50	50	50	50	50	50	50	50	50	50	50	50	50	50	50	50	50	50	50	50
				50	50	50	50	50	50	50	50	50	50	50	50	50	50	50	50	50	50	50	50	50	50
				50	50	50	50	50	50	50	50	50	50	50	50	50	50	50	50	50	50	50	50	50	50
				50	50	50	50	50	50	50	50	50	50	50	50	50	50	50	50	50	50	50	50	50	50
				50	50	50	50	50	50	50	50	50	50	50	50	50	50	50	50	50	50	50	50	50	50
				50	50	50	50	50	50	50	50	50	50	50	50	50	50	50	50	50	50	50	50	50	50
				50	50	50	50	50	50	50	50	50	50	50	50	50	50	50	50	50	50	50	50	50	50
				50	50	50	50	50	50	50	50	50	50	50	50	50	50	50	50	50	50	50	50	50	50
				50	50	50	50	50	50	50	50	50	50	50	50	50	50	50	50	50	50	50	50	50	50
				50	50	50	50	50	50	50	50	50	50	50	50	50	50	50	50	50	50	50	50	50	50
				50	50	50	50	50	50	50	50	50	50	50	50	50	50	50	50	50	50	50	50	50	50
				50	50	50	50	50	50	50	50	50	50	50	50	50	50	50	50	50	50	50	50	50	50
				50	50	50	50	50	50	50	50	50	50	50	50	50	50	50	50	50	50	50	50	50	50
				50	50	50	50	50	50	50	50	50	50	50	50	50	50	50	50	50	50	50	50	50	50
				50	50	50	50	50	50	50	50	50	50	50	50	50	50	50	50	50	50	50	50	50	50
				50	50	50	50	50	50	50	50	50	50	50	50	50	50	50	50	50	50	50	50	50	50
				50	50	50	50	50	50	50	50	50	50	50	50	50	50	50	50	50	50	50	50	50	50
				50	50	50	50	50	50	50	50	50	50	50	50	50	50	50	50	50	50	50	50	50	50
				50	50	50	50	50	50	50	50	50	50	50	50	50	50	50	50	50	50	50	50	50	50
				50	50	50	50	50	50	50	50	50	50	50	50	50	50	50	50	50	50	50	50	50	50
				75 75 75>;

			PS_Config_Lmt_FW_Diff_N = <
				(-50)	(-50)	(-50)	(-50)	(-50)	(-50)	(-50)	(-50)	(-50)	(-50)	(-50)	(-50)	(-50)	(-50)	(-50)	(-50)	(-50)	(-50)	(-50)	(-50)	(-50)	(-50)
				(-50)	(-50)	(-50)	(-50)	(-50)	(-50)	(-50)	(-50)	(-50)	(-50)	(-50)	(-50)	(-50)	(-50)	(-50)	(-50)	(-50)	(-50)	(-50)	(-50)	(-50)	(-50)
				(-50)	(-50)	(-50)	(-50)	(-50)	(-50)	(-50)	(-50)	(-50)	(-50)	(-50)	(-50)	(-50)	(-50)	(-50)	(-50)	(-50)	(-50)	(-50)	(-50)	(-50)	(-50)
				(-50)	(-50)	(-50)	(-50)	(-50)	(-50)	(-50)	(-50)	(-50)	(-50)	(-50)	(-50)	(-50)	(-50)	(-50)	(-50)	(-50)	(-50)	(-50)	(-50)	(-50)	(-50)
				(-50)	(-50)	(-50)	(-50)	(-50)	(-50)	(-50)	(-50)	(-50)	(-50)	(-50)	(-50)	(-50)	(-50)	(-50)	(-50)	(-50)	(-50)	(-50)	(-50)	(-50)	(-50)
				(-50)	(-50)	(-50)	(-50)	(-50)	(-50)	(-50)	(-50)	(-50)	(-50)	(-50)	(-50)	(-50)	(-50)	(-50)	(-50)	(-50)	(-50)	(-50)	(-50)	(-50)	(-50)
				(-50)	(-50)	(-50)	(-50)	(-50)	(-50)	(-50)	(-50)	(-50)	(-50)	(-50)	(-50)	(-50)	(-50)	(-50)	(-50)	(-50)	(-50)	(-50)	(-50)	(-50)	(-50)
				(-50)	(-50)	(-50)	(-50)	(-50)	(-50)	(-50)	(-50)	(-50)	(-50)	(-50)	(-50)	(-50)	(-50)	(-50)	(-50)	(-50)	(-50)	(-50)	(-50)	(-50)	(-50)
				(-50)	(-50)	(-50)	(-50)	(-50)	(-50)	(-50)	(-50)	(-50)	(-50)	(-50)	(-50)	(-50)	(-50)	(-50)	(-50)	(-50)	(-50)	(-50)	(-50)	(-50)	(-50)
				(-50)	(-50)	(-50)	(-50)	(-50)	(-50)	(-50)	(-50)	(-50)	(-50)	(-50)	(-50)	(-50)	(-50)	(-50)	(-50)	(-50)	(-50)	(-50)	(-50)	(-50)	(-50)
				(-50)	(-50)	(-50)	(-50)	(-50)	(-50)	(-50)	(-50)	(-50)	(-50)	(-50)	(-50)	(-50)	(-50)	(-50)	(-50)	(-50)	(-50)	(-50)	(-50)	(-50)	(-50)
				(-50)	(-50)	(-50)	(-50)	(-50)	(-50)	(-50)	(-50)	(-50)	(-50)	(-50)	(-50)	(-50)	(-50)	(-50)	(-50)	(-50)	(-50)	(-50)	(-50)	(-50)	(-50)
				(-50)	(-50)	(-50)	(-50)	(-50)	(-50)	(-50)	(-50)	(-50)	(-50)	(-50)	(-50)	(-50)	(-50)	(-50)	(-50)	(-50)	(-50)	(-50)	(-50)	(-50)	(-50)
				(-50)	(-50)	(-50)	(-50)	(-50)	(-50)	(-50)	(-50)	(-50)	(-50)	(-50)	(-50)	(-50)	(-50)	(-50)	(-50)	(-50)	(-50)	(-50)	(-50)	(-50)	(-50)
				(-50)	(-50)	(-50)	(-50)	(-50)	(-50)	(-50)	(-50)	(-50)	(-50)	(-50)	(-50)	(-50)	(-50)	(-50)	(-50)	(-50)	(-50)	(-50)	(-50)	(-50)	(-50)
				(-50)	(-50)	(-50)	(-50)	(-50)	(-50)	(-50)	(-50)	(-50)	(-50)	(-50)	(-50)	(-50)	(-50)	(-50)	(-50)	(-50)	(-50)	(-50)	(-50)	(-50)	(-50)
				(-50)	(-50)	(-50)	(-50)	(-50)	(-50)	(-50)	(-50)	(-50)	(-50)	(-50)	(-50)	(-50)	(-50)	(-50)	(-50)	(-50)	(-50)	(-50)	(-50)	(-50)	(-50)
				(-50)	(-50)	(-50)	(-50)	(-50)	(-50)	(-50)	(-50)	(-50)	(-50)	(-50)	(-50)	(-50)	(-50)	(-50)	(-50)	(-50)	(-50)	(-50)	(-50)	(-50)	(-50)
				(-50)	(-50)	(-50)	(-50)	(-50)	(-50)	(-50)	(-50)	(-50)	(-50)	(-50)	(-50)	(-50)	(-50)	(-50)	(-50)	(-50)	(-50)	(-50)	(-50)	(-50)	(-50)
				(-50)	(-50)	(-50)	(-50)	(-50)	(-50)	(-50)	(-50)	(-50)	(-50)	(-50)	(-50)	(-50)	(-50)	(-50)	(-50)	(-50)	(-50)	(-50)	(-50)	(-50)	(-50)
				(-50)	(-50)	(-50)	(-50)	(-50)	(-50)	(-50)	(-50)	(-50)	(-50)	(-50)	(-50)	(-50)	(-50)	(-50)	(-50)	(-50)	(-50)	(-50)	(-50)	(-50)	(-50)
				(-50)	(-50)	(-50)	(-50)	(-50)	(-50)	(-50)	(-50)	(-50)	(-50)	(-50)	(-50)	(-50)	(-50)	(-50)	(-50)	(-50)	(-50)	(-50)	(-50)	(-50)	(-50)
				(-50)	(-50)	(-50)	(-50)	(-50)	(-50)	(-50)	(-50)	(-50)	(-50)	(-50)	(-50)	(-50)	(-50)	(-50)	(-50)	(-50)	(-50)	(-50)	(-50)	(-50)	(-50)
				(-50)	(-50)	(-50)	(-50)	(-50)	(-50)	(-50)	(-50)	(-50)	(-50)	(-50)	(-50)	(-50)	(-50)	(-50)	(-50)	(-50)	(-50)	(-50)	(-50)	(-50)	(-50)
				(-50)	(-50)	(-50)	(-50)	(-50)	(-50)	(-50)	(-50)	(-50)	(-50)	(-50)	(-50)	(-50)	(-50)	(-50)	(-50)	(-50)	(-50)	(-50)	(-50)	(-50)	(-50)
				(-50)	(-50)	(-50)	(-50)	(-50)	(-50)	(-50)	(-50)	(-50)	(-50)	(-50)	(-50)	(-50)	(-50)	(-50)	(-50)	(-50)	(-50)	(-50)	(-50)	(-50)	(-50)
				(-50)	(-50)	(-50)	(-50)	(-50)	(-50)	(-50)	(-50)	(-50)	(-50)	(-50)	(-50)	(-50)	(-50)	(-50)	(-50)	(-50)	(-50)	(-50)	(-50)	(-50)	(-50)
				(-50)	(-50)	(-50)	(-50)	(-50)	(-50)	(-50)	(-50)	(-50)	(-50)	(-50)	(-50)	(-50)	(-50)	(-50)	(-50)	(-50)	(-50)	(-50)	(-50)	(-50)	(-50)
				(-50)	(-50)	(-50)	(-50)	(-50)	(-50)	(-50)	(-50)	(-50)	(-50)	(-50)	(-50)	(-50)	(-50)	(-50)	(-50)	(-50)	(-50)	(-50)	(-50)	(-50)	(-50)
				(-50)	(-50)	(-50)	(-50)	(-50)	(-50)	(-50)	(-50)	(-50)	(-50)	(-50)	(-50)	(-50)	(-50)	(-50)	(-50)	(-50)	(-50)	(-50)	(-50)	(-50)	(-50)
				(-50)	(-50)	(-50)	(-50)	(-50)	(-50)	(-50)	(-50)	(-50)	(-50)	(-50)	(-50)	(-50)	(-50)	(-50)	(-50)	(-50)	(-50)	(-50)	(-50)	(-50)	(-50)
				(-50)	(-50)	(-50)	(-50)	(-50)	(-50)	(-50)	(-50)	(-50)	(-50)	(-50)	(-50)	(-50)	(-50)	(-50)	(-50)	(-50)	(-50)	(-50)	(-50)	(-50)	(-50)
				(-50)	(-50)	(-50)	(-50)	(-50)	(-50)	(-50)	(-50)	(-50)	(-50)	(-50)	(-50)	(-50)	(-50)	(-50)	(-50)	(-50)	(-50)	(-50)	(-50)	(-50)	(-50)
				(-50)	(-50)	(-50)	(-50)	(-50)	(-50)	(-50)	(-50)	(-50)	(-50)	(-50)	(-50)	(-50)	(-50)	(-50)	(-50)	(-50)	(-50)	(-50)	(-50)	(-50)	(-50)
				(-50)	(-50)	(-50)	(-50)	(-50)	(-50)	(-50)	(-50)	(-50)	(-50)	(-50)	(-50)	(-50)	(-50)	(-50)	(-50)	(-50)	(-50)	(-50)	(-50)	(-50)	(-50)
				(-50)	(-50)	(-50)	(-50)	(-50)	(-50)	(-50)	(-50)	(-50)	(-50)	(-50)	(-50)	(-50)	(-50)	(-50)	(-50)	(-50)	(-50)	(-50)	(-50)	(-50)	(-50)
				(-75) (-75) (-75)>;

			PS_Config_Diff_Test_Frame = <50>;
		};
	};
};
		/* for Xiaomi N85 NT36523D CSOT8.68" panel module */
