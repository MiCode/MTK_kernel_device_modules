// SPDX-License-Identifier: (GPL-2.0 OR MIT)
/*
 * Copyright (C) 2025 MediaTek Inc.
 * Author: Hulk Lu <hulk.lu@mediatek.com>
 */

#include <dt-bindings/power/mt6881-aiot-ext-power.h>

&aiot_addl_clkitg {
	status = "okay";

	bring-up-pd-pcie@30 {
		compatible = "mediatek,scpsys-bring-up";
		reg = <0x30>;
		power-domains = <&scpsys MT6881_POWER_DOMAIN_PCIE>;
	};

	bring-up-pd-pcie-phy@31 {
		compatible = "mediatek,scpsys-bring-up";
		reg = <0x31>;
		power-domains = <&scpsys MT6881_POWER_DOMAIN_PCIE_PHY>;
	};
};
