// SPDX-License-Identifier: GPL-2.0
&i2c0 {
	clock-frequency = <1000000>;
	status = "okay";

	aw35615@24 {
		compatible = "awinic,aw35615";
		reg = <0x24>;
		awinic,int_n = <&pio 41 0>;
		aw35615,snk_pdo_size = <2>; /* set sink pdo num*/
		aw35615,snk_pdo_vol = <5000 5000>; /* set sink pdo voltage mV*/
		aw35615,snk_pdo_cur = <1000 2000>; /* set sink pdo current mA*/
		aw35615,snk_pps_size = <1>; /* set sink pps num*/
		aw35615,snk_pps_vol = <5000 9000>; /* set sink pps voltage mV*/
		aw35615,snk_pps_cur = <4000>; /* set sink pps current mA*/
		aw35615,src_pdo_size = <2>; /* set source pdo num*/
		aw35615,src_pdo_vol = <5000 5000>; /* set source pdo voltage mV*/
		aw35615,src_pdo_cur = <500 2000>; /* set source pdo current mA*/
		aw35615,src_pps_size = <0>; /* set sink pps num*/
		aw35615,src_pps_vol = <0>; /* set sink pps voltage mV*/
		aw35615,src_pps_cur = <0>; /* set sink pps current mA*/
		aw35615,snk_tog_time = <0x36>; /* set toggle sink time */
		aw35615,src_tog_time = <0x36>; /* set toggle source time */
		aw35615,cc1_ov_th = <0x7>; /* set cc1 ov threshold */
		aw35615,cc2_ov_th = <0x7>; /* set cc2 ov threshold */
		aw35615,lpd_tim_set = <0x4>; /* set the LPD sensitivity */
		status = "okay";
	};
};
