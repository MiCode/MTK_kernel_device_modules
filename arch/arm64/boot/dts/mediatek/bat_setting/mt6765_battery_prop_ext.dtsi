// SPDX-License-Identifier: GPL-2.0+
/*
 * Copyright (c) 2019 MediaTek Inc.
 *
 */

bat_gm30: battery{
	compatible = "mediatek,bat_gm30";
	/*	Charging termination current.*/
	difference-fullocv-ith = <(200)>;
	/*	If ui_soc shows 1% more than X minites, system will shutdown.*/
	shutdown-1-time = <(30)>;
/*	The ui_soc will keep 100% until SOC drop X percents after unplugged.*/
	keep-100-percent = <(1)>;
	r-fg-value = <(10)>;	/*	R_sense resistance.*/
	/*	Configures whether using embedded battery or not.*/
	embedded-sel = <(1)>;
	pmic-shutdown-current = <(20)>;	/*	System shutdown current.*/
	fg-meter-resistance = <(75)>;	/*	The resistance of PCB*/
	/*	Tune value for current measurement.*/
	car-tune-value = <(100)>;
	pmic-min-vol = <(33500)>;
	/*	vboot voltage for gauge 0%.*/
	poweron-system-iboot = <(500)>;
	/*	power on system iboot*/
	shutdown-gauge0-voltage = <(34000)>;
	/*	shutdown gauge 0% voltage*/
	temperature-t0 = <(50)>;	/*	Battery temperature T0*/
	temperature-t1 = <(25)>;	/*	Battery temperature T1*/
	temperature-t2 = <(10)>;	/*	Battery temperature T2*/
	temperature-t3 = <(0)>;	/*	Battery temperature T3*/
	temperature-t4 = <(-10)>;	/*	Battery temperature T4*/
	g-fg-pseudo100-t0 = <(100)>;	/*	Pseudo 100% percentage at T0.*/
	g-fg-pseudo100-t1 = <(100)>;	/*	Pseudo 100% percentage at T1.*/
	g-fg-pseudo100-t2 = <(100)>;	/*	Pseudo 100% percentage at T2.*/
	g-fg-pseudo100-t3 = <(100)>;	/*	Pseudo 100% percentage at T3.*/
	g-fg-pseudo100-t4 = <(100)>;	/*	Pseudo 100% percentage at T4.*/
	/*	System shut down voltage.*/
	q-max-sys-voltage-bat0 = <(3350)>;
	/*	System shut down voltage.*/
	q-max-sys-voltage-bat1 = <(3350)>;
	/*	System shut down voltage.*/
	q-max-sys-voltage-bat2 = <(3350)>;
	/*	System shut down voltage.*/
	q-max-sys-voltage-bat3 = <(3350)>;
#include "mt6765_battery_table_ext.dtsi"
};
