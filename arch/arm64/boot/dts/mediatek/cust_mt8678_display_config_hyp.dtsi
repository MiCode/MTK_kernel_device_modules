// SPDX-License-Identifier: (GPL-2.0 OR MIT)
/*
 * Copyright (C) 2022 MediaTek Inc.
 */

&dsi0 {
	status = "okay";
};

&max96789 {
	status = "okay";
};

&mipi_tx_config0 {
	status = "okay";
};

&dispsys_config {
	helper-value = <0>, /*MTK_DRM_OPT_STAGE*/
		<1>, /*MTK_DRM_OPT_USE_CMDQ*/
		<1>, /*MTK_DRM_OPT_USE_M4U*/
		<1>, /*MTK_DRM_OPT_MMQOS_SUPPORT*/
		<1>, /*MTK_DRM_OPT_MMDVFS_SUPPORT*/
		<0>, /*MTK_DRM_OPT_SODI_SUPPORT*/
		<1>, /*MTK_DRM_OPT_IDLE_MGR*/
		<0>, /*MTK_DRM_OPT_IDLEMGR_SWTCH_DECOUPLE*/
		<1>, /*MTK_DRM_OPT_IDLEMGR_BY_REPAINT*/
		<0>, /*MTK_DRM_OPT_IDLEMGR_ENTER_ULPS*/
		<0>, /*MTK_DRM_OPT_IDLEMGR_KEEP_LP11*/
		<0>, /*MTK_DRM_OPT_DYNAMIC_RDMA_GOLDEN_SETTING*/
		<0>, /*MTK_DRM_OPT_IDLEMGR_DISABLE_ROUTINE_IRQ*/
		<0>, /*MTK_DRM_OPT_IDLEMGR_ASYNC*/
		<0>, /*MTK_DRM_OPT_MET_LOG*/
		<1>, /*MTK_DRM_OPT_USE_PQ*/
		<1>, /*MTK_DRM_OPT_ESD_CHECK_RECOVERY*/
		<1>, /*MTK_DRM_OPT_ESD_CHECK_SWITCH*/
		<1>, /*MTK_DRM_OPT_PRESENT_FENCE*/
		<0>, /*MTK_DRM_OPT_RDMA_UNDERFLOW_AEE*/
		<0>, /*MTK_DRM_OPT_DSI_UNDERRUN_AEE*/
		<0>, /*MTK_DRM_OPT_ODDMR_UNDERRUN_AEE*/
		<0>, /*MTK_DRM_OPT_HRT*/
		<0>, /*MTK_DRM_OPT_HRT_MODE*/
		<0>, /*MTK_DRM_OPT_DELAYED_TRIGGER*/
		<0>, /*MTK_DRM_OPT_OVL_EXT_LAYER*/
		<0>, /*MTK_DRM_OPT_AOD*/
		<1>, /*MTK_DRM_OPT_RPO*/
		<0>, /*MTK_DRM_OPT_DUAL_PIPE*/
		<0>, /*MTK_DRM_OPT_DC_BY_HRT*/
		<0>, /*MTK_DRM_OPT_OVL_WCG*/
		<0>, /*MTK_DRM_OPT_OVL_SBCH*/
		<1>, /*MTK_DRM_OPT_COMMIT_NO_WAIT_VBLANK*/
		<0>, /*MTK_DRM_OPT_MET*/
		<0>, /*MTK_DRM_OPT_REG_PARSER_RAW_DUMP*/
		<0>, /*MTK_DRM_OPT_VP_PQ*/
		<0>, /*MTK_DRM_OPT_GAME_PQ*/
		<0>, /*MTK_DRM_OPT_MMPATH*/
		<0>, /*MTK_DRM_OPT_HBM*/
		<0>, /*MTK_DRM_OPT_VDS_PATH_SWITCH*/
		<0>, /*MTK_DRM_OPT_LAYER_REC*/
		<1>, /*MTK_DRM_OPT_CLEAR_LAYER*/
		<0>, /*MTK_DRM_OPT_LFR*/
		<0>, /*MTK_DRM_OPT_SF_PF*/
		<0>, /*MTK_DRM_OPT_DYN_MIPI_CHANGE*/
		<0>, /*MTK_DRM_OPT_PRIM_DUAL_PIPE*/
		<1>, /*MTK_DRM_OPT_MSYNC2_0*/
		<1>, /*MTK_DRM_OPT_MSYNC2_0_WAIT_EPT*/
		<1>, /*MTK_DRM_OPT_MML_PRIMARY*/
		<1>, /*MTK_DRM_OPT_MML_SUPPORT_CMD_MODE*/
		<1>, /*MTK_DRM_OPT_MML_PQ*/
		<1>, /*MTK_DRM_OPT_MML_IR*/
		<0>, /*MTK_DRM_OPT_DUAL_TE*/
		<0>, /*MTK_DRM_OPT_RES_SWITCH*/
		<1>, /*MTK_DRM_OPT_RES_SWITCH_ON_AP*/
		<0>, /*MTK_DRM_OPT_PREFETCH_TE*/
		<0>, /*MTK_DRM_OPT_VIDLE_APSRC_OFF*/
		<0>, /*MTK_DRM_OPT_VIDLE_DSI_PLL_OFF*/
		<0>, /*MTK_DRM_OPT_CHECK_TRIGGER_MERGE*/
		<0>, /*MTK_DRM_OPT_VIRTUAL_DISP*/
		<1>, /*MTK_DRM_OPT_OVL_BW_MONITOR*/
		<0>, /*MTK_DRM_OPT_GPU_CACHE*/
		<1>, /*MTK_DRM_OPT_SPHRT*/
		<0>, /*MTK_DRM_OPT_SDPA_OVL_SWITCH*/
		<1>, /*MTK_DRM_OPT_HRT_BY_LARB*/
		<0>, /*MTK_DRM_OPT_TILE_OVERHEAD*/
		<1>, /*MTK_DRM_OPT_VIDLE_TOP_EN*/
		<0>, /*MTK_DRM_OPT_VIDLE_MTCMOS_DT_EN*/
		<0>, /*MTK_DRM_OPT_VIDLE_MMINFRA_DT_EN*/
		<0>, /*MTK_DRM_OPT_VIDLE_DVFS_DT_EN*/
		<0>, /*MTK_DRM_OPT_VIDLE_QOS_DT_EN*/
		<0>, /*MTK_DRM_OPT_VIDLE_GCE_TS_EN*/
		<1>, /*MTK_DRM_OPT_VIDLE_FULL_SCENARIO*/
		<0>, /*MTK_DRM_OPT_DPC_PRE_TE_EN*/
		<1>, /*MTK_DRM_OPT_PARTIAL_UPDATE*/
		<0>, /*MTK_DRM_OPT_SLC_ALL_CACHE*/
		<0>, /*MTK_DRM_OPT_OVL_WCG_BY_COLOR_MODE*/
		<0>, /*"MTK_DRM_OPT_OVLSYS_CASCADE"*/
		<1>; /*MTK_DRM_OPT_LTPO_VM*/
};
