## drivers/gpu/drm/mediatek/mediatek_v2/mi_disp/Kconfig
```kconfig
config MI_DISP
	bool "Xiaomi Display Feature support"
	default y
	depends on DRM_MEDIATEK_V2
	help
	  This creates /dev/mi_display/disp_feature.

config MI_DISP_DFS_EVENT
	bool "Xiaomi Display DFS support"
	default n
	depends on MI_DISP
	help
	  This is used to support remote diagnosis.
```

## drivers/mihw/perf_actuator/Kconfig
```kconfig
# SPDX-License-Identifier: GPL-2.0-only

config MQOS_PERF_ACTUATOR
        tristate "perf actuator interface"
	default n
        help
	  perf actuator
```

## drivers/misc/mediatek/kswapd_aff/Kconfig
```kconfig
config PERFHELPER
	tristate "Perflock helper"
	default m
	help
	  this module support for performance
```

## drivers/misc/mediatek/launch_boost/Kconfig
```kconfig
config MI_LAUNCH_BOOST
	tristate "app cold launch boot boost"
	default n
	help
	  This driver used for preread io for app cold launch.
```

## drivers/misc/xiaomi/Kconfig
```kconfig
# SPDX-License-Identifier: GPL-2.0-only
#
# Misc memory devices
#

menu "Xiaomi Misc devices"
endmenu
```

## drivers/power/supply/wt_chg/Kconfig
```kconfig
# SPDX-License-Identifier: GPL-2.0
#charge_policy
source "$(KCONFIG_EXT_PREFIX)drivers/power/supply/wt_chg/charger_policy/Kconfig"
#sc_charger
source "$(KCONFIG_EXT_PREFIX)drivers/power/supply/wt_chg/sc_charger/Kconfig"
#protocol
source "$(KCONFIG_EXT_PREFIX)drivers/power/supply/wt_chg/sc_charger/protocol/Kconfig"
#subpimc
source "$(KCONFIG_EXT_PREFIX)drivers/power/supply/wt_chg/sc_charger/subpmic/Kconfig"
config SOUTHCHIP_ADAPTER_CLASS
	tristate "support southchip charger adapter class"
	default n
	help
		Say Y here to support southchip charger adapter class.
config SOUTHCHIP_CHARGER_CLASS
	tristate "support southchip charger class"
	default n
	help
		Say Y here to support southchip charger class.
config SOUTHCHIP_DVCHG_CLASS
	tristate "support southchip chager pump class"
	default n
	help
		Say Y here to support southchip chager pump class.
```

## drivers/power/supply/wt_chg/charger_policy/Kconfig
```kconfig
#SPDX-License-Identifier: GPL-2.0

config PD_ADAPTER
    depends on SOUTHCHIP_ADAPTER_CLASS
    bool "southchip PD adapter"
    default n
    help 
      Say Y to enable southchip pd adapter
config SOUTHCHIP_CHARGER_MANAGER
	tristate "support southchip charger manger"
	default n
	help
		Say Y here to support southchip charger manger.

config SOUTHCHIP_DVCHG_POLICY
	tristate "support southchip charger pump policy"
	default n
	help
		Say Y here to support southchip charger class.

config XIAOMI_SMART_CHG
        tristate "support xiaomi smart charge"
        default n
        help
                Say Y here to support xiaomi smart charge.
```

## drivers/power/supply/wt_chg/sc_charger/protocol/Kconfig
```kconfig
menuconfig PROTOCOL
	tristate "support protocol for southchip"
	help
	  Say Y here to support protocol.

if PROTOCOL

source "$(KCONFIG_EXT_PREFIX)drivers/power/supply/wt_chg/sc_charger/protocol/bc12/Kconfig"

endif
```

## drivers/thermal/xiaomi/Kconfig
```kconfig
# SPDX-License-Identifier: GPL-2.0-only
#
# Xiaomi thermal drivers configuration
#

config MI_THERMAL_MULTI_CHARGE
	tristate "enable multi charge themral interface"
	help
	  Enable multi charge function in kernel, add two sysfs nodes in
	  thermal_message.

config MI_THERMAL_ATC_ENABLE
	tristate "enable atc enable themral interface"
	help
	  Enable atc enable function in kernel, add two sysfs nodes in
	  thermal_message.

config MI_THERMAL_TEMP_TRIP
	tristate "board sensor single temperature trip"
	depends on MI_THERMAL_INTERFACE
	default n
	help
	  This is for board sensor single temperature point update.

config MI_THERMAL_COMM_SYSFS
	tristate "thermal common sysfs node"
	depends on MI_THERMAL_INTERFACE
	default n
	help
	  This is for new sysfs node can add by dtsi.
```
