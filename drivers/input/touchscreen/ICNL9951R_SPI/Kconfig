## drivers/input/touchscreen/ICNL9951R_SPI/Kconfig
```kconfig
config TOUCHSCREEN_ICNL9951R_SPI
	tristate "Chipone TDDI touchscreen for Mediatek package"
	default n
	help
	  Say y here if you have chipone TDDI touch panel.
	  If unsure, say N.
```

## drivers/input/touchscreen/NT38771/Kconfig
```kconfig
#
# Novatek NT387xx touchscreen driver configuration
#
config TOUCHSCREEN_NT38771
	tristate "Novatek NT387xx host download SPI driver"
	help
	  Say Y here if you have a Novatek NT387xx no flash touchscreen connected
	  to your system by SPI bus.

	  If unsure, say N.
```

## drivers/input/touchscreen/ft3683g/Kconfig
```kconfig
config TOUCHSCREEN_FOCALTECH_FT3683G
	tristate "focaltech tianma spi touchscreen"
	default m
	help
	  Say Y here if you have a focaltech series touch controller
	  to your system.
	  If build module, say M.
	  If unsure, say N.
```

## drivers/input/touchscreen/ft8057m_spi/Kconfig
```kconfig
#
# Focaltech Touchscreen driver configuration
#

config TOUCHSCREEN_FTS_M
    tristate "Focaltech Touchscreen"
    default m
    help
      Say Y here if you have Focaltech touch panel.
      If unsure, say N.
```

## drivers/input/touchscreen/xiaomi_touch/Kconfig
```kconfig
config TOUCHSCREEN_XIAOMI_TOUCHFEATURE_COMMON
	tristate "Xiaomi Touch Feature"
	help
	  Say Y here if you enable xiaomi touch feature.
	  If unsure, say N.
	  To compile this driver as a module, choose M here:
```

## drivers/misc/Kconfig
```kconfig
# SPDX-License-Identifier: GPL-2.0-only

source "drivers/misc/mediatek/Kconfig"
source "drivers/misc/xiaomi/Kconfig"
source "drivers/misc/hqsysfs/Kconfig"
```

## drivers/misc/mediatek/SIH6887/Kconfig
```kconfig
config SIH_VIBRATOR
    tristate "SI Vibrator driver"
    default n
    help 
    SI Vibrator driver
```

## drivers/misc/mediatek/audio_ipi/Kconfig
```kconfig
config MTK_AUDIO_IPI
	tristate "Enable MTK audio ipi support"
	depends on MTK_AUDIODSP_SUPPORT || MTK_SCP_AUDIO
	default m
	help
	  This option enables MTK audio ipi modules to communicate
	  with subsystem.
	  This option depends on MediaTek in-house audio DSP support
	  or audio feature support on MediaTek in-house DSP.

config DEVICE_MODULES_VHOST_ADSP
	tristate "Host kernel accelerator for virtio blk (EXPERIMENTAL)"
	depends on BLOCK
	select VHOST
	help
	  This kernel module can be loaded in host kernel to accelerate
	  guest block with virtio_adsp. Not to be confused with virtio_adsp
	  module itself which needs to be loaded in guest kernel.

	  To compile this driver as a module, choose M here: the module will
	  be called vhost_adsp.
```

## drivers/misc/mediatek/auto_mbraink/Kconfig
```kconfig
source "$(KCONFIG_EXT_PREFIX)drivers/misc/mediatek/auto_mbraink/bridge/Kconfig"
source "$(KCONFIG_EXT_PREFIX)drivers/misc/mediatek/auto_mbraink/perf/Kconfig"
source "$(KCONFIG_EXT_PREFIX)drivers/misc/mediatek/auto_mbraink/modules/v8668/Kconfig"

config MTK_AUTO_MBRAINK
	tristate " MTK_AUTO MBRAINK support"
	select   MTK_MBRAINK_BRIDGE
	help
          MBRAINK is a MediaTek in-house kernel module which can
          communicate with android MBrain.
          Set Y to enable this feature.
          If unsure, Set N to stay with legancy feature.

config MTK_AUTO_MBRAINK_MT8668
	tristate "Specify Mediatek MBRAINK Platform is M8668"
	depends on MTK_AUTO_MBRAINK
	help
	  Select MediaTek MBraink Module Platform is MT6899
	  for android MBrain feature.
	  Set Y to select this feature for specific platform-mt6899.
	  If unsure, set N to disable.
```

## drivers/misc/mediatek/auto_mbraink/bridge/Kconfig
```kconfig
config TEST_MTK_AUTO_MBRAINK_BRIDGE
	tristate "MTK AUTO MBRAINK BRIDGE support"
	help
	  AUTO MBRAINK BRIDGE is a MediaTek in-house kernel module which can
	  communicate with android MBrain.
	  Set Y to enable this feature.
	  If unsure, Set N to stay with legancy feature.
```

## drivers/misc/mediatek/auto_mbraink/mbrain_vhost/Kconfig
```kconfig
config AUTO_MTK_MBRAINK_VHOST
	tristate "MTK AUTO MBRAINK PERF support"
	help
	  MBRAINK PERF is a MediaTek in-house kernel module which can
	  communicate with android MBrain.
	  Set Y to enable this feature.
	  If unsure, Set N to stay with legancy feature.
```

## drivers/misc/mediatek/auto_mbraink/modules/v8668/Kconfig
```kconfig
config TEST_MTK_AUTO_MBRAINK_MT8668
	tristate "Specify Mediatek MBRAINK Platform is MT8668"
	depends on TEST_MTK_MBRAINK
	help
	  Select MediaTek MBraink Module Platform is MT8668
	  for android MBrain feature.
	  Set Y to select this feature for specific platform-mt8668.
	  If unsure, set N to disable.
```

## drivers/misc/mediatek/auto_mbraink_client/Kconfig
```kconfig
source "$(KCONFIG_EXT_PREFIX)drivers/misc/mediatek/auto_mbraink/bridge/Kconfig"
source "$(KCONFIG_EXT_PREFIX)drivers/misc/mediatek/auto_mbraink/perf/Kconfig"
source "$(KCONFIG_EXT_PREFIX)drivers/misc/mediatek/auto_mbraink/modules/v8668/Kconfig"

config MTK_AUTO_MBRAINK
	tristate " MTK_AUTO MBRAINK support"
	select   MTK_MBRAINK_BRIDGE
	help
          MBRAINK is a MediaTek in-house kernel module which can
          communicate with android MBrain.
          Set Y to enable this feature.
          If unsure, Set N to stay with legancy feature.

config  MTK_AUTO_MBRAINK_MT6989
	tristate "Specify Mediatek MBRAINK Platform is MT6989"
	depends on  MTK_AUTO_MBRAINK
	help
	  Select MediaTek MBraink Module Platform is MT6989
	  for android MBrain feature.
	  Set Y to select this feature for specific platform-mt6989.
	  If unsure, set N to disable.

config MTK_AUTO_MBRAINK_MT8678
	tristate "Specify Mediatek MBRAINK Platform is MT8678"
	depends on MTK_AUTO_MBRAINK
	default n
	help
	  Select MediaTek MBraink Module Platform is MT8678
	  for AUTO MBrain feature.
	  Set Y to select this feature for specific platform-mt8678.
	  If unsure, set N to disable.

config MTK_AUTO_MBRAINK_MT6899
	tristate "Specify Mediatek MBRAINK Platform is MT6899"
	depends on MTK_AUTO_MBRAINK
	help
	  Select MediaTek MBraink Module Platform is MT6899
	  for android MBrain feature.
	  Set Y to select this feature for specific platform-mt6899.
	  If unsure, set N to disable.
```

## drivers/misc/mediatek/cameraisp/src/isp_50/Kconfig
```kconfig
config MTK_CAMERA_ISP_RAW_SUPPORT_ISP50
	tristate "[ISP] Image Signal Processor - mt6771"
	help
	  Enable to build mt6771 camera isp driver which
	  processes and enhances the image raw data
	  from the imgsensor.
	  Disable if it is not supported or not wanted.
```

## drivers/misc/mediatek/cci_lite/Kconfig
```kconfig
config MEDIATEK_CCI_DEBUG_LITE
	tristate "Mediatek cci dvfs debug driver"
	help
	  This kernel config can be used to debug cci dvfs (dynamic voltage
	  and frequency scaling) for Mediatek cci driver.
	  When enable this option, we can get more dvfs information.
          If unsure, say N.
```

## drivers/misc/mediatek/cpuhotplug/Kconfig
```kconfig
config MTK_CPUHOTPLUG
	tristate "MediaTek CPU hotplug driver"
	help
	  This kernel config can be used to enable cpu hotplug driver.
          When this config is turned on, the CPU switch in suspend state
          will be supported.
	  	Select "y" if you want to enable this features.
	  	Select "n" if unsure.

config MT8788_CPUHOTPLUG
	tristate "MediaTek CPU hotplug driver on mt8788"
	help
	  This kernel config can be used to enable cpu hotplug driver for mt8788.
          When this config is turned on, the CPU switch in suspend state
          will be supported.
	  	Select "y" if you want to enable this features.
	  	Select "n" if unsure.
```

## drivers/misc/mediatek/cpumaxfreq/Kconfig
```kconfig
#
# P16/P16P code for HQFEAT-89663 by p-yinjieru at 2025/03/10
#

config CPUMAXFREQ_SUPPORT
	tristate "xiaomi get cpumaxfreq"
	default n
	help
	  Say 'm' here to support cpumaxfreq node
```

## drivers/misc/mediatek/dcm/Kconfig
```kconfig
config MTK_DCM_COMMON
	tristate "Mediatek DCM COMMON"
	depends on ARCH_MEDIATEK && OF
	help
	  For Mediatek Dynamic Clock Management control. Provid a common interface to
	  adjust dcm setting. Setting will not keep after reboot
	  Select "y" if you want to use.
	  Select "n" if you are not sure.

config MTK_DCM_MT6768
	tristate "Mediatek MT6768 DCM control"
	depends on ARCH_MEDIATEK && OF
	select MTK_DCM_COMMON
	help
	  For Mediatek MT6768 Dynamic Clock Management HW control. Only enable when you
	  neet to change mt6768 dcm setting. Setting will not keep after reboot
	  Select "y" if you want to change mt6768 dcm setting.
	  Select "n" if you do not need to change


config MTK_DCM_MT6885
	tristate "Mediatek MT6885 DCM control"
	depends on ARCH_MEDIATEK && OF
	select MTK_DCM_COMMON
	help
	  For Mediatek MT6885 Dynamic Clock Management HW control. Only enable when you
	  neet to change mt6885 dcm setting. Setting will not keep after reboot
	  Select "y" if you want to change mt6893 dcm setting.
	  Select "n" if you do not need to change

config MTK_DCM_MT6985
	tristate "Mediatek MT6985 DCM control"
	depends on ARCH_MEDIATEK && OF
	select MTK_DCM_COMMON
	help
	  For Mediatek MT6985 Dynamic Clock Management HW control. Only enable when you
	  neet to change mt6985 dcm setting. Setting will not keep after reboot
	  Select "y" if you want to change mt6985 dcm setting.
	  Select "n" if you do not need to change

config MTK_DCM_MT6878
	tristate "Mediatek MT6878 DCM control"
	depends on ARCH_MEDIATEK && OF
	select MTK_DCM_COMMON
	help
	  For Mediatek MT6878 Dynamic Clock Management HW control. Only enable when you
	  neet to change mt6878 dcm setting. Setting will not keep after reboot
	  Select "y" if you want to change mt6878 dcm setting.
	  Select "n" if you do not need to change

config MTK_DCM_MT6897
	tristate "Mediatek MT6897 DCM control"
	depends on ARCH_MEDIATEK && OF
	select MTK_DCM_COMMON
	help
	  For Mediatek MT6897 Dynamic Clock Management HW control. Only enable when you
	  neet to change mt6897 dcm setting. Setting will not keep after reboot
	  Select "y" if you want to change mt6897 dcm setting.
	  Select "n" if you do not need to change

config MTK_DCM_MT6989
	tristate "Mediatek MT6989 DCM control"
	depends on ARCH_MEDIATEK && OF
	select MTK_DCM_COMMON
	help
	  For Mediatek MT6989 Dynamic Clock Management HW control. Only enable when you
	  neet to change mt6989 dcm setting. Setting will not keep after reboot
	  Select "y" if you want to change mt6989 dcm setting.
	  Select "n" if you do not need to change

config MTK_DCM_MT6991
	tristate "Mediatek MT6991 DCM control"
	depends on ARCH_MEDIATEK && OF
	select MTK_DCM_COMMON
	help
	  For Mediatek MT6991 Dynamic Clock Management HW control. Only enable when you
	  neet to change mt6991 dcm setting. Setting will not keep after reboot
	  Select "y" if you want to change mt6991 dcm setting.
	  Select "n" if you do not need to change
```

## drivers/misc/mediatek/et/Kconfig
```kconfig
config MTK_ET
	tristate "MediaTek Debug Module"
	default n
	help
	  This driver provides exception handling for
	  debug.
	  Select "y" if you want to enable this features.
	  Select "n" if unsure.
```

## drivers/misc/mediatek/geniezone/gz-trusty/Kconfig
```kconfig
menu "GZ Trusty"


config HAVE_MTK_GZ_LOG
	bool "GZ gz_log & trusty_log support"
	help
	  This symbol is used to build gz_log into kernel.
	  The gz_log driver will create a proc node which can only printthe gz
	  message.
	  It will be select if MTK_ENABLE_GENIEZONE is on.
	  If the gz_log driver failed or this symbol is false, the mtk logger
	  can not read the gz message correctly.

config MT_GZ_TRUSTY_DEBUGFS
	tristate "Trusty debugfs for Mediatek platforms"
	help
	  This is used to control the creation of trusty debugfs. It includes
	  std call and fast call unit test and stress tests for trusty and
	  nebula. It dump the information about the thread, threadstat,
	  and appliacation.


config TRUSTY_INTERRUPT_FIQ_ONLY
	bool "GZ Trusty interrupt fiq support"
	help
	  This is used for Trusty to support handling new flow in GICv3
	  If this is selected, NWd will not route IRQ to Secure OS
	  but just fire NOP.
	  This is MUST for us to handle G0S IRQ for Secure OS.

config MTK_NEBULA_VM_SUPPORT
	tristate "Nebula VM OS Enable"
	depends on MTK_ENABLE_GENIEZONE
	help
	  This is used for MTK Geniezone to Support Nebula VM OS.
	  Nebula's IRQ will be routed by Linux to Geniezone.
	  Say Y if you would like to enable this feature.
	  If unsure, say N.

config MTK_GZVM_DEBUG
	bool "Enable debug functionality for GZ hypervisor AVF"
	help
	  This config enables additional debug functions for the GZ
	  hypervisor AVF (Android Virtualization Framework) within
	  the Geniezone Virtual Machine (GZVM) framework. When enabled,
	  developers will have access to extra logging and
	  debugging tools that assist in diagnosing and testing
	  features related to hypervisor and AVF

endmenu

# GZ Trusty
```

## drivers/misc/mediatek/hall/Kconfig
```kconfig
config HALL_STATE
	tristate "Enable press hall state"
	default n
        help
	Press the power button volume up button
	and volume down button to trigger the crash.
```

## drivers/misc/mediatek/hardware_info/Kconfig
```kconfig
config HARDWARE_INFO
	tristate "hardware info"
	default n
	help
	This adds support for hardware info.
```

## drivers/misc/mediatek/helio-dvfsrc/Kconfig
```kconfig
config MTK_PMQOS
	tristate "MediaTek PMQOS Framework support"
	help
	  Say yes here to support for the MediaTek PMQOS framework
	  driver. Driver can register the Qos class notify and receive
	  from the devices request to adjust qos policy for power
	  and performance.

config MTK_DVFSRC_V1
	tristate "MTK DVFSRC_V1 Support"
	help
	  This kernel config can be used to enable MediaTek DVFSRC (dynamic
	  voltage and frequency scaling resource collector) on MT6771.
	  Dynamic Vcore voltage and DRAM frequency adjustments optimize power
	  efficiency and performance.
	  If unsure, say N.
```

## drivers/misc/mediatek/hwccf/Kconfig
```kconfig
config MTK_HWCCF
    tristate "Mediatek HWCCF Support"
    select REGMAP
    help
      Select this option to enable support for the Mediatek HWCCF driver.
      This driver provides support for PLL, clock gate (CG), multiplexer (MUX)
      and MTCMOS control by hardware.
```

## drivers/misc/mediatek/ise_trusty/Kconfig
```kconfig
#
# ISE Trusty
#

menu "ISE Trusty"

config ISE_TRUSTY
	tristate "ISE Trusty"
	default n

config ISE_TRUSTY_FIQ
	tristate
	depends on ISE_TRUSTY

config ISE_TRUSTY_FIQ_ARM
	tristate
	depends on ISE_TRUSTY
	depends on ARM
	select FIQ_GLUE
	select ISE_TRUSTY_FIQ
	default y

config ISE_TRUSTY_FIQ_ARM64
	tristate
	depends on ISE_TRUSTY
	depends on ARM64
	select FIQ_GLUE
	select ISE_TRUSTY_FIQ
	default y

config ISE_TRUSTY_LOG
	tristate
	depends on ISE_TRUSTY
	default y

config ISE_TRUSTY_VIRTIO
	tristate "ISE Trusty virtio support"
	depends on ISE_TRUSTY
	select VIRTIO
	default y

config ISE_TRUSTY_VIRTIO_IPC
	tristate "ISE Trusty Virtio IPC driver"
	depends on ISE_TRUSTY_VIRTIO
	default y
	help
	  This module adds support for communications with ISE Trusty Services

	  If you choose to build a module, it'll be called trusty-ipc.
	  Say N if unsure.

config ISE_TRUSTY_BUG_ON_WARN
	tristate "ISE Trusty enable warning as BUG_ON"
	depends on ISE_TRUSTY_VIRTIO_IPC
	depends on MTK_AEE_FEATURE
	default n
	help
	  Enable BUG_ON when trusty met the trouble to confirm issue by
	  AEE. Such as time-out of IPC etc.

	  Select this if you want to enable above facilities.
	  If unsure, say N.

config ISE_TRUSTY_TIPC_FOOTPRINT
	tristate "ISE Trusty TIPC footprint"
	depends on ISE_TRUSTY_VIRTIO_IPC
	default n
	help
	  The debug feature which enables tipc footprint to trace tipc
	  flow between REE/iSE.

	  Select this if you want to enable above facilities.
	  If unsure, say N.

endmenu
```
