## drivers/input/touchscreen/FT3519T/Kconfig
```kconfig
#
# Focaltech Touchscreen driver configuration
#

config TOUCHSCREEN_FT3519T
    tristate "Focaltech Touchscreen"
    default n
    help
      Say Y here if you have Focaltech touch panel.
      If unsure, say N.
```

## drivers/input/touchscreen/Kconfig
```kconfig
# SPDX-License-Identifier: GPL-2.0-only
#
# Touchscreen driver configuration
#

if INPUT_TOUCHSCREEN
config TOUCHSCREEN_MTK_TOUCH
       string "Touch IC name for Mediatek package"
       help
         Set touch IC name if you have touch panel.

         To compile this dirver for used touch IC.

config TOUCHSCREEN_MT6985_ALPHA_SUPPORT
       tristate "Specify Alpha Touch Platform is mt6985"
       help
         Select Alpha Touch Platform is mt6985.
         To compile this dirver for used touch IC.
         Set Y or M to select this feature for specific platform-mt6985,
         and set N to disable.

config TOUCHSCREEN_ILITEK_TOUCH
       tristate "ILITEK TOUCHSCREEN"
       help
         Set Y or M to select this feature for touch compile,
         and set N to disable.

config TOUCHSCREEN_BOTAI_MULTI_TOUCH
       tristate "GT9XX MULTIPLE TOUCHSCREEN"
       help
         Set Y or M to select this feature for touch compile,
         and set N to disable.for BoTai touch feature.

config TOUCHSCREEN_GT9XX
       tristate "GT9XX TOUCHSCREEN FOR CAR SERDES TOUCH"
       help
         Set Y or M to select this feature for touch compile,
         and set N to disable.for car serdes touch feature.

config TOUCHSCREEN_FT3519T
    tristate "Focaltech Touchscreen FT3519T"
    default n
    help
      Say Y here if you have Focaltech touch panel.
      If unsure, say N.

config TOUCHSCREEN_FT3683G
    tristate "Focaltech Touchscreen FT3683G"
    default n
    help
      Say Y here if you have Focaltech touch panel.
      If unsure, say N.

config TOUCHSCREEN_GT9916
	tristate "Goodix berlin touchscreen"
	help
	  Say Y here if you have a Goodix berlin series touch controller
	  to your system.
	  If build module, say M.
	  If unsure, say N.

config TOUCHSCREEN_COMMON
     tristate "lct Touchscreen Driver"
     help
     Say Y here if you want to add lct touchscreen driver.
     If unsure, say N.

config TOUCHSCREEN_XIAOMI_TOUCHFEATURE
	tristate "Xiaomi Touch Feature"
	depends on INPUT_TOUCHSCREEN
	help
		Say Y here if you enable xiaomi touch feature.
		If unsure, say N.
		To compile this driver as a module, choose M here:

# source "$(KCONFIG_EXT_PREFIX)drivers/input/touchscreen/BoTai_Multi_Touch/Kconfig"
# source "$(KCONFIG_EXT_PREFIX)drivers/input/touchscreen/GT9966/Kconfig"
# source "$(KCONFIG_EXT_PREFIX)drivers/input/touchscreen/gt9xx/Kconfig"
source "$(KCONFIG_EXT_PREFIX)drivers/input/touchscreen/ILITEK/Kconfig"
# source "$(KCONFIG_EXT_PREFIX)drivers/input/touchscreen/synaptics_dsx_96789/Kconfig"
# source "$(KCONFIG_EXT_PREFIX)drivers/input/touchscreen/synaptics_dsx_96851/Kconfig"
# source "$(KCONFIG_EXT_PREFIX)drivers/input/touchscreen/NT36532/Kconfig"

endif
```

## drivers/misc/mediatek/zram/Kconfig
```kconfig
# SPDX-License-Identifier: GPL-2.0

config MIUI_ZRAM_MEMORY_TRACKING
	bool "Track zRam stats"
	depends on ZRAM
	help
	  With this feature, admin can track the state of zram
	  of zRAM. Admin could see the information via
	  /sys/block/zramX/.

	  See Documentation/blockdev/zram.txt for more information.
```

## drivers/power/supply/hq_chg/Kconfig
```kconfig
# SPDX-License-Identifier: GPL-2.0
# common utils
source "$(KCONFIG_EXT_PREFIX)drivers/power/supply/hq_chg/common/Kconfig"

#charge_policy
source "$(KCONFIG_EXT_PREFIX)drivers/power/supply/hq_chg/charger_policy/Kconfig"

#sc_charger
source "$(KCONFIG_EXT_PREFIX)drivers/power/supply/hq_chg/sc_charger/Kconfig"

#protocol
source "$(KCONFIG_EXT_PREFIX)drivers/power/supply/hq_chg/sc_charger/protocol/Kconfig"
source "$(KCONFIG_EXT_PREFIX)drivers/power/supply/hq_chg/sc_charger/protocol/bc12/Kconfig"

#subpimc
source "$(KCONFIG_EXT_PREFIX)drivers/power/supply/hq_chg/sc_charger/subpmic/Kconfig"

#sy_charger
source "$(KCONFIG_EXT_PREFIX)drivers/power/supply/hq_chg/sy_charger/Kconfig"

#sy subpimc
source "$(KCONFIG_EXT_PREFIX)drivers/power/supply/hq_chg/sy_charger/subpmic/Kconfig"

#sy_protocol
source "$(KCONFIG_EXT_PREFIX)drivers/power/supply/hq_chg/sy_charger/protocol/Kconfig"
source "$(KCONFIG_EXT_PREFIX)drivers/power/supply/hq_chg/sy_charger/protocol/bc12/Kconfig"

#nu_charger
source "$(KCONFIG_EXT_PREFIX)drivers/power/supply/hq_chg/nu_charger/Kconfig"

#nuvolta subpimc
source "$(KCONFIG_EXT_PREFIX)drivers/power/supply/hq_chg/nu_charger/subpmic/Kconfig"

#fuelgauge
source "$(KCONFIG_EXT_PREFIX)drivers/power/supply/hq_chg/fuelgauge/Kconfig"

#bq_charger
source "$(KCONFIG_EXT_PREFIX)drivers/power/supply/hq_chg/bq_charger/Kconfig"

# tiny battery secret
#source "$(KCONFIG_EXT_PREFIX)drivers/power/supply/hq_chg/battery_secrete/Kconfig"
source "$(KCONFIG_EXT_PREFIX)drivers/power/supply/hq_chg/tiny_battery_secrete/Kconfig"

config HUAQIN_ADAPTER_CLASS
	tristate "support hauqin charger adapter class"
	default n
	help
		Say Y here to support hauqin charger adapter class.

config HUAQIN_CHARGER_CLASS
	tristate "support hauqin charger class"
	default n
	help
		Say Y here to support hauqin charger class.

config HUAQIN_CP_CLASS
	tristate "support hauqin chager pump class"
	default n
	help
		Say Y here to support hauqin chager pump class.

config PD_BATTERY_SECRET
	tristate "pd battery secret"
	default n
	help
		Say Y here to support pd battery secret.

config XIAOMI_SMART_CHG
        tristate "support xiaomi smart charge"
        default n
        help
                Say Y here to support xiaomi smart charge.

config XM_CHG_ANIMATION
        tristate "support xiaomi charge animation"
        default n
        help
                Say Y here to support xiaomi charge animation.

config XM_FG_I2C_ERR
        tristate "support xiaomi fg i2c error"
        default n
        help
                Say Y here to support xiaomi fg i2c error.

config HUAQIN_ERP_SUPPORT
        tristate "support erp law"
        default n
        help
                Say Y here to support erp law

config HUAQIN_SOH2_SUPPORT
        tristate "support soh2 algo"
        default n
        help
                Say Y here to support soh2 algo
```

## drivers/power/supply/hq_chg/charger_policy/Kconfig
```kconfig
#SPDX-License-Identifier: GPL-2.0

config HUAQIN_CHARGER_MANAGER
	tristate "support hauqin charger manger"
	default n
	help
		Say Y here to support hauqin charger manger.

config HUAQIN_CP_POLICY
	tristate "support hauqin charger pump policy"
	default n
	help
		Say Y here to support hauqin charger class.

config HUAQIN_QC_POLICY
	tristate "support hauqin qc policy"
	default n
	help
		Say Y here to support hauqin charger class.

config XM_CHG_DFS
	tristate "support xiaomi charge dfs features"
	default n
	help
		Say Y or M to support xiaomi charge dfs features.

config BC12_RETRY_FOR_MI_PD
	tristate "support retry BC1.2"
	default n
	help
		Say Y here to support retry BC1.2.

config HUAQIN_SOFT_ITERM_SUPPORT
	tristate "support soft iterm support"
	default n
	help
		Say Y here to support soft iterm.

config HUAQIN_ERP_SUPPORT
	tristate "support erp"
	default n
	help
		Say Y here to support erp.

config HUAQIN_USE_AUTH_CYCLE_COUNT
	tristate "support soft iterm support"
	default n
	help
		Say Y here to support soft iterm.
```

## drivers/power/supply/hq_chg/common/Kconfig
```kconfig
# SPDX-License-Identifier: GPL-2.0
config HUAQIN_CHARGER_COMMON
	bool "Support Huaqin Charger Common Utils"
	default y
	help
	  Say Y/M here to support huaqin voter utils

config HUAQIN_VOTER
	depends on HUAQIN_CHARGER_COMMON
	tristate "Support Huaqin Voter Driver"
	default m
	help
	  Say Y/M here to support huaqin voter utils

config HQ_NOTIFY
	depends on HUAQIN_CHARGER_COMMON
	tristate "Support Huaqin Notify Driver"
	default m
	help
	  Say Y/M here to support huaqin notify utils
```

## drivers/power/supply/hq_chg/fuelgauge/Kconfig
```kconfig
#SPDX-License-Identifier: GPL-2.0

config BQ_FUELGAUGE
	tristate "bq28z610 fuelgauge"
	default n
	help
		Say Y here to support bq28z610 fuelgauge.

config HUAQIN_FUEL_ALGORITHM
	tristate "support huaqin fuel algorithm"
	default n
	help
		Say Y here to support huaqin fuel algorithm

config HUAQIN_SOC_SMOOTH_SUPPORT
	tristate "support soc smooth support"
	default n
	help
		Say Y here to support soc smooth

config HUAQIN_SOC_REACH_100_ALGO_SUPPORT
	tristate "support soc reach 100 algo support"
	default n
	help
		Say Y here to support soc reach 100 algo
```

## drivers/power/supply/hq_chg/sy_charger/protocol/Kconfig
```kconfig
menuconfig SY_PROTOCOL
	tristate "support protocol for southchip"
	help
	  Say Y here to support protocol.

if SY_PROTOCOL

source "$(KCONFIG_EXT_PREFIX)drivers/power/supply/hq_chg/sy_charger/protocol/bc12/Kconfig"

endif
```

## drivers/power/supply/hq_chg/sy_charger/subpmic/Kconfig
```kconfig
config SY_SUBPMIC_DRIVER
    tristate "subpmic driver"
    default n
    help
      Say Y to use subpmic core driver

config SC_CHARGER
    tristate "subpmic 6601"
    default n
	help
      Say Y to use subpmic core driver
```

## drivers/staging/binder_prio/Kconfig
```kconfig
# SPDX-License-Identifier: GPL-2.0-only
#
# Mi memory info
#
config BINDER_PRIO
	tristate "Xiaomi binder prio"
	default n
config BINDER_PRIO_MIDDLE
	tristate "Xiaomi binder prio middle"
	default n
```

## drivers/ufs/mi_ufs/Kconfig
```kconfig
# SPDX-License-Identifier: GPL-2.0-only

config SCSI_UFS_XIAOMI
	bool "Xiaomi customized UFS driver based on MTK platform"
	select MI_ERROR_STATE
	select SCSI_UFS_XIAOMI_FFU
	depends on DEVICE_MODULES_SCSI_UFS_MEDIATEK
	default n
	help
	  This adds support for Xiaomi's customized platform driver by skipping GKI.

config MI_ERROR_STATE
	bool "Xiaomi err_state & err_reason function"
	depends on SCSI_UFS_XIAOMI
	default n
	help
	  This adds support for Xiaomi err_state and err_reason function.

config SCSI_UFS_XIAOMI_FFU
	bool "Xiaomi UFS FFU"
	depends on SCSI_UFS_XIAOMI
	default n
	help
	  This adds support for Xiaomi FFU driver support.

config SCSI_UFS_XIAOMI_CLD
	bool "Xiaomi UFS CLD"
	depends on SCSI_UFS_XIAOMI
	default n
	help
	  This adds support for Xiaomi CLD driver support.

config UFS_WB
	bool "Xiaomi WB NODE"
	depends on SCSI_UFS_XIAOMI
	default n
	help
	  This adds support for Xiaomi WB node .
```
