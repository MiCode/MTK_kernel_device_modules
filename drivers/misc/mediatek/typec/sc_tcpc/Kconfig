## drivers/misc/mediatek/typec/sc_tcpc/Kconfig
```kconfig
#
# TypeC Port Controller Device Configuration
#

config TCPC_CLASS
	tristate "TypeC Port Controller Device Class"
	select TYPEC
	help
	  Say Y to enable
	  Typec Port
	  Controller Device
	  Class

config SOUTHCHIP_TCPC_CLASS
	tristate "TypeC Port Controller Device Class"
	select MTK_USB_TYPEC
	select RT_REGMAP
	select TYPEC
	default n
	help
	  Say Y to enable
	  Typec Port
	  Controller Device
	  Class

config USB_POWER_DELIVERY
	tristate "Support USB power delivery Function"
	depends on TCPC_CLASS || SOUTHCHIP_TCPC_CLASS
	default n
	help
	  Say Y to enable
	  USB
	  Power Delivery
	  support


config TCPC_RT1711H
	tristate "Richtek RT1711H TypeC port Controller Driver"
	depends on TCPC_CLASS || SOUTHCHIP_TCPC_CLASS
	default n
	help
	  Say Y to enable
	  Richtek RT1711H
	  TypeC port Controller
	  Driver

config TCPC_SY6976
	tristate "Richtek SY6976 TypeC port Controller Driver"
	depends on TCPC_CLASS || SOUTHCHIP_TCPC_CLASS
	default n
	help
	  Say Y to enable
	  Richtek SY6976
	  TypeC port Controller
	  Driver

config TCPC_SC660X
	tristate "Richtek SC660X TypeC port Controller Driver"
	depends on TCPC_CLASS || SOUTHCHIP_TCPC_CLASS
	default n
	help
	  Say Y to enable
	  Southchip SC660X
	  TypeC port Controller
	  Driver

config USB_PD_VBUS_STABLE_TOUT
	int "PD VBUS Stable Timeout"
	depends on USB_POWER_DELIVERY
	range 0 1000                       # >= 0,  <= 1000
	default 125
	help
	  Setup a timeout value (ms)
	  for
	  VBUS change
	  stable

config PD_DBG_INFO
	tristate "PD debug information"
	depends on TCPC_CLASS || SOUTHCHIP_TCPC_CLASS
	default y
	help
	  Say Y to enable PD debug
	  for PD DBG
	  information
	  Say N to disable
```

## drivers/misc/mediatek/usb/usb_sram/Kconfig
```kconfig
# SPDX-License-Identifier: GPL-2.0
#
# For MTK USB3.0 IP

config MTK_USB_SRAM
	tristate "MediaTek USB Sram Manager"
	help
	  Say Y or M here if your system runs on MediaTek SoCs with
	  'USB Sram' feature. The feature will manage usb's own sram
	  including exporting api for others modules.

	  If you don't know what this is, please say N.

	  Choose M here to compile this driver as a module, and it
	  will be called usb_sram.ko
```

## drivers/misc/mediatek/usb/usb_xhci/Kconfig
```kconfig
# SPDX-License-Identifier: GPL-2.0
#
# USB Host Controller Drivers
#

config DEVICE_MODULES_USB_XHCI_MTK
	tristate "xHCI support for MediaTek SoCs"
	select MFD_SYSCON
	help
	  Say 'Y' to enable the support for the xHCI host controller
	  found in MediaTek SoCs.
	  If unsure, say N.
config DEVICE_MODULES_USB_XHCI_SIDEBAND_MTK
	tristate "xHCI support for sideband on MediaTek SoCs"
	help
	  Say 'Y' to enable the support for the xHCI sideband capability.
	  provide a mechanism for a sideband datapath for payload associated
	  with audio class endpoints. This allows for an audio DSP to use
	  xHCI USB endpoints directly, allowing CPU to sleep while playing
	  audio
```

## drivers/misc/mediatek/vhost_vdmabuf/Kconfig
```kconfig
config DEVICE_MODULES_VHOST_VDMABUF
	tristate "DMA-BUF vdmabuf"
	depends on GRT_HYPERVISOR
	help
	  vdmabuf is a means of cross-domain shared memory. Its function is
	  to transfer the dmabuf requested by the guest to the host so that
	  both ends can access the same physical mem. This is the
	  configuration of vdmabuf on the host side.
```

## drivers/misc/mediatek/videogo/Kconfig
```kconfig
config MTK_VIDEOGO
	tristate "mtk video performance controller"
	help
		This option enables the MediaTek (MTK) video performance controller driver.

		The MTK video performance controller is responsible for managing and optimizing
		the performance of video processing tasks on MediaTek platforms. It provides
		various controls and optimizations to ensure smooth video playback and efficient
		resource utilization.

		If you enable this option, the driver will be compiled and included in the kernel.
		To compile this driver as a module, choose 'M' here. The module will be called
		'videogo'.

		This driver is essential for applications that require high-performance video
		processing on MediaTek hardware. It is recommended to enable this option if you
		are using MediaTek platforms and need to optimize video performance.

		If you are unsure, it is safe to say N.
```

## drivers/misc/mediatek/virtio_vdmabuf/Kconfig
```kconfig
config DEVICE_MODULES_VIRTIO_VDMABUF
	tristate "DMA-BUF vdmabuf"
	depends on HYPER_VM_UOS
	help
	  Choose this option to enable  vdmabuf feature.
	  vdmabuf is a means of cross-domain shared memory. Its function is
	  to transfer the dmabuf requested by the guest to the host so that
	  both ends can access the same physical mem. This is the
	  configuration of vdmabuf on the guest side.
```

## drivers/misc/mediatek/vmm/Kconfig
```kconfig
# SPDX-License-Identifier: GPL-2.0

config MTK_VMM_NOTIFIER_DUMMY
	tristate "MediaTek VMM Notifier driver dummy"
	help
	  This driver is for the Multimedia Infrastructure in MediaTek SoCs.
	  The VMM notifier driver mainly help to nofify MM MCU that camera
	  related mtcmos status. If one of camera mtcmos is on, VMM DVFS has
	  limitation of adjusting voltage, therefore notify camera mtcmos
	  status is necessary for sake of hardware stability.

config MTK_VMM_NOTIFIER
	tristate "MediaTek VMM Notifier driver"
	help
	  This driver is for the Multimedia Infrastructure in MediaTek SoCs.
	  The VMM notifier driver mainly help to nofify MM MCU that camera
	  related mtcmos status. If one of camera mtcmos is on, VMM DVFS has
	  limitation of adjusting voltage, therefore notify camera mtcmos
	  status is necessary for sake of hardware stability.

config MTK_VMM_NOTIFIER_MT6991
	tristate "MediaTek VMM Notifier driver MT6991"
	help
	  This driver is for the Multimedia Infrastructure in MediaTek SoCs.
	  The VMM notifier driver mainly help to nofify MM MCU that camera
	  related mtcmos status. If one of camera mtcmos is on, VMM DVFS has
	  limitation of adjusting voltage, therefore notify camera mtcmos
	  status is necessary for sake of hardware stability.

config MTK_VMM_NOTIFIER_ISP8S
	tristate "MediaTek VMM Notifier driver ISP8S"
	help
	  This option enables the MediaTek VMM (Voltage Management Module) notifier driver for ISP8S.
	  The driver is used in MediaTek SoCs to support the Multimedia Infrastructure, specifically
	  for camera-related MTCMOS (Multi-Threshold CMOS) power management.

	  When any camera MTCMOS is powered on, the VMM DVFS (Dynamic Voltage and Frequency Scaling)
	  module must limit voltage adjustments to ensure hardware stability. This driver notifies
	  the MM MCU (Multimedia Microcontroller Unit) about the status of camera MTCMOS, allowing
	  the system to safely manage voltage and power states.

	  If you are using a MediaTek SoC with ISP8S and require camera power management integration
	  with VMM DVFS, enable this option. Otherwise, you can disable it.
```

## drivers/misc/xiaomi/bootmonitor/Kconfig
```kconfig
# SPDX-License-Identifier: GPL-2.0-only
#
# Mi boot monitor
#

config MI_BOOT_MONITOR
	tristate "boot monitor"
	default y
	help
	This adds support for mi boot monitor.
```

## drivers/misc/xiaomi/build_product_name/Kconfig
```kconfig
# SPDX-License-Identifier: GPL-2.0-only
#
# BUILD_PRODUCT_NAME info
#
config BUILD_PRODUCT_NAME
	string "build product"
	default ""
	help
		build product
```

## drivers/misc/xiaomi/cam_intentaware_fsys/Kconfig
```kconfig
# SPDX-License-Identifier: GPL-2.0-only
#
# CAM_INTENTAWARE_FSYS info
#
config CAM_INTENTAWARE_FSYS
	tristate "CAM INTENTAWARE FSYS"
	default n
	help
	 Driver for CAM INTENTAWARE FSYS
```

## drivers/misc/xiaomi/mi_locking/Kconfig
```kconfig
# SPDX-License-Identifier: GPL-2.0-only

config MI_LOCKING
       tristate "mi_locking support"
       default n
       help
         mi locking will record waitlock time and holdlock time.
```

## drivers/misc/xiaomi/mi_t1_chip/Kconfig
```kconfig
# SPDX-License-Identifier: GPL-2.0-only
#
# MI_T1_CHIP info
#
config MI_T1_CHIP
	tristate "MI T1 CHIP"
	default n
	help
	 Driver for MI T1 CHIP
```

## drivers/misc/xiaomi/mi_ubt/Kconfig
```kconfig
# SPDX-License-Identifier: GPL-2.0-only

config MI_UBT
	tristate "mi_ubt support"
	default n
	help
		mi_ubt provide dump_user_backtrace interface to show user stacktrace.

source "$(KCONFIG_EXT_PREFIX)drivers/misc/xiaomi/mi_ubt/test/Kconfig"
```

## drivers/misc/xiaomi/scene_swappiness/Kconfig
```kconfig
config SCENE_SWAPPINESS
    tristate "SCENE_SWAPPINESS adjusts swappiness according to different scenarios"
	default n
    help
      UX task alloc page frist.
```

## drivers/net/ethernet/stmicro/stmmac/Kconfig
```kconfig
# SPDX-License-Identifier: GPL-2.0-only
config STMMAC_ETH
	tristate "STMicroelectronics Multi-Gigabit Ethernet driver"
	depends on HAS_IOMEM && HAS_DMA
	depends on PTP_1588_CLOCK_OPTIONAL
	select MII
	select PCS_XPCS
	select PAGE_POOL
	select PHYLINK
	select CRC32
	select RESET_CONTROLLER
	help
	  This is the driver for the Ethernet IPs built around a
	  Synopsys IP Core.

if STMMAC_ETH

config STMMAC_SELFTESTS
	bool "Support for STMMAC Selftests"
	depends on INET
	depends on STMMAC_ETH
	default n
	help
	  This adds support for STMMAC Selftests using ethtool. Enable this
	  feature if you are facing problems with your HW and submit the test
	  results to the netdev Mailing List.

config STMMAC_PLATFORM
	tristate "STMMAC Platform bus support"
	depends on STMMAC_ETH
	select MFD_SYSCON
	default y
	help
	  This selects the platform specific bus support for the stmmac driver.
	  This is the driver used on several SoCs:
	  STi, Allwinner, Amlogic Meson, Altera SOCFPGA.

	  If you have a controller with this interface, say Y or M here.

	  If unsure, say N.

if STMMAC_PLATFORM

config DWMAC_MEDIATEK
	tristate "MediaTek MT27xx GMAC support"
	depends on OF && (ARCH_MEDIATEK || COMPILE_TEST)
	help
	  Support for MediaTek GMAC Ethernet controller.

	  This selects the MT2712 SoC support for the stmmac driver.

endif

endif
```

## drivers/power/mca/Kconfig
```kconfig
config  XM_POWER_SUPPLY
	tristate "Xiaomi power supply config"
	help
	  Say Y or M here to enable xiaomi power supply
```

## drivers/power/supply/wireless_chg/Kconfig
```kconfig
# SPDX-License-Identifier: GPL-2.0

config WIRELESS_SC96231
	tristate "wireless charging sc96231 driver"
	help
		Say yes here to enable xmext use sc96231 wireless rev chg driver.
		Say no if not using xmext use sc96231 wireless rev chg driver.

config WIRELESS_CHG_CLASS
	tristate "wireless charging class"
	help
		Say yes here to enable wls chg class.
		Say no if not using wls chg class

config WIRELESS_CHG_CLASS_INTF
	tristate "wireless charging class driver"
	help
		Say yes here to enable wireless_charger_class driver.
		Say no if not using wireless_charger_class driver.

config XM_WLS_CHG_CLASS_INTF
	bool "support wireless charging class ops"
	default n
	help
		Say yes here to use wireless_charger_class ops.
		Say no if using wireless_charger_class weak ops.

config WIRELESS_SC96281
	tristate "southchip wireless charger driver"
	help
		Say yes here to enable sc96281 wireless charger driver.
		Say no if not using sc96281 wireless charger driver.
  
  config XM_WLS_MANAGER
	tristate "wls_cp_manager contral wireless adapter charging"
	help
		Say yes here to enable wls_cp_manager contral wls adapter charging driver.
		Say no if not using wls_cp_manager contral wls adapter charging driver.

config SUPPORT_SOUTHCHIP_PDPHY
	bool "support southchip pdphy"
	default n
	help
	support southchip pdphy.
```

## drivers/spi/Kconfig
```kconfig
# SPDX-License-Identifier: GPL-2.0-only
#
# SPI driver configuration
#

if SPI

config DEVICE_MODULES_SPI_MT65XX
	tristate "MediaTek SPI controller"
	depends on ARCH_MEDIATEK || COMPILE_TEST
	help
	  This selects the MediaTek(R) SPI bus driver.
	  If you want to use MediaTek(R) SPI interface,
	  say Y or M here.If you are not sure, say N.
	  SPI drivers for Mediatek MT65XX and MT81XX series ARM SoCs.

config XIAOMI_FINGERPRINT_SPI_NUM
	int "xiaomi fingerprint spi num"
	default 1
	help
	  xiaomi fingerprint and mitee

config INTR2_PIN_ENABLE
	int "xiaomi ULTRA fingerprint controller "
	default 0
	help
	  add xiaomi ULTRA fingerprint

config DX5_SPI_PULL_RESUORCES
	bool "Enable P12U SPI Power Control"
	default n
	help
	This option enables project-specific SPI resources control code for DX5.
	Say Y here if you want to use this feature in your project.

config XIAOMI_SIDE_FINGERPRINT
	int "side_fingerprint"
	default 0
	help
	  add xiaomi side_fingerprint

config XIAOMI_FINGERPRINT_POWEAR_OFF_SEQ
	int "fingerprint_power_off_seq"
	default 0
	help
	  add xiaomi fingerprint_power_off_seq

endif # SPI
```

## drivers/spmi/Kconfig
```kconfig
# SPDX-License-Identifier: GPL-2.0-only
#
# SPMI driver configuration
#
if SPMI

config DEVICE_MODULES_SPMI_MTK_PMIF
	tristate "Mediatek SPMI Controller (PMIC Arbiter)"
	help
	  If you say yes to this option, support will be included for the
	  built-in SPMI PMIC Arbiter interface on Mediatek family
	  processors.

	  This is required for communicating with Mediatek PMICs and
	  other devices that have the SPMI interface.

config MTK_SPMI_NACK_DEBUG
	tristate "Mediatek SPMI NACK DEBUG"
	help
	  Say Y here to enable SPMI NACK debug support.
	  There are two possibilities when SPMI master receives an NACK,
	  By enabling SPMI NACK debug support, we can distinguish these
	  two different types of NACK, and handler it properly.
	  We will mask SPMI NACK irq for 100us if this is a current clamping
	  NACK, in order to avoid IRQ flooding.
	  We will trigger assert if this is a real NACK, in order to stop the
	  system in time and make debug signal issue easier.
endif
```

## drivers/tee/mitee/Kconfig
```kconfig
# MI-TEE Trusted Execution Environment Configuration
config MITEE_SUPPORT
	tristate "Enable MITEE Support"
	help
	  This implements the MI-TEE Trusted Execution Environment (TEE)
	  feature.

# MITEE TUI Configuration
config MITEE_TUI_SUPPORT
	tristate "Enable MITEE TUI Support"
	depends on MITEE_SUPPORT
	help
	  this is used to support mitee tui driver
```

## drivers/tty/serial/8250/Kconfig
```kconfig
# SPDX-License-Identifier: GPL-2.0
#
# The 8250/16550 serial drivers.  You shouldn't be in this list unless
# you somehow have an implicit or explicit dependency on SERIAL_8250.
#

config DEVICE_MODULES_SERIAL_8250_MT6577
	tristate "Mediatek serial port support"
	depends on SERIAL_8250
	depends on ARCH_MEDIATEK || COMPILE_TEST
	help
	  If you have a Mediatek based board and want to use the
	  serial port, say Y to this option. If unsure, say N.

config MTK_NO_SUPPORT_UARTHUB
	bool "Mediatek support uarthub"
	help
	  This config is used to control whether the project supports uarthub.
	  The default value is n.If uarthub is not supported, please set this config.
	  This config is specifically enabled for projects without uarthub.
	  If the current project does not support uarthub, please enable this config.
```

## sound/soc/codecs/aw882xx/Kconfig
```kconfig
config SND_SMARTPA_AW882XX
	tristate "AWINIC AW882XXxx speaker amplifier"
	depends on I2C
	default n
	help
	  Config of AWINIC AW882xx speaker amplifier.
```

## sound/soc/codecs/fs19xx/Kconfig
```kconfig
config SND_SOC_FS1XXX
	tristate "FourSemi FS19xx speaker amplifier"
	depends on I2C
	default n
	help
	  Config of FourSemi FS19xx speaker amplifier.
```
