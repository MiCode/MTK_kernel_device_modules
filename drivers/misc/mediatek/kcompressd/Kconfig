## drivers/misc/mediatek/kcompressd/Kconfig
```kconfig
# SPDX-License-Identifier: GPL-2.0
config MTK_KCOMPRESSD
	tristate "Kcompressd: Accelerated zram compression"
	help
	  Kcompressd creates multiple daemons to accelerate the compression of pages
	  in zram, offloading this time-consuming task from the zram driver.

	  This approach improves system efficiency by handling page compression separately,
	  which was originally done by kswapd or direct reclaim.
```

## drivers/misc/mediatek/lpm/governors/Kconfig
```kconfig
config MTK_CPU_IDLE_GOV
	tristate "Meditaek cpuidle governor support"
	help
	  For MediaTek cpuidle policy.
	  The policy is used to select suitable cpu idle state.
	  Select "y/m" if you want to enable mtk cpuidle policy.
	  Select "n" if unsure.

config MTK_CPU_IDLE_GOV_VERSION
	string "Meditaek Idle governor version"
	default "MHSP"
	help
	  Set MTK_IDLE_GOV_VERSION for Mediatek cpuidle policy.

config MTK_CPU_IDLE_IPI_SUPPORT
	bool "Meditaek Idle governor support ipi prediction"
	default n
	help
	  Set MTK_CPU_IDLE_IPI_SUPPORT for
	  Mediatek cpuidle ipi prediction policy.
	  The mechanism is based on ipi duration to
	  predict this cpu idle time.

config MTK_CPU_RETENTION_SUPPORT
	bool "Meditaek Idle governor support CPU retention"
	default y
	help
	  Set MTK_CPU_RETENTION_SUPPORT for
	  Mediatek cpu retention policy.
	  The mechanism is based on cpu idle count to
	  decide cpu retention on/off.
```

## drivers/misc/mediatek/mbraink/Kconfig
```kconfig
source "$(KCONFIG_EXT_PREFIX)drivers/misc/mediatek/mbraink/bridge/Kconfig"
source "$(KCONFIG_EXT_PREFIX)drivers/misc/mediatek/mbraink/perf/Kconfig"
source "$(KCONFIG_EXT_PREFIX)drivers/misc/mediatek/mbraink/modules/v6991/Kconfig"
source "$(KCONFIG_EXT_PREFIX)drivers/misc/mediatek/mbraink/modules/v6993/Kconfig"

config MTK_MBRAINK
	tristate "MTK MBRAINK support"
	select MTK_MBRAINK_BRIDGE
	help
          MBRAINK is a MediaTek in-house kernel module which can
          communicate with android MBrain.
          Set Y to enable this feature.
          If unsure, Set N to stay with legancy feature.

config MTK_MBRAINK_MT6989
	tristate "Specify Mediatek MBRAINK Platform is MT6989"
	depends on MTK_MBRAINK
	help
	  Select MediaTek MBraink Module Platform is MT6989
	  for android MBrain feature.
	  Set Y to select this feature for specific platform-mt6989.
	  If unsure, set N to disable.

config MTK_MBRAINK_MT8678
	tristate "Specify Mediatek MBRAINK Platform is MT8678"
	depends on MTK_MBRAINK
	default n
	help
	  Select MediaTek MBraink Module Platform is MT8678
	  for AUTO MBrain feature.
	  Set Y to select this feature for specific platform-mt8678.
	  If unsure, set N to disable.

config MTK_MBRAINK_MT6899
	tristate "Specify Mediatek MBRAINK Platform is MT6899"
	depends on MTK_MBRAINK
	help
	  Select MediaTek MBraink Module Platform is MT6899
	  for android MBrain feature.
	  Set Y to select this feature for specific platform-mt6899.
	  If unsure, set N to disable.
```

## drivers/misc/mediatek/mbraink/bridge/Kconfig
```kconfig
config MTK_MBRAINK_BRIDGE
	tristate "MTK MBRAINK BRIDGE support"
	help
	  MBRAINK BRIDGE is a MediaTek in-house kernel module which can
	  communicate with android MBrain.
	  Set Y to enable this feature.
	  If unsure, Set N to stay with legancy feature.
```

## drivers/misc/mediatek/mbraink/modules/v6991/Kconfig
```kconfig
config MTK_MBRAINK_MT6991
	tristate "Specify Mediatek MBRAINK Platform is MT6991"
	depends on MTK_MBRAINK
	help
	  Select MediaTek MBraink Module Platform is MT6991
	  for android MBrain feature.
	  Set Y to select this feature for specific platform-mt6991.
	  If unsure, set N to disable.
```

## drivers/misc/mediatek/mbraink/modules/v6993/Kconfig
```kconfig
config MTK_MBRAINK_MT6993
	tristate "Specify Mediatek MBRAINK Platform is MT6993"
	depends on MTK_MBRAINK
	help
	  Select MediaTek MBraink Module Platform is MT6993
	  for android MBrain feature.
	  Set Y to select this feature for specific platform-mt6993.
	  If unsure, set N to disable.
```

## drivers/misc/mediatek/mbraink/perf/Kconfig
```kconfig
config MTK_MBRAINK_PERF
	tristate "MTK MBRAINK PERF support"
	help
	  MBRAINK PERF is a MediaTek in-house kernel module which can
	  communicate with android MBrain.
	  Set Y to enable this feature.
	  If unsure, Set N to stay with legancy feature.
```

## drivers/misc/mediatek/mkp/Kconfig
```kconfig
config MTK_MKP
	tristate "MTK MKP feature"
	help
	  Protect the kernel section and module section, and
	  provide hook implementation to detect the changes
	  of critical kernel data. It uses some mechanisms
	  provided by EL2 to set memory type in S2 page table.

config MTK_MKP_TEST
	bool "MKP Test Functions"
	depends on MTK_MKP
	default n
	help
	  Provide MKP test functions to verify whether the
	  protection mechanism works. It contains functions to
	  simulate attacks on the kernel text and rodata. If
	  the protection works, the test will trigger OOPs
	  after some trials. Please do not enable it on USER
	  loads.
```

## drivers/misc/mediatek/mm_monitor/Kconfig
```kconfig
# SPDX-License-Identifier: GPL-2.0

config MTK_MM_MONITOR
	tristate "MediaTek MM_MONITOR Support"
	depends on ARCH_MEDIATEK || COMPILE_TEST
	help
	  Say yes here to add support for the MediaTek Multimedia Monitor Controller (MMMC)
	  driver. The MMMC is used to debug for Mediatek multimedia drivers.
	  Say no if the project version does not need MMMC to debug bw / latency information
	  for Multimedia drivers.

config MTK_MMMC_DEBUG
	tristate "enable MM_MONITOR_CONTROLLER driver debug extension"
	help
	  This extension enables some debug feature for the Multimedia Monitor Controller
	  Driver (MMMC). For some debug functions, we only default enable in userdebug/eng
	  load, and avoid the debug functions to be enabled in user load for security concern.
	  Debug function includes user trigger to control MMMC related HW.
```

## drivers/misc/mediatek/mme/Kconfig
```kconfig
config MMEVENT
	tristate "MMEVENT module enable or disable"
	help
	  Enable other module to use Multimedia event log mechanism.
	  By enable this config, the mme/ driver is built into kernel.
	  Otherwise other module will use empty functions in header file
	  instead. This is to make the event log mechanism driver to be
	  a switchable module.
```

## drivers/misc/mediatek/mtk-interconnect/Kconfig
```kconfig
# SPDX-License-Identifier: GPL-2.0-only

config INTERCONNECT_MTK_EXTENSION
	tristate "Mediatek Network-on-Chip interconnect extension drivers"
	depends on INTERCONNECT_MTK
	help
	  New framework for Mediatek's Network-on-Chip interconnect hardware.

config MTK_INTERCONNECT_DEBUG
	tristate "enable MTK INTERCONNECT driver debug extension"
	help
	  This extension enables interconnect systrace for mmqos driver, we
	  only default enable interconnect systrace feature in userdebug/eng load,
	  and avoid user load for performance concern. But for systrace feature,
	  user can enable/disable it with adb command.
```

## drivers/misc/mediatek/mtk_zram/Kconfig
```kconfig
config MTK_ZRAM_ENGINE
	tristate "MTK zram engine feature"
	help
	  MTK proprietary compression engine, which is highly integrated with
	  ZRAM to provide fast and light-loading compression tasks.
	  This is used for the improvement of sw compression over some scenarios.
	  If you are not sure about whether to enable it or not, please set n.

config MTK_ZRAM
	tristate "MTK zram feature"
	depends on BLOCK && SYSFS && MMU
	depends on CRYPTO_LZ4
	depends on MTK_ZRAM_ENGINE && MTK_KCOMPRESSD
	select ZSMALLOC
	help
	  Creates virtual block devices called /dev/block/zramX (X = 0, 1, ...).
	  Pages written to these disks are compressed and stored in memory itself.
	  These disks allow very fast I/O and compression provides good amounts of
	  memory savings.
	  If you are not sure about whether to enable it or not, please set n.

config ZRAM_ENGINE_COMP_FIFO_BITS
	int "The entry bits of ZRAM ENGINE Compression FIFOs (8-11)"
	range 8 11
	default "11"
	help
	  This will create a fifo with depth of 2^8 ~ 2^11.

config ZRAM_ENGINE_DECOMP_FIFO_BITS
	int "The entry bits of ZRAM ENGINE Decompression FIFOs (3-7)"
	range 3 7
	default "7"
	help
	  This will create per-cpu fifos with depth of 2^3 ~ 2^7 for
	  decompression.

config HWCOMP_SUPPORT_NO_DST_COPY
	bool "No extra SW copy to store HW compressed data"
	default y
	help
	  Original zram uses zsmalloc to store compressed data. The flow is to compress
	  SRC page and then copy the compressed data to zsmalloc. Turn on this option will
	  use slab memory to store compressed data directly without the SW copy.
```

## drivers/misc/mediatek/network/Kconfig
```kconfig
config MTK_UDP_GRO_DEBUG
	tristate "MediaTek Network UDP GRO Debug"
	help
	  This is the network for MediaTek kernel UDP GRO debug.
	  When GRO packet is merged and skb->tail is pulled.
	  Only for udp GRO packets.
	  Only for GRO fraglist mode.
	  Only for fraglist is NULL and gso_size is not zero.
```

## drivers/misc/mediatek/nfc/p16/Kconfig
```kconfig
source "$(KCONFIG_EXT_PREFIX)drivers/misc/mediatek/nfc/p16/nxp-ese/Kconfig"
source "$(KCONFIG_EXT_PREFIX)drivers/misc/mediatek/nfc/p16/nxp-nfc/Kconfig"
source "$(KCONFIG_EXT_PREFIX)drivers/misc/mediatek/nfc/p16/tmsdrv/Kconfig"
```

## drivers/misc/mediatek/perfhelper/Kconfig
```kconfig
config PERFHELPER
    tristate "Perf helper"
    default n
    help
        mimd kernel node, like global_reclaim/mimd_trigger etc.
```

## drivers/misc/mediatek/performance/Kconfig
```kconfig
config MTK_FPSGO_V3
	tristate "Support FPSGO_V3 framework"
	help
	  Support FPSGO_V3 framework for most FPS performance and
	  low power balance. As a perquisite to ensure FPS performance,
	  FPSGO_V3 persuades lowest power consumption for better DoU
	  endurance and gaming experience.
	  FPSGO_V3 include AI performance and low power.
	  If you are not sure about this, set n.

config MTK_FPSGO_V8
	tristate "Support FPSGO_V8 framework"
	help
	  Support FPSGO_V8 common framework for most FPS performance and
	  low power balance. As a perquisite to ensure FPS performance,
	  FPSGO_V8 provide general API for scenario to achieve lower power
	  consumption.
	  If you are not sure about this, set n.

config MTK_PERFORMANCE_MODULE
	tristate "Mediatek Performance Module"
	help
	  For MediaTek performance modules, such as FPSGO and EARA-QoS
	  Select "y" if you want to enable power throttling feature
	  Select "n" if unsure.

config MTK_FRS
	tristate "Mediatek Frame Rate Smoother"
	help
	  Support Frame Rate Smoother kernel intergface. It will adjustment
	  target fps by thermal.
	  If you are not sure about this, set n.

config MTK_LOAD_TRACKER
	tristate "CPU Loading Tracking Service"
	depends on CPU_FREQ
	default n
	help
	  MTK_LOAD_TRACKER is the kernel config of CPU Loading Tracking
	  Service designed by MTK, which is a service to get CPU Loading
	  information. User can register callback and config polling
	  duration to get CPU loading.

config MTK_LOAD_TRACKER_DEBUG
	tristate "CPU Loading Tracking Service"
	help
	  MTK_LOAD_TRACKER_DEBUG is the kernel debug config of CPU Loading
	  Tracking Service designed by MTK. Use can use it to avoid print
	  trace log on use load.
	  Default it enable on eng, userdebug load.

config MTK_PERF_IOCTL_MAGT
	tristate "Mediatek Adaptive Gaming Technology"
	help
	  Support MAGT analysis performance.
          If you are not sure about this, set n.

config MTK_SBE
	tristate "MediaTek Scenario Boost Engine"
	help
	  For UX scenario, SBE identify scrolling behavior, and adjust
	  CPU boost policy to achieve FPS performance and low power balance
	  via kernel config of MTK_SBE
	  If you are not sure about this, set n.

config MTK_GAME
	tristate "GAME module specific"
	help
	  MTK game module, in order to decouple with FPSGO module
	  This module is for game feature use, If some flow modification
	  for game only, need to modify in this module.
	  Default it enable on eng, user, userdebug load.

config MTK_PELT_HINT
	tristate "MediaTek PELT HINT"
	help
	  Enable the MediaTek PELT (Per-Entity Load Tracking) HINT module. This
	  module provides an API for boosting the CPU resources allocated to tasks
	  by providing hints to the scheduler. It is useful in scenarios where
	  tasks require more immediate CPU resources for better performance.
	  If unsure, or if you do not need task-specific CPU resource optimization,
	  select 'n'.

config MTK_POWER_RL_V2
	tristate "Support Power RL V2"
	help
	  Power RL V2 is a MediaTek feature designed
	  to manage the power consumption of games running on the device. It
	  works by monitoring the system's thermal conditions and dynamically
	  adjusting the power usage to prevent overheating. This can help to
	  maintain a balance between performance and power, ensuring that
	  the device operates within safe thermal limits. Enable this feature if
	  you want to provide thermal management for gaming applications on
	  MediaTek platforms. If unsure, or if your device does not require this
	  feature, choose 'n'.
```

## drivers/misc/mediatek/pkvm_cmdq/Kconfig
```kconfig
# SPDX-License-Identifier: GPL-2.0
#
# Copyright (c) 2024 MediaTek Inc.
#

config MTK_PKVM_CMDQ
	tristate "MTK pKVM cmdq"
	help
	  A new option CONFIG_MTK_PKVM_CMDQ for the feature.
	  This is used for handling el1 in pKVM(EL2). If you
	  are not sure about whether to enable it or not,
	  please set n.
```

## drivers/misc/mediatek/pkvm_smmu/Kconfig
```kconfig
config MTK_PKVM_SMMU
	tristate "MTK pKVM smmu"
	help
	  A new option CONFIG_MTK_PKVM_SMMU for the feature.
	  This is used for handling smmu in pKVM(EL2). If you
	  are not sure about whether to enable it or not,
	  please set n.

config MTK_PKVM_SMMU_WA
	bool "MTK pKVM smmu workaround"
	help
	  A new option CONFIG_MTK_PKVM_SMMU_WA for the feature.
	  This is used for handling smmu in pKVM(EL2). If you
	  are not sure about whether to enable it or not,
	  please set n.
```

## drivers/misc/mediatek/sensor/1.0/situation/situation_hub/sar_detector/Kconfig
```kconfig
config MTK_SAR_DETECTOR_HUB
	bool "flat for MediaTek package"
	help
	  Put the device lie on the table.
```

## drivers/misc/mediatek/sensor/1.0/situation/situation_hub/sar_detector_1/Kconfig
```kconfig
config MTK_SAR_DETECTOR_1_HUB
	bool "flat for MediaTek package"
	help
	  Put the device lie on the table.
```

## drivers/misc/mediatek/simtray/Kconfig
```kconfig
#
# P16/P16P code for HQFEAT-89765 by p-yinjieru at 2025/02/26
#
config SIMTRAY_STATUS
	tristate "Xiaomi SIM tray status"
	default n
	help
	  Say 'y' here to support SIM tray GPIO detection
```

## drivers/misc/mediatek/spm/Kconfig
```kconfig
config MTK_SPM
	tristate "MTK SPM"
	help
	  This kernel config can be used to enable MTK QOS FRAMEWORK.
	  When enabling this option, BW Limiter and BW Bound Detector
	  will be enabled and set EMI hardware.
	  If unsure, say N.

config MTK_SPM_V0
	tristate "MTK SPM V0"
	help
	  This kernel config can be used to enable config MTK SPM V0
	  for MT6765 & 61, this spm driver will support idle and
	  suspend flow
	  If unsure, say N.

config MTK_IDLE_BOOST
	tristate "MTK IDLE BOOST"
	help
	  This kernel config can be used to boost vcore to 0.7v when
	  entering idle for MT6768, enhancing system stability.
	  Useful for frequent idle transitions.
	  If unsure, say N.
```
