## drivers/misc/mediatek/swpm/Kconfig
```kconfig
config MTK_SWPM_MODULE
	tristate "Meditaek Software Power Model Module"
	help
	  For MediaTek Software Power Model Module,
	  modling SoC likes CPU, GPU and DRAM power.
	  Select "y" if you want to enable SWPM features.
	  Select "n" if unsure.

config MTK_SWPM_DBG_COMMON
	tristate "Meditaek Software Power Model common debug Module"
	help
	  Select MTK_SWPM_DBG_COMMON then Mediatek Software Power Model
	  common debug feature will be enabled. The common debug
	  feature will support basic debug control and show the
	  information to console and ftrace.

config MTK_SWPM_PERF_ARMV8_PMU
	tristate "Meditaek Software Power Model uses ARMV8 and L3-cache PMU"
	help
	   Select MTK_SWPM_PERF_ARMV8_PMU then Mediatek Software Power Model
	   common debug feature will reserve ARM related PMU.
	   Mediatek Software Power Model will register ARM PMUs and L3 cache
	   performance monitor unit (PMU) by perf framework.

config MTK_SWPM_MT6835
	tristate "Specify Mediatek SWPM Platform is MT6835"
	depends on MTK_SWPM_MODULE
	select MTK_SWPM_DBG_COMMON
	help
	  Select MediaTek Software Power Model Platform is MT6835
	  for power management.
	  Set Y to select this feature for specific platform-mt6835.
	  If unsure, set N to disable.

config MTK_SWPM_MT6853
	tristate "Specify Mediatek SWPM Platform is MT6853"
	depends on MTK_SWPM_MODULE
	select MTK_SWPM_DBG_COMMON
	help
	  Select MediaTek Software Power Model Platform is MT6853
	  for power management.
	  Set Y to select this feature for specific platform-mt6853.
	  If unsure, set N to disable.

config MTK_SWPM_MT6858
	tristate "Specify Mediatek SWPM Platform is MT6858"
	depends on MTK_SWPM_MODULE
	select MTK_SWPM_DBG_COMMON
	help
	  Select MediaTek Software Power Model Platform is MT6858
	  for power management.
	  Set Y to select this feature for specific platform-mt6858.
	  If unsure, set N to disable.

config MTK_SWPM_MT6873
	tristate "Specify Mediatek SWPM Platform is MT6873"
	depends on MTK_SWPM_MODULE
	select MTK_SWPM_DBG_COMMON
	help
	  Select MediaTek Software Power Model Platform is MT6873
	  for power management.
	  Set Y to select this feature for specific platform-mt6873.
	  If unsure, set N to disable.

config MTK_SWPM_MT6879
	tristate "Specify Mediatek SWPM Platform is MT6879"
	depends on MTK_SWPM_MODULE
	select MTK_SWPM_DBG_COMMON
	help
	  Select MediaTek Software Power Model Platform is MT6879
	  for power management.
	  Set Y to select this feature for specific platform-mt6879.
	  If unsure, set N to disable.

config MTK_SWPM_MT6885
	tristate "Specify Mediatek SWPM Platform is MT6885"
	depends on MTK_SWPM_MODULE
	select MTK_SWPM_DBG_COMMON
	help
	  Select MediaTek Software Power Model Platform is MT6885
	  for power management.
	  Set Y to select this feature for specific platform-mt6885.
	  If unsure, set N to disable.

config MTK_SWPM_MT6886
	tristate "Specify Mediatek SWPM Platform is MT6886"
	depends on MTK_SWPM_MODULE
	select MTK_SWPM_DBG_COMMON
	help
	  Select MediaTek Software Power Model Platform is MT6886
	  for power management.
	  Set Y to select this feature for specific platform-mt6886.
	  If unsure, set N to disable.

config MTK_SWPM_MT6897
	tristate "Specify Mediatek SWPM Platform is MT6897"
	depends on MTK_SWPM_MODULE
	select MTK_SWPM_DBG_COMMON
	help
	  Select MediaTek Software Power Model Platform is MT6897
	  for power management.
	  Set Y to select this feature for specific platform-mt6897.
	  If unsure, set N to disable.


config MTK_SWPM_MT6893
	tristate "Specify Mediatek SWPM Platform is MT6893"
	depends on MTK_SWPM_MODULE
	select MTK_SWPM_DBG_COMMON
	help
	  Select MediaTek Software Power Model Platform is MT6893
	  for power management.
	  Set Y to select this feature for specific platform-mt6893.
	  If unsure, set N to disable.

config MTK_SWPM_MT6899
	tristate "Specify Mediatek SWPM Platform is MT6899"
	depends on MTK_SWPM_MODULE
	select MTK_SWPM_DBG_COMMON
	help
	  Select MediaTek Software Power Model Platform is MT6899
	  for power management.
	  Set Y to select this feature for specific platform-mt6899.
	  If unsure, set N to disable.

config MTK_SWPM_MT6983
	tristate "Specify Mediatek SWPM Platform is MT6983"
	depends on MTK_SWPM_MODULE
	select MTK_SWPM_DBG_COMMON
	help
	  Select MediaTek Software Power Model Platform is MT6983
	  for power management.
	  Set Y to select this feature for specific platform-mt6983.
	  If unsure, set N to disable.

config MTK_SWPM_MT6985
	tristate "Specify Mediatek SWPM Platform is MT6985"
	depends on MTK_SWPM_MODULE
	select MTK_SWPM_DBG_COMMON
	help
	  Select MediaTek Software Power Model Platform is MT6985
	  for power management.
	  Set Y to select this feature for specific platform-mt6985.
	  If unsure, set N to disable.

config MTK_SWPM_MT6989
	tristate "Specify Mediatek SWPM Platform is MT6989"
	depends on MTK_SWPM_MODULE
	select MTK_SWPM_DBG_COMMON
	help
	  Select MediaTek Software Power Model Platform is MT6989
	  for power management.
	  Set Y to select this feature for specific platform-mt6989.
	  If unsure, set N to disable.

config MTK_SWPM_MT6991
	tristate "Specify Mediatek SWPM Platform is MT6991"
	depends on MTK_SWPM_MODULE
	select MTK_SWPM_DBG_COMMON
	help
	  Select MediaTek Software Power Model Platform is MT6991
	  for power management.
	  Set Y to select this feature for specific platform-mt6991.
	  If unsure, set N to disable.

config MTK_SWPM_MT6993
	tristate "Specify Mediatek SWPM Platform is MT6993"
	depends on MTK_SWPM_MODULE
	select MTK_SWPM_DBG_COMMON
	help
	  Select MediaTek Software Power Model Platform is MT6993
	  for power management.
	  Set Y to select this feature for specific platform-mt6993.
	  If unsure, set N to disable.


config MTK_SWPM_ISP
	tristate "Meditaek Software ISP Power Model funtionality"
	depends on MTK_SWPM_MODULE
	help
	  Wrapper between ISP driver and ISP SWPM.
	  Set Y to enable this feature.
	  If unsure, set N to disable.
	  Default is N to disable ISP SWPM wrapper.
```

## drivers/misc/mediatek/swpm_legacy_v2/Kconfig
```kconfig
config MTK_SWPM_MODULE_LEGACY_V2
	tristate "Meditaek Software Power Model Module"
	help
	  For MediaTek Software Power Model Module,
	  modling SoC likes CPU, GPU and DRAM power.
	  Select "y" if you want to enable SWPM features.
	  Select "n" if unsure.

config MTK_SWPM_DBG_COMMON
	tristate "Meditaek Software Power Model common debug Module"
	help
	  Select MTK_SWPM_DBG_COMMON then Mediatek Software Power Model
	  common debug feature will be enabled. The common debug
	  feature will support basic debug control and show the
	  information to console and ftrace.

config MTK_SWPM_PERF_ARMV8_PMU_LEGACY_V2
	tristate "Meditaek Software Power Model uses ARMV8 and L3-cache PMU"
	help
	   Select MTK_SWPM_PERF_ARMV8_PMU_LEGACY_V2 then Mediatek Software Power Model
	   common debug feature will reserve ARM related PMU.
	   Mediatek Software Power Model will register ARM PMUs and L3 cache
	   performance monitor unit (PMU) by perf framework.

config MTK_SWPM_MT6789
	tristate "Specify Mediatek SWPM Platform is MT6789"
	depends on MTK_SWPM_MODULE_LEGACY_V2
	select MTK_SWPM_DBG_COMMON
	help
	  Select MediaTek Software Power Model Platform is MT6789
	  for power management.
	  Set Y to select this feature for specific platform-mt6789.
	  If unsure, set N to disable.

config MTK_SWPM_MT6855
	tristate "Specify Mediatek SWPM Platform is MT6855"
	depends on MTK_SWPM_MODULE_LEGACY_V2
	select MTK_SWPM_DBG_COMMON
	help
	  Select MediaTek Software Power Model Platform is MT6855
	  for power management.
	  Set Y to select this feature for specific platform-mt6855.
	  If unsure, set N to disable.

config MTK_SWPM_MT6895
	tristate "Specify Mediatek SWPM Platform is MT6895"
	depends on MTK_SWPM_MODULE_LEGACY_V2
	select MTK_SWPM_DBG_COMMON
	help
	  Select MediaTek Software Power Model Platform is MT6895
	  for power management.
	  Set Y to select this feature for specific platform-mt6895.
	  If unsure, set N to disable.
```

## drivers/misc/mediatek/task_turbo/Kconfig
```kconfig
config MTK_TASK_TURBO
	tristate "MTK task turbo feature"
	help
	  A new option CONFIG_MTK_TASK_TURBO for the feature.
	  Task turbo provide enhancement of APP launch and lock
	  latency via Preempting lock waiting queue and more
	  oppotunity to occupy CPU resource.
	  If you are not sure about whether to enable it or not,
	  please set n.

config MTK_VIP_ENGINE
	tristate "MTK vip engine feature"
	help
	  A new option CONFIG_MTK_VIP_ENGINE for the feature.
	  VIP engine provide enhancement to ensure that TOP-APP
	  have sufficient CPU resources under high-loading
	  situations.
	  If you are not sure about whether to enable it or not,
	  please set n.
```
